# R7S910x18 register map
Vendor: Renesas Electronics Corporation; Series: RZT; File version: 1.0
CPU: other r1p4, little endian, MPU, FPU, vendor SysTick, 1 interrupt priority bits
Registers are 32-bit, read-write, no defined reset value unless marked. A register's access mark holds for its fields unless they carry their own. Offsets are from the block's base; [hi:lo] are bit positions; {n}, {i} and the like mark numbered series.

## CMTW — Compare match timer W
Base 0xA0080300; register names take the prefix CMTW_
0x00 CMTW0_CMWSTR 16-bit — Timer start register
0x04 CMTW0_CMWCR 16-bit — Timer control register
0x08 CMTW0_CMWIOR 16-bit — Timer I/O control register
0x10 CMTW0_CMWCNT — Timer counter
0x14 CMTW0_CMWCOR — Compare match constant register
0x18 CMTW0_CMWICR0 ro — Input capture register 0
0x1C CMTW0_CMWICR1 ro — Input capture register 1
0x20 CMTW0_CMWOCR0 — Output compare register 0
0x24 CMTW0_CMWOCR1 — Output compare register 1
0x80 CMTW1_CMWSTR 16-bit — Timer start register
0x84 CMTW1_CMWCR 16-bit — Timer control register
0x88 CMTW1_CMWIOR 16-bit — Timer I/O control register
0x90 CMTW1_CMWCNT — Timer counter
0x94 CMTW1_CMWCOR — Compare match constant register
0x98 CMTW1_CMWICR0 ro — Input capture register 0
0x9C CMTW1_CMWICR1 ro — Input capture register 1
0xA0 CMTW1_CMWOCR0 — Output compare register 0
0xA4 CMTW1_CMWOCR1 — Output compare register 1
0x100 CMTW_NFCR0 — Digital noise filter control register 0
0x104 CMTW_NFCR1 — Digital noise filter control register 1
0x110 CMTW_ECDMESLR — ECM dynamic mode error output select register

## PPG0 — Programmable pulse generator 0
Base 0xA0080500; register names take the prefix PPG0_
0x06 PCR 8-bit — PPG output control register
0x07 PMR 8-bit — PPG output mode register
0x08 NDERH 8-bit — Next data enable register H
0x09 NDERL 8-bit — Next data enable register L
0x0A PODRH 8-bit — Output data register H
0x0B PODRL 8-bit — Output data register L
0x0C NDRH 8-bit — Next data register H
0x0D NDRL 8-bit — Next data register L
0x0E NDRH2 8-bit — Next data register H
0x0F NDRL2 8-bit — Next data register L

## PPG1 — Programmable pulse generator 1
Base 0xA0080510; register names take the prefix PPG1_
Registers as PPG0; these are added or differ:
0x10 PTRSLR 8-bit — PPG trigger select register

## WDT0 — Watchdog timer 0
Base 0xA0080600; register names take the prefix WDT0_
0x00 WDTRR 8-bit — WDT refresh register
0x02 WDTCR 16-bit — WDT control register
0x04 WDTSR 16-bit — WDT status register
0x06 WDTRCR 8-bit — WDT reset control register

## WDT1 — Watchdog timer 1
Base 0xA0080620; register names take the prefix WDT1_
Registers as WDT0.

## IWDT — Independent watchdog timer
Base 0xA0080700; register names take the prefix IWDT_
0x00 IWDTRR 8-bit — IWDT refresh register
0x02 IWDTCR 16-bit — IWDT control register
0x04 IWDTSR 16-bit — IWDT status register
0x06 IWDTRCR 8-bit — IWDT reset control register

## POE3 — Port output enable
Base 0xA0080800; register names take the prefix POE3_
0x00 ICSR1 16-bit rw-once — Input level control/status register 1
0x02 OCSR1 16-bit rw-once — Output level control/status register 1
0x04 ICSR2 16-bit rw-once — Input level control/status register 2
0x06 OCSR2 16-bit rw-once — Output level control/status register 2
0x08 ICSR3 16-bit rw-once — Input level control/status register 3
0x0A SPOER 8-bit — Software port output enable register
0x0B POECR1 8-bit rw-once — Port output enable control register 1
{0x8+2i} POECR{i} 16-bit rw-once (i=2..6) — Port output enable control register {i}
0x16 ICSR4 16-bit rw-once — Input level control/status register 4
0x18 ICSR5 16-bit rw-once — Input level control/status register 5
0x1A ALR1 16-bit rw-once — Active level register 1
0x1C ICSR6 16-bit rw-once — Input level control/status register 6
0x23 G3SELR 8-bit rw-once — GPT3 pin select register
0x24 M0SELR1 8-bit rw-once — MTU0 pin select register 1
0x25 M0SELR2 8-bit rw-once — MTU0 pin select register 2
0x26 M3SELR 8-bit rw-once — MTU3 pin select register
0x27 M4SELR1 8-bit rw-once — MTU4 pin select register 1
0x28 M4SELR2 8-bit rw-once — MTU4 pin select register 2
