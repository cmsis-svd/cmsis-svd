# RZ_A1LU register map
Vendor: Renesas Electronics Corporation.; Series: RZ; File version: 3
CPU: other r3p0, little endian, MPU, no FPU, 3 interrupt priority bits
Registers are 32-bit, read-write, no defined reset value unless marked. A register's access mark holds for its fields unless they carry their own. Offsets are from the block's base; [hi:lo] are bit positions; {n}, {i} and the like mark numbered series.

## USB201
Base 0xE8207000
0x00 SYSCFG0_1 16-bit
0x02 BUSWAIT_1 16-bit
0x04 SYSSTS0_1 16-bit
0x08 DVSTCTR0_1 16-bit
0x0C TESTMODE_1 16-bit
0x10 D0FBCFG_1 16-bit
0x12 D1FBCFG_1 16-bit
0x14 CFIFO_1
0x18 D0FIFO_1
0x1C D1FIFO_1
0x20 CFIFOSEL_1 16-bit
0x22 CFIFOCTR_1 16-bit
0x28 D0FIFOSEL_1 16-bit
0x2A D0FIFOCTR_1 16-bit
0x2C D1FIFOSEL_1 16-bit
0x2E D1FIFOCTR_1 16-bit
0x30 INTENB0_1 16-bit
0x32 INTENB1_1 16-bit
0x36 BRDYENB_1 16-bit
0x38 NRDYENB_1 16-bit
0x3A BEMPENB_1 16-bit
0x3C SOFCFG_1 16-bit
0x40 INTSTS0_1 16-bit
0x42 INTSTS1_1 16-bit
0x46 BRDYSTS_1 16-bit
0x48 NRDYSTS_1 16-bit
0x4A BEMPSTS_1 16-bit
0x4C FRMNUM_1 16-bit
0x4E UFRMNUM_1 16-bit
0x50 USBADDR_1 16-bit
0x54 USBREQ_1 16-bit
0x56 USBVAL_1 16-bit
0x58 USBINDX_1 16-bit
0x5A USBLENG_1 16-bit
0x5C DCPCFG_1 16-bit
0x5E DCPMAXP_1 16-bit
0x60 DCPCTR_1 16-bit
0x64 PIPESEL_1 16-bit
0x68 PIPECFG_1 16-bit
0x6A PIPEBUF_1 16-bit
0x6C PIPEMAXP_1 16-bit
0x6E PIPEPERI_1 16-bit
{0x6E+2i} PIPE{i}CTR_1 16-bit (i=1..9)
0x82 PIPEACTR_1 16-bit
0x84 PIPEBCTR_1 16-bit
0x86 PIPECCTR_1 16-bit
0x88 PIPEDCTR_1 16-bit
0x8A PIPEECTR_1 16-bit
0x8C PIPEFCTR_1 16-bit
{0x8C+4i} PIPE{i}TRE_1 16-bit (i=1..5)
{0x8E+4i} PIPE{i}TRN_1 16-bit (i=1..5)
0xA4 PIPEBTRE_1 16-bit
0xA6 PIPEBTRN_1 16-bit
0xA8 PIPECTRE_1 16-bit
0xAA PIPECTRN_1 16-bit
0xAC PIPEDTRE_1 16-bit
0xAE PIPEDTRN_1 16-bit
0xB0 PIPEETRE_1 16-bit
0xB2 PIPEETRN_1 16-bit
0xB4 PIPEFTRE_1 16-bit
0xB6 PIPEFTRN_1 16-bit
0xB8 PIPE9TRE_1 16-bit
0xBA PIPE9TRN_1 16-bit
0xBC PIPEATRE_1 16-bit
0xBE PIPEATRN_1 16-bit
{0xD0+2i} DEVADD{i}_1 16-bit (i=0..9)
0xE4 DEVADDA_1 16-bit
0x102 SUSPMODE_1 16-bit
{0x160+4i} D0FIFOB{i}_1 (i=0..7)
{0x180+4i} D1FIFOB{i}_1 (i=0..7)

## SCUX
Base 0xE8208000
{0x0+0x100*i} IPCIR_IPC0_{i} (i=0..3)
{0x4+0x100*i} IPSLR_IPC0_{i} (i=0..3)
{0x400+0x100*i} OPCIR_OPC0_{i} (i=0..3)
{0x404+0x100*i} OPSLR_OPC0_{i} (i=0..3)
{0x800+0x100*i} FFDIR_FFD0_{i} (i=0..3)
{0x804+0x100*i} FDAIR_FFD0_{i} (i=0..3)
{0x808+0x100*i} DRQSR_FFD0_{i} (i=0..3)
{0x80C+0x100*i} FFDPR_FFD0_{i} (i=0..3)
{0x810+0x100*i} FFDBR_FFD0_{i} (i=0..3)
{0x814+0x100*i} DEVMR_FFD0_{i} (i=0..3)
{0x81C+0x100*i} DEVCR_FFD0_{i} (i=0..3)
{0xC00+0x100*i} FFUIR_FFU0_{i} (i=0..3)
{0xC04+0x100*i} FUAIR_FFU0_{i} (i=0..3)
{0xC08+0x100*i} URQSR_FFU0_{i} (i=0..3)
{0xC0C+0x100*i} FFUPR_FFU0_{i} (i=0..3)
{0xC10+0x100*i} UEVMR_FFU0_{i} (i=0..3)
{0xC18+0x100*i} UEVCR_FFU0_{i} (i=0..3)
0x1000 SRCIR0_2SRC0_0
0x1004 SADIR0_2SRC0_0
0x1008 SRCBR0_2SRC0_0
0x100C IFSCR0_2SRC0_0
0x1010 IFSVR0_2SRC0_0
0x1014 SRCCR0_2SRC0_0
0x1018 MNFSR0_2SRC0_0
0x101C BFSSR0_2SRC0_0
0x1020 SC2SR0_2SRC0_0
0x1024 WATSR0_2SRC0_0
0x1028 SEVMR0_2SRC0_0
0x1030 SEVCR0_2SRC0_0
0x1034 SRCIR1_2SRC0_0
0x1038 SADIR1_2SRC0_0
0x103C SRCBR1_2SRC0_0
0x1040 IFSCR1_2SRC0_0
0x1044 IFSVR1_2SRC0_0
0x1048 SRCCR1_2SRC0_0
0x104C MNFSR1_2SRC0_0
0x1050 BFSSR1_2SRC0_0
0x1054 SC2SR1_2SRC0_0
0x1058 WATSR1_2SRC0_0
0x105C SEVMR1_2SRC0_0
0x1064 SEVCR1_2SRC0_0
0x1068 SRCIRR_2SRC0_0
0x1100 SRCIR0_2SRC0_1
0x1104 SADIR0_2SRC0_1
0x1108 SRCBR0_2SRC0_1
0x110C IFSCR0_2SRC0_1
0x1110 IFSVR0_2SRC0_1
0x1114 SRCCR0_2SRC0_1
0x1118 MNFSR0_2SRC0_1
0x111C BFSSR0_2SRC0_1
0x1120 SC2SR0_2SRC0_1
0x1124 WATSR0_2SRC0_1
0x1128 SEVMR0_2SRC0_1
0x1130 SEVCR0_2SRC0_1
0x1134 SRCIR1_2SRC0_1
0x1138 SADIR1_2SRC0_1
0x113C SRCBR1_2SRC0_1
0x1140 IFSCR1_2SRC0_1
0x1144 IFSVR1_2SRC0_1
0x1148 SRCCR1_2SRC0_1
0x114C MNFSR1_2SRC0_1
0x1150 BFSSR1_2SRC0_1
0x1154 SC2SR1_2SRC0_1
0x1158 WATSR1_2SRC0_1
0x115C SEVMR1_2SRC0_1
0x1164 SEVCR1_2SRC0_1
0x1168 SRCIRR_2SRC0_1
{0x1200+0x100*i} DVUIR_DVU0_{i} (i=0..3)
{0x1204+0x100*i} VADIR_DVU0_{i} (i=0..3)
{0x1208+0x100*i} DVUBR_DVU0_{i} (i=0..3)
{0x120C+0x100*i} DVUCR_DVU0_{i} (i=0..3)
{0x1210+0x100*i} ZCMCR_DVU0_{i} (i=0..3)
{0x1214+0x100*i} VRCTR_DVU0_{i} (i=0..3)
{0x1218+0x100*i} VRPDR_DVU0_{i} (i=0..3)
{0x121C+0x100*i} VRDBR_DVU0_{i} (i=0..3)
{0x1220+0x100*i} VRWTR_DVU0_{i} (i=0..3)
{0x1224+4i} VOL{i}R_DVU0_0 (i=0..7)
{0x1244+0x100*i} DVUER_DVU0_{i} (i=0..3)
{0x1248+0x100*i} DVUSR_DVU0_{i} (i=0..3)
{0x124C+0x100*i} VEVMR_DVU0_{i} (i=0..3)
{0x1254+0x100*i} VEVCR_DVU0_{i} (i=0..3)
{0x1324+4i} VOL{i}R_DVU0_1 (i=0..7)
{0x1424+4i} VOL{i}R_DVU0_2 (i=0..7)
{0x1524+4i} VOL{i}R_DVU0_3 (i=0..7)
0x1600 MIXIR_MIX0_0
0x1604 MADIR_MIX0_0
0x1608 MIXBR_MIX0_0
0x160C MIXMR_MIX0_0
0x1610 MVPDR_MIX0_0
0x1614 MDBAR_MIX0_0
0x1618 MDBBR_MIX0_0
0x161C MDBCR_MIX0_0
0x1620 MDBDR_MIX0_0
0x1624 MDBER_MIX0_0
0x1628 MIXSR_MIX0_0
0x1700 SWRSR_CIM
0x1704 DMACR_CIM
{0x1708+4i} DMATD{i}_CIM (i=0..3)
{0x1718+4i} DMATU{i}_CIM (i=0..3)
0x1738 SSIRSEL_CIM
{0x173C+4i} FDTSEL{i}_CIM (i=0..3)
{0x174C+4i} FUTSEL{i}_CIM (i=0..3)
0x175C SSIPMD_CIM
0x1760 SSICTRL_CIM
{0x1764+4i} SRCRSEL{i}_CIM (i=0..3)
0x1774 MIXRSEL_CIM
