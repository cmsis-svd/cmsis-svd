# STM32WL5x_CM0P register map
File version: 1.9
CPU: CM0 r0p1, little endian, MPU, no FPU, 4 interrupt priority bits
Registers are 32-bit, read-write, reset 0x0 unless marked. A register's access mark holds for its fields unless they carry their own. Offsets are from the block's base; lines under a group give offsets from that group; [hi:lo] are bit positions; {n}, {i} and the like mark numbered series; 'fields as' and 'values as' point back to an identical list; <NAME> marks a mode.

## Memory map
0x40000000 TIM2 size 0x400 — General-purpose-timers
0x40002800 RTC size 0x400 — Real-time clock
0x40002C00 WWDG size 0x400 — System window watchdog
0x40003000 IWDG size 0x400 — Independent watchdog
0x40003800 SPI2 size 0x400
0x40004400 USART2 size 0x400
0x40005400 I2C1 size 0x400 — Inter-integrated circuit
0x40005800 I2C2 size 0x400
0x40005C00 I2C3 size 0x400
0x40007400 DAC size 0x400 — Digital-to-analog converter
0x40007C00 LPTIM1 size 0x400 — Low-power timer
0x40008000 LPUART size 0x400 — Universal synchronous asynchronous receiver transmitter
0x40009400 LPTIM2 size 0x400 — Low-power timer
0x40009800 LPTIM3 size 0x400 — Low-power timer
0x4000B000 TAMP size 0x400 — Tamper and backup registers
0x40010000 SYSCFG size 0x30 — System configuration controller
0x40010030 VREFBUF size 0xD0 — Voltage reference buffer
0x40010100 SYSCFG_continue size 0x100 — System configuration controller
0x40010200 COMP size 0x200 — Comparator
0x40012400 ADC size 0x400 — Analog to digital convertor
0x40012C00 TIM1 size 0x400 — Advanced-control timers
0x40013000 SPI1 size 0x400 — Serial peripheral interface/Inter-IC sound
0x40013800 USART1 size 0x400 — Universal synchronous asynchronous receiver transmitter
0x40014400 TIM16 size 0x400 — General-purpose timers
0x40014800 TIM17 size 0x400 — General-purpose timers
0x40020000 DMA1 size 0x400 — Direct memory access controller
0x40020400 DMA2 size 0x400
0x40020800 DMAMUX size 0x400 — DMA request multiplexer
0x40023000 CRC size 0x400 — Cyclic redundancy check calculation unit
0x48000000 GPIOA size 0x400 — General-purpose I/Os
0x48000400 GPIOB size 0x400 — General-purpose I/Os
0x48000800 GPIOC size 0x400 — General-purpose I/Os
0x48001C00 GPIOH size 0x400 — General-purpose I/Os
0x58000000 RCC size 0x400 — Reset and clock control
0x58000400 PWR size 0x400 — Power control
0x58000800 EXTI size 0x400 — External interrupt/event controller
0x58000C00 IPCC size 0x400 — Inter Processor communication controller
0x58001000 RNG size 0x400 — True random number generator
0x58001400 HSEM size 0x400 — Hardware semaphore
0x58001800 AES size 0x400 — Advanced encryption standard hardware accelerator 1
0x58002000 PKA size 0x2000 — Public key accelerator
0x58004000 FLASH size 0x400
0x58004400 TZSC size 0x400 — Global TrustZone Controller
0x58004800 TZIC size 0x400 — TrustZone Interrupt Control
0x58010000 SPI3 size 0x400
0xE000E008 SCB_ACTRL size 0x5 — System control block ACTLR
0xE000E010 STK size 0x11 — SysTick timer
0xE000E100 NVIC size 0x355 — Nested Vectored Interrupt Controller
0xE000ED00 SCB size 0x41 — System control block
0xE000ED90 MPU size 0x15 — Memory protection unit
0xE000EF00 NVIC_STIR size 0x5 — Nested vectored interrupt controller

## Interrupts
0 TZIC_ILA (TZIC) — Security Interrupt controller illegal access interrupt
1 PVD_PVM_3 (EXTI) — PVD through EXTI[16], PVM[3] through EXTI[34]
2 TAMP_RTCSTAMP_LSECSS_RTCALARM_RTCSSRU_RTCWKUP (RTC) — Tamper, TimeStamp, LSECSS,alarm A and B,SSR underflow,RTC wakeup interrupt
3 FLASH_RCC_C1SEV (FLASH) — Flash memory global interrupt and Flash memory ECC single error interrupt,RCC global interrupt,CPU1 SEV through EXTI
4 EXTI1_0 (EXTI) — EXTI line 0 interrupt through EXTI
5 EXTI3_2 (EXTI) — EXTI line 1 interrupt through EXTI
6 EXTI15_4 (EXTI) — EXTI line 2 interrupt through EXTI
7 ADC_COMP_DAC (ADC) — ADC and DAC global interrupt,COMP1 and COMP2 interrupt through EXTI
8 DMA1_CH3_1 (DMA1) — DMA1 channel 3:1 secure and non-secure interrupt (C2IMR2[2:0])
9 DMA1_CH7_4 (DMA1) — DMA1 channel 7:4 secure and non-secure interrupt (C2IMR2[6:3])
10 DMA2_CH7_1_DMAMUX1_OVR (DMA2) — DMA2 channel 7:1 secure and non-secure interrupt (C2IMR2[14:8]),DMAMUX1 overrun interrupt (C2IMR2[15])
11 LPTIM1 — LPtimer 1 global interrupt
12 LPTIM2 — LPtimer 2 global interrupt
13 LPTIM3 — LPtimer 3 global interrupt
14 TIM1_BRK_TIM1_UP_TIM1_TRG_COM_TIM1_CC (TIM1) — Timer 1 break, update, trigger and communication,capture compare interrupt
15 TIM2 — Timer 2 global interrupt
16 TIM16 — Timer 16 global interrupt
17 TIM17 — Timer 17 global interrupt
18 IPCC_C2_RX_IT_IPCC_C2_TX_IT (IPCC) — IPCC CPU2 RX occupied interrupt, IPCC CPU2 TX free interrupt
19 HSEM — Semaphore interrupt 1 to CPU2
20 True_RNG (RNG) — True random number generator interrupt
21 AES_PKA (AES) — AES global interrupt , Private key accelerator interrupt
22 I2C1_EV_I2C1_ER (I2C1) — I2C1 event interrupt,I2C1 error interrupt
23 I2C2_EV_I2C2_ER (I2C2) — I2C2 event interrupt , I2C2 error interrupt
24 I2C3_EV_I2C3_ER (I2C3) — I2C3 event interrupt , I2C2 error interrupt
25 SPI1 — SPI 1 global interrupt
26 SPI2S2 (SPI2) — SPI2S2 global interrupt
27 USART1 — USART1 global interrupt
28 USART2 — USART2 global interrupt
29 LPUART1 (LPUART) — LPUART1 global interrupt
30 SUBGHZSPI (SPI3) — Sub-GHz radio SPI global interrupt
31 Radio_IRQ_Busy (EXTI) — Radio IRQs, RFBUSY interrupt through EXTI

## Notices in the file
Copyright (c) 2020 STMicroelectronics.
SPDX-License-Identifier: Apache-2.0
Licensed under the Apache License, Version 2.0 (the "License");
you may not use this file except in compliance with the License.
You may obtain a copy of the License at
http://www.apache.org/licenses/LICENSE-2.0
Unless required by applicable law or agreed to in writing, software
distributed under the License is distributed on an "AS IS" BASIS,
WITHOUT WARRANTIES OR CONDITIONS OF ANY KIND, either express or implied.
See the License for the specific language governing permissions and
limitations under the License.
