# RS14100 register map
File version: 1.0
RS1xxxx Cortex-M4 MCU
CPU: CM4 r0p1, little endian, MPU, FPU, 4 interrupt priority bits
Registers are 32-bit, read-write, reset 0x0 unless marked. A register's access mark holds for its fields unless they carry their own. Offsets are from the block's base; lines under a group give offsets from that group; [hi:lo] are bit positions; {n}, {i} and the like mark numbered series; 'fields as' and 'values as' point back to an identical list; <NAME> marks a mode.

## Memory map
0x12000000 QSPI size 0x128 — The queued serial peripheral interface module provides a serial peripheral interface with queued transfer capability
0x20240000 ETHERNET size 0x1058 — Ether MAC 10/100/1000 Universal enables a host to transmit and receive data over Ethernet in compliance with the IEEE 802.3-2002 standard
0x20480400 IID_RPINE size 0x2C
0x20480500 IID_AES size 0x100 — The AES module provides AES encoding and decoding functionality. It can be used in a microprocessor based environment
0x20480600 IID_QK size 0x100 — The purpose of Quiddikey is to provide secure key storage without storing the key.
0x21081084 RPDMA_G size 0x18 — RPDMAC is an AMBA complaint peripheral unit supports 8-channels
0x24040000 I2C2 size 0x100
0x24040400 I2S1 size 0x200
0x24040800 SSI2 size 0x100
0x24040C00 IR size 0x1C — IR Decoder are used for the decoding the external ir sensor input.
0x24041400 MCUULP_CLOCK size 0xA8 — The MCU ULP (Ultra Low Power) domain contains the MCU ULP AHB Inter-Connect-Matrix, MCU ULP Peripherals and the direct AHB Interface with the Processor. This section describes the different clock sources possible for each peripheral and the AHB/APB Interfaces.
0x24041800 ULP_UART size 0x100
0x24042000 TIMERS size 0x94 — TIMER can be used to generate various timing events for the software
0x24043000 UDMA1 size 0x82C
0x24043A00 COMPARATOR_1 size 0x8 — Analog comparators is a peripheral circuit that consists of two comparators, reference buffer, scaler and a resistor bank
0x24043A14 OPAMP size 0xC — The opamps top consists of 3 general purpose Operational Amplifiers (OPAMP) offering rail-to-rail inputs and outputs
0x24048000 ULTRA_LOW_POWER_DOMAINS size 0x14 — This is explain the Ultra low power domains peripherals registers.
0x24048100 SLEEP_FSM size 0x28 — This is explain the Sleep FSM registers.
0x24048200 TIMEPERIOD_CALIBRATION size 0x1C — In this the time periods of 32KHz RC clock, 32KHz RO clock and 32KHz XTAL clock can be calibrated
0x2404821C MCU_Calender blocks up to offset 0x44 — The MCU calender acts as RTC with time in seconds, minutes, hours, days, months, years and centuries
0x24048300 MCU_WDT size 0x1C — A dedicated window watch dog timer for MCU applications
0x24048400 POWER_DOMAINS blocks up to offset 0x90 — All the Applications, High Speed Interfaces and Peripherals are segregated into multiple power domains to achieve lower current consumption when they are inactive. At reset, all the domains are powered ON.
0x24048500 TEMPERATURE_SENSOR size 0x14 — The temperature sensor is used to read the temperature by using APB registers, which is access through direct to ULPSS system.
0x24048540 ProcessSensor blocks up to offset 0x44 — The process sensor module, count the process clock (high frequency ring clock) over one MCU FSM clock and divide this clock by programmable value.
0x2404C000 EGPIO1 size 0x1260
0x24070000 FIM size 0x24 — FIM support fixed point Multiplications implemented through programmable shifting.
0x44000000 USART0 size 0x100 — Universal Asynchronous Receiver/Transmitter is for serial communication with peripherals, modems and datasets
0x44000100 UART0 size 0x100
0x44010000 I2C0 size 0x100 — Inter Integrated Circuit(I2C) is programmable control bus that provides support for the communications link between integrated circuits in a system
0x44020000 SSI0 size 0x100 — Synchronous Serial Interface(SSI)
0x44030000 UDMA0 size 0x82C — DMA Performs data transfers along with Addresses and control information
0x45010000 SSI1 size 0x100
0x45020000 UART1 size 0x100
0x45030000 GSPI0 size 0x40 — GSPI, or Generic SPI, is a module which has been derived from QSPI. GSPI can act only as a master
0x45060000 SCT0 size 0xB0 — Configurable timer is used in counting clocks, events and states with reference clock external clock and system clock
0x45060100 SCT1 size 0xB0
0x45060200 SCT2 size 0xB0
0x45060300 SCT3 size 0xB0
0x4506F000 SCT_MUX_REG size 0x20 — Configurable timer is used in counting clocks, events and states with reference clock external clock and system clock
0x45070000 CAN0 size 0x1F — The DCAN is a standalone CAN (Controller Area Network) controller widely used in automotive and industrial applications.
0x45080000 CRC size 0x3C — CRC is used in all wireless communication as a first data integrity check
0x45090000 HWRNG size 0x8 — Random numbers generated are 16-bit random numbers and are generated using either the True random number generator or the Pseudo random number generator.
0x46000000 MCUHP_CLOCK size 0x5C — MCU HP (High Performance) domain contains the Cortex-M4F Processor, FPU, Debugger, MCU High Speed Interfaces, MCU HP Peripherals, MCU HP DMA and MCU/SZP shareable Interfaces
0x46008000 MCUHP_MISC_CLOCK size 0x48 — MCU HP (High Performance) domain contains the Cortex-M4F Processor, FPU, Debugger, MCU High Speed Interfaces, MCU HP Peripherals, MCU HP DMA and MCU/SZP shareable Interfaces
0x4600C000 EFUSE size 0x38 — The EFUSE controller is used to provide an interface to one time program memory (EFUSE macro) to perform write and read operations
0x46130000 EGPIO0 size 0x1260 — ENHANCED GENERAL PERPOSE INPUT/OUTPUT
0x46170000 CCI size 0x20C — CCI module helps external memories and peripherals to communicate with internal AHB bus with less number of pins
0x47000000 SIO size 0x2B0 — SERIAL GENERAL PERPOSE INPUT/OUTPUT
0x47040000 I2C1 size 0x100
0x47050000 I2S0 size 0x200 — I2S(Inter-IC Sound) is transferring two-channel digital audio data from one IC device to another
0x47060000 QEI size 0x50 — The Quadrature Encoder Interface (QEI) module provides the interface to incremental encoders for obtaining mechanical position data
0x47070000 MCPWM size 0x14C — The Motor Control PWM (MCPWM) controller is used to generate a periodic pulse waveform, which is useful in motor control and power control applications

## Interrupts
0 MCUHP_CLOCK
2 TIMER0 (TIMERS)
3 TIMER1 (TIMERS)
4 TIMER2 (TIMERS)
5 TIMER3 (TIMERS)
7 COMP2 (COMPARATOR_1)
8 COMP1 (COMPARATOR_1)
10 UDMA1
12 ULP_UART
13 I2C2
14 I2S1
16 SSI2
17 FIM
18 ULP_EGPIO_PIN (EGPIO1)
19 ULP_EGPIO_GROUP (EGPIO1)
20 NPSS_TO_MCU_WDT_INTR (MCU_WDT)
29 MCU_CAL_RTC (MCU_Calender)
31 RPDMA (RPDMA_G)
33 UDMA0
34 CT (SCT0)
37 SIO
38 USART0
39 UART1
40 CAN0
42 I2C0
43 I2S (I2S0)
44 SSI1
46 GSPI0
47 SSI0
48 MCPWM
49 QEI
50 EGPIO_GROUP_0 (EGPIO0)
51 EGPIO_GROUP_1 (EGPIO0)
{n+52} EGPIO_PIN_{n} (EGPIO0) (n=0..7)
60 QSPI
61 I2C1
62 ETHERNET
71 CCI
