# LPC55S06 register map
Vendor: nxp.com; File version: 1.0
CPU: CM33 r2p0, little endian, MPU, FPU, VTOR, 3 interrupt priority bits
Registers are 32-bit, read-write, reset 0x0 unless marked. A register's access mark holds for its fields unless they carry their own. Offsets are from the block's base; [hi:lo] are bit positions; {n}, {i} and the like mark numbered series; 'fields as' and 'values as' point back to an identical list.

## INPUTMUX — Input multiplexing (INPUT MUX)
Base 0x40006000
{0x0+4i} SCT0_INMUX[{i}] (i=0..6) reset 0x1F — Input mux register for SCT0 input
  [4:0] INP_N — Input number to SCT0 inputs 0 to 6..
    {v}=SCT_GPI{v} function selected from IOCON register (v=0..7); {v}=T{v-8}_OUT0 ctimer {v-8} match[0] output (v=8..12); 13=ADC_IRQ interrupt request from ADC; 14=GPIOINT_BMATCH; 15=None; 16=None; 17=COMP_OUTPUT output from analog comparator; 18=I2S_SHARED_SCK[0] output from I2S pin sharing; 19=I2S_SHARED_SCK[1] output from I2S pin sharing; 20=I2S_SHARED_WS[0] output from I2S pin sharing; 21=I2S_SHARED_WS[1] output from I2S pin sharing; 22=ARM_TXEV interrupt event from cpu0 or cpu1; 23=DEBUG_HALTED from cpu0 or cpu1; {v}=None (v=24..31)
{0x20+4i} TIMER0CAPTSEL[{i}] (i=0..3) reset 0x1F — Capture select registers for TIMER0 inputs
  [4:0] CAPTSEL — Input number to TIMER0 capture inputs 0 to 4
    {v}=CT_INP{v} function selected from IOCON register (v=0..16); {v}=None (v=17..21); 22=COMP_OUTPUT output from analog comparator; 23=I2S_SHARED_WS[0] output from I2S pin sharing; 24=I2S_SHARED_WS[1] output from I2S pin sharing; {v}=None (v=25..31)
{0x40+4i} TIMER1CAPTSEL[{i}] (i=0..3) reset 0x1F — Capture select registers for TIMER1 inputs
  [4:0] CAPTSEL — Input number to TIMER1 capture inputs 0 to 4
    values as TIMER0CAPTSEL[0].CAPTSEL
{0x60+4i} TIMER2CAPTSEL[{i}] (i=0..3) reset 0x1F — Capture select registers for TIMER2 inputs
  [4:0] CAPTSEL — Input number to TIMER2 capture inputs 0 to 4
    values as TIMER0CAPTSEL[0].CAPTSEL
{0xC0+4i} PINTSEL[{i}] (i=0..7) reset 0x7F — Pin interrupt select register
  [6:0] INTPIN — Pin number select for pin interrupt or pattern match engine input. For PIOx_y: INTPIN = (x * 32) + y. PIO0_0 to PIO1_31 correspond to numbers 0 to 63.
{0xE0+4i} DMA0_ITRIG_INMUX[{i}] (i=0..22) reset 0x1F — Trigger select register for DMA0 channel
  [4:0] INP — Trigger input number (decimal value) for DMA channel n (n = 0 to 22).
    {v}=Pin interrupt {v} (v=0..3); 4=Timer CTIMER0 Match 0; 5=Timer CTIMER0 Match 1; 6=Timer CTIMER1 Match 0; 7=Timer CTIMER1 Match 1; 8=Timer CTIMER2 Match 0; 9=Timer CTIMER2 Match 1; 10=Timer CTIMER3 Match 0; 11=Timer CTIMER3 Match 1; 12=Timer CTIMER4 Match 0; 13=Timer CTIMER4 Match 1; 14=COMP_OUTPUT; 15=DMA0 output trigger mux 0; 16=DMA0 output trigger mux 1; 17=DMA0 output trigger mux 1; 18=DMA0 output trigger mux 3; 19=SCT0 DMA request 0; 20=SCT0 DMA request 1; 21=HASH DMA RX trigger; {v}=None (v=22..31)
{0x160+4i} DMA0_OTRIG_INMUX[{i}] (i=0..3) reset 0x1F — DMA0 output trigger selection to become DMA0 trigger
  [4:0] INP — DMA trigger output number (decimal value) for DMA channel n (n = 0 to 22).
0x180 FREQMEAS_REF reset 0x1F — Selection for frequency measurement reference clock
  [4:0] CLKIN — Clock source number (decimal value) for frequency measure function reference clock:
    0=External main crystal oscilator (Clock_in); 1=FRO 12MHz clock; 2=FRO 96MHz clock; 3=Watchdog oscillator / FRO1MHz clock; 4=32 kHz oscillator (32k_clk) clock; 5=main clock (main_clock); 6=FREQME_GPIO_CLK_A; 7=FREQME_GPIO_CLK_B
0x184 FREQMEAS_TARGET reset 0x1F — Selection for frequency measurement target clock
  [4:0] CLKIN — Clock source number (decimal value) for frequency measure function target clock:
    values as FREQMEAS_REF.CLKIN
{0x1A0+4i} TIMER3CAPTSEL[{i}] (i=0..3) reset 0x1F — Capture select registers for TIMER3 inputs
  [4:0] CAPTSEL — Input number to TIMER3 capture inputs 0 to 4
    values as TIMER0CAPTSEL[0].CAPTSEL
{0x1C0+4i} TIMER4CAPTSEL[{i}] (i=0..3) reset 0x1F — Capture select registers for TIMER4 inputs
  [4:0] CAPTSEL — Input number to TIMER4 capture inputs 0 to 4
    values as TIMER0CAPTSEL[0].CAPTSEL
{0x1E0+4i} PINTSECSEL[{i}] (i=0..1) reset 0x3F — Pin interrupt secure select register
  [5:0] INTPIN — Pin number select for pin interrupt secure or pattern match engine input. For PIO0_x: INTPIN = x. PIO0_0 to PIO0_31 correspond to numbers 0 to 31.
{0x200+4i} DMA1_ITRIG_INMUX[{i}] (i=0..9) reset 0xF — Trigger select register for DMA1 channel
  [3:0] INP — Trigger input number (decimal value) for DMA channel n (n = 0 to 9).
    {v}=Pin interrupt {v} (v=0..3); 4=Timer CTIMER0 Match 0; 5=Timer CTIMER0 Match 1; 6=Timer CTIMER2 Match 0; 7=Timer CTIMER4 Match 0; {v}=DMA1 output trigger mux {v-8} (v=8..11); 12=SCT0 DMA request 0; 13=SCT0 DMA request 1; 14=HASH DMA RX trigger; 15=None
{0x240+4i} DMA1_OTRIG_INMUX[{i}] (i=0..3) reset 0xF — DMA1 output trigger selection to become DMA1 trigger
  [3:0] INP — DMA trigger output number (decimal value) for DMA channel n (n = 0 to 9).
0x740 DMA0_REQ_ENA reset 0x7FFFFF — Enable DMA0 requests
  [22:0] REQ_ENA — Controls the 23 request inputs of DMA0. If bit i is '1' the DMA request input #i is enabled.
    0=Hash-Crypt DMA request; 2=High Speed SPI (Flexcomm 8) RX; 3=High Speed SPI (Flexcomm 8) TX; 4=Flexcomm Interface 0 RX / I2C Slave; 5=Flexcomm Interface 0 TX / I2C Master; 6=Flexcomm Interface 1 RX / I2C Slave; 7=Flexcomm Interface 1 TX / I2C Master; 8=Flexcomm Interface 3 RX / I2C Slave; 9=Flexcomm Interface 3 TX / I2C Master; 10=Flexcomm Interface 2 RX / I2C Slave; 11=Flexcomm Interface 2 TX / I2C Master; 12=Flexcomm Interface 4 RX / I2C Slave; 13=Flexcomm Interface 4 TX / I2C Master; 14=Flexcomm Interface 5 RX / I2C Slave; 15=Flexcomm Interface 5 TX / I2C Master; 16=Flexcomm Interface 6 RX / I2C Slave; 17=Flexcomm Interface 6 TX / I2C Master; 18=Flexcomm Interface 7 RX / I2C Slave; 19=Flexcomm Interface 6 TX / I2C Master; 21=ADC0 FIFO 0; 22=ADC0 FIFO 1
0x748 DMA0_REQ_ENA_SET wo — Set one or several bits in DMA0_REQ_ENA register
  [22:0] SET — Write : If bit #i = 1, bit #i in DMA0_REQ_ENA register is set to 1; if bit #i = 0 , no change in DMA0_REQ_ENA register
0x750 DMA0_REQ_ENA_CLR wo — Clear one or several bits in DMA0_REQ_ENA register
  [22:0] CLR — Write : If bit #i = 1, bit #i in DMA0_REQ_ENA register is reset to 0; if bit #i = 0 , no change in DMA0_REQ_ENA register
0x760 DMA1_REQ_ENA reset 0x3FF — Enable DMA1 requests
  [9:0] REQ_ENA — Controls the 10 request inputs of DMA1. If bit i is '1' the DMA request input #i is enabled.
    0=Hash-Crypt input DMA request; 2=High Speed SPI (Flexcomm 8) RX; 3=High Speed SPI (Flexcomm 8) TX; 4=Flexcomm Interface 0 RX /I2C Slave; 5=Flexcomm Interface 0 TX / I2C Master; 6=Flexcomm Interface 1 RX /I2C Slave; 7=Flexcomm Interface 1 TX / I2C Master; 8=Flexcomm Interface 3 RX / I2C Slave; 9=Flexcomm Interface 3 TX / I2C Master
0x768 DMA1_REQ_ENA_SET wo — Set one or several bits in DMA1_REQ_ENA register
  [9:0] SET — Write : If bit #i = 1, bit #i in DMA1_REQ_ENA register is set to 1; if bit #i = 0 , no change in DMA1_REQ_ENA register
0x770 DMA1_REQ_ENA_CLR wo — Clear one or several bits in DMA1_REQ_ENA register
  [9:0] CLR — Write : If bit #i = 1, bit #i in DMA1_REQ_ENA register is reset to 0; if bit #i = 0 , no change in DMA1_REQ_ENA register
0x780 DMA0_ITRIG_ENA reset 0x3FFFFF — Enable DMA0 triggers
  [21:0] ITRIG_ENA — Controls the 22 trigger inputs of DMA0. If bit i is '1' the DMA trigger input #i is enabled.
0x788 DMA0_ITRIG_ENA_SET wo — Set one or several bits in DMA0_ITRIG_ENA register
  [21:0] SET — Write : If bit #i = 1, bit #i in DMA0_ITRIG_ENA register is set to 1; if bit #i = 0 , no change in DMA0_ITRIG_ENA register
0x790 DMA0_ITRIG_ENA_CLR wo — Clear one or several bits in DMA0_ITRIG_ENA register
  [21:0] CLR — Write : If bit #i = 1, bit #i in DMA0_ITRIG_ENA register is reset to 0; if bit #i = 0 , no change in DMA0_ITRIG_ENA register
0x7A0 DMA1_ITRIG_ENA reset 0x7FFF — Enable DMA1 triggers
  [14:0] ITRIG_ENA — Controls the 15 trigger inputs of DMA1. If bit i is '1' the DMA trigger input #i is enabled.
0x7A8 DMA1_ITRIG_ENA_SET wo — Set one or several bits in DMA1_ITRIG_ENA register
  [14:0] SET — Write : If bit #i = 1, bit #i in DMA1_ITRIG_ENA register is set to 1; if bit #i = 0 , no change in DMA1_ITRIG_ENA register
0x7B0 DMA1_ITRIG_ENA_CLR wo — Clear one or several bits in DMA1_ITRIG_ENA register
  [14:0] CLR — Write : If bit #i = 1, bit #i in DMA1_ITRIG_ENA register is reset to 0; if bit #i = 0 , no change in DMA1_ITRIG_ENA register
