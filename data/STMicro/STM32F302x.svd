# STM32F302x register map
File version: 1.1
Registers are 32-bit, read-write, reset 0x0 unless marked. A register's access mark holds for its fields unless they carry their own. Offsets are from the block's base; lines under a group give offsets from that group; [hi:lo] are bit positions; {n}, {i} and the like mark numbered series; 'fields as' and 'values as' point back to an identical list; <NAME> marks a mode.

## Memory map
0x40000000 TIM2 size 0x400 — General purpose timer
0x40001000 TIM6 size 0x400 — Basic timers
0x40002800 RTC size 0x400 — Real-time clock
0x40002C00 WWDG size 0x400 — Window watchdog
0x40003000 IWDG size 0x400 — Independent watchdog
0x40003400 I2S2ext size 0x400
0x40003800 SPI2 size 0x400 — Serial peripheral interface/Inter-IC2
0x40003C00 SPI3 size 0x400
0x40004000 I2S3ext size 0x400
0x40004400 USART2 size 0x400
0x40004800 USART3 size 0x400
0x40005400 I2C1 size 0x400 — Inter-integrated circuit
0x40005800 I2C2 size 0x400
0x40005C00 USB_FS size 0x400 — Universal serial bus full-speed device interface
0x40006400 CAN size 0x400 — Controller area network
0x40007000 PWR size 0x400 — Power control
0x40007400 DAC size 0x400 — Digital-to-analog converter
0x40007800 I2C3 size 0x400
0x40010000 SYSCFG size 0x1C — System configuration controller
0x4001001C COMP size 0x19 — Comparator
0x40010038 OPAMP size 0x3C8 — Operational amplifier
0x40010400 EXTI size 0x400 — External interrupt/event controller
0x40012C00 TIM1 size 0x400 — Advanced timer
0x40013800 USART1 size 0x400 — Universal synchronous asynchronous receiver-transmitter
0x40014000 TIM15 size 0x400 — General purpose timers
0x40014400 TIM16 size 0x400 — General-purpose-timers
0x40014800 TIM17 size 0x400 — General purpose timer
0x40020000 DMA1 size 0x400 — DMA controller 1
0x40021000 RCC size 0x400 — Reset and clock control
0x40022000 Flash size 0x400
0x40023000 CRC size 0x400 — cyclic redundancy check calculation unit
0x40024000 TSC size 0x400 — Touch sensing controller
0x48000000 GPIOA size 0x400 — General-purpose I/Os
0x48000400 GPIOB size 0x400 — General-purpose I/Os
0x48000800 GPIOC size 0x400 — General-purpose I/Os
0x48000C00 GPIOD size 0x400
0x48001400 GPIOF size 0x400
0x50000000 ADC1 size 0x400 — Analog-to-Digital Converter
0x50000300 ADC1_2 size 0xD — Analog-to-Digital Converter
0x50000700 ADC3_4 size 0xD
0xE000E000 NVIC size 0x1001 — Nested Vectored Interrupt Controller
0xE000ED88 FPU size 0x200 — Floting point unit
0xE0042000 DBGMCU size 0x400 — Debug support

## Interrupts
0 WWDG (DBGMCU) — Window Watchdog interrupt
1 PVD (WWDG) — PVD through EXTI line detection interrupt
2 TAMP_STAMP (I2C2, I2C3) — Tamper and TimeStamp interrupts
3 RTC_WKUP (TIM1) — RTC Wakeup interrupt through the EXTI line
4 FLASH (Flash) — Flash global interrupt
5 RCC — RCC global interrupt
6 EXTI0 (I2C2, I2C3) — EXTI Line0 interrupt
7 EXTI1 (I2C2, I2C3) — EXTI Line3 interrupt
8 EXTI2_TSC (TSC, I2C2, I2C3) — EXTI Line2 and Touch sensing interrupts
9 EXTI3 (I2C2, I2C3) — EXTI Line3 interrupt
10 EXTI4 (I2C2, I2C3) — EXTI Line4 interrupt
11 DMA1_CH1 (DMA1) — DMA1 channel 1 interrupt
12 DMA1_CH2 (DMA1) — DMA1 channel 2 interrupt
13 DMA1_CH3 (DMA1) — DMA1 channel 3 interrupt
14 DMA1_CH4 (DMA1) — DMA1 channel 4 interrupt
15 DMA1_CH5 (DMA1) — DMA1 channel 5 interrupt
16 DMA1_CH6 (DMA1) — DMA1 channel 6 interrupt
17 DMA1_CH7 (DMA1) — DMA1 channel 7interrupt
19 USB_HP_CAN_TX (RTC) — USB High Priority/CAN_TX interrupts
20 USB_LP_CAN_RX0 (RTC) — USB Low Priority/CAN_RX0 interrupts
21 CAN_RX1 (RTC) — CAN_RX1 interrupt
22 CAN_SCE (RTC) — CAN_SCE interrupt
23 EXTI9_5 (I2C2, I2C3) — EXTI Line5 to Line9 interrupts
24 TIM1_BRK_TIM15 (USART1) — TIM1 Break/TIM15 global interruts
25 TIM1_UP_TIM16 (USART2) — TIM1 Update/TIM16 global interrupts
26 TIM1_TRG_COM_TIM17 (USART3) — TIM1 trigger and commutation/TIM17 interrupts
28 TIM2 (TIM15) — TIM2 global interrupt
29 TIM3 (TIM16) — TIM3 global interrupt
30 TIM4 (TIM17) — TIM4 global interrupt
31 I2C1_EV_EXTI23 (I2C2, I2C3, DAC) — I2C1 event interrupt and EXTI Line23 interrupt
32 I2C1_ER (DAC) — I2C1 error interrupt
33 I2C2_EV_EXTI24 (NVIC) — I2C2 event interrupt & EXTI Line24 interrupt
34 I2C2_ER (NVIC) — I2C2 error interrupt
35 SPI1 (COMP) — SPI1 global interrupt
36 SPI2 (PWR) — SPI2 global interrupt
37 USART1_EXTI25 (SPI2, I2C2, I2C3) — USART1 global interrupt and EXTI Line 25 interrupt
38 USART2_EXTI26 (SPI3, I2C2, I2C3) — USART2 global interrupt and EXTI Line 26 interrupt
39 USART3_EXTI28 (I2S2ext, I2C2, I2C3) — USART3 global interrupt and EXTI Line 28 interrupt
40 EXTI15_10 (I2C2, I2C3) — EXTI Line15 to Line10 interrupts
41 RTCAlarm (TIM1) — RTC alarm interrupt
42 USB_WKUP (TIM6) — USB wakeup from Suspend
51 SPI3 (CAN) — SPI3 global interrupt
52 UART4_EXTI34 (I2S3ext, I2C2, I2C3) — UART4 global and EXTI Line 34 interrupts
53 UART5_EXTI35 (EXTI, I2C2, I2C3) — UART5 global and EXTI Line 35 interrupts
54 TIM6_DACUNDER (ADC1, OPAMP) — TIM6 global and DAC12 underrun interrupts
55 TIM7 (SYSCFG) — TIM7 global interrupt
56 DMA2_CH1 (TIM2) — DMA2 channel1 global interrupt
57 DMA2_CH2 (TIM2) — DMA2 channel2 global interrupt
58 DMA2_CH3 (TIM2) — DMA2 channel3 global interrupt
59 DMA2_CH4 (TIM2) — DMA2 channel4 global interrupt
60 DMA2_CH5 (TIM2) — DMA2 channel5 global interrupt
64 COMP123 (IWDG) — COMP1 & COMP2 & COMP3 interrupts combined with EXTI Lines 21, 22 and 29 interrupts
65 COMP456 (IWDG) — COMP4 & COMP5 & COMP6 interrupts combined with EXTI Lines 30, 31 and 32 interrupts
66 COMP7 (IWDG) — COMP7 interrupt combined with EXTI Line 33 interrupt
74 USB_HP (TIM6) — USB High priority interrupt
75 USB_LP (TIM6) — USB Low priority interrupt
76 USB_WKUP_EXTI (I2C2, I2C3) — USB wakeup from Suspend and EXTI Line 18
