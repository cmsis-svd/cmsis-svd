# STM32WL5x_CM4 register map
File version: 1.9
CPU: CM4 r0p1, little endian, MPU, FPU, 4 interrupt priority bits
Registers are 32-bit, read-write, reset 0x0 unless marked. A register's access mark holds for its fields unless they carry their own. Offsets are from the block's base; lines under a group give offsets from that group; [hi:lo] are bit positions; {n}, {i} and the like mark numbered series; 'fields as' and 'values as' point back to an identical list; <NAME> marks a mode.

## Memory map
0x40000000 TIM2 size 0x400 — General-purpose-timers
0x40002800 RTC size 0x400 — Real-time clock
0x40002C00 WWDG size 0x400 — System window watchdog
0x40003000 IWDG size 0x400 — Independent watchdog
0x40003800 SPI2 size 0x400
0x40004400 USART2 size 0x400
0x40005400 I2C1 size 0x400 — Inter-integrated circuit
0x40005800 I2C2 size 0x400
0x40005C00 I2C3 size 0x400
0x40007400 DAC size 0x400 — Digital-to-analog converter
0x40007C00 LPTIM1 size 0x400 — Low-power timer
0x40008000 LPUART size 0x400 — Universal synchronous asynchronous receiver transmitter
0x40009400 LPTIM2 size 0x400 — Low-power timer
0x40009800 LPTIM3 size 0x400 — Low-power timer
0x4000B000 TAMP size 0x400 — Tamper and backup registers
0x40010000 SYSCFG size 0x30 — System configuration controller
0x40010030 VREFBUF size 0xD0 — Voltage reference buffer
0x40010100 SYSCFG_continue size 0x100 — System configuration controller
0x40010200 COMP size 0x200 — Comparator
0x40012400 ADC size 0x400 — Analog to digital convertor
0x40012C00 TIM1 size 0x400 — Advanced-control timers
0x40013000 SPI1 size 0x400 — Serial peripheral interface/Inter-IC sound
0x40013800 USART1 size 0x400 — Universal synchronous asynchronous receiver transmitter
0x40014400 TIM16 size 0x400 — General-purpose timers
0x40014800 TIM17 size 0x400 — General-purpose timers
0x40020000 DMA1 size 0x400 — Direct memory access controller
0x40020400 DMA2 size 0x400
0x40020800 DMAMUX size 0x400 — DMA request multiplexer
0x40023000 CRC size 0x400 — Cyclic redundancy check calculation unit
0x48000000 GPIOA size 0x400 — General-purpose I/Os
0x48000400 GPIOB size 0x400 — General-purpose I/Os
0x48000800 GPIOC size 0x400 — General-purpose I/Os
0x48001C00 GPIOH size 0x400 — General-purpose I/Os
0x58000000 RCC size 0x400 — Reset and clock control
0x58000400 PWR size 0x400 — Power control
0x58000800 EXTI size 0x400 — External interrupt/event controller
0x58000C00 IPCC size 0x400 — Inter Processor communication controller
0x58001000 RNG size 0x400 — True random number generator
0x58001400 HSEM size 0x400 — Hardware semaphore
0x58001800 AES size 0x400 — Advanced encryption standard hardware accelerator 1
0x58002000 PKA size 0x2000 — Public key accelerator
0x58004000 FLASH size 0x400
0x58004400 TZSC size 0x400 — Global TrustZone Controller
0x58004800 TZIC size 0x400 — TrustZone Interrupt Control
0x58010000 SPI3 size 0x400
0xE000E008 SCB_ACTRL size 0x5 — System control block ACTLR
0xE000E010 STK size 0x11 — SysTick timer
0xE000E100 NVIC size 0x355 — Nested Vectored Interrupt Controller
0xE000ED00 SCB size 0x41 — System control block
0xE000ED90 MPU size 0x15 — Memory protection unit
0xE000EF00 NVIC_STIR size 0x5 — Nested vectored interrupt controller
0xE0042000 DBGMCU size 0x400 — Microcontroller Debug Unit

## Interrupts
0 WWDG — Window watchdog early wakeup interrupt
1 PVD_PVM_3 (EXTI) — PVD through EXTI[16], PVM[3] through EXTI[34]
2 TAMP_RTCSTAMP_LSECSS_RTCSSRU (RTC) — Tamper, TimeStamp, LSECSS,RTC_SSRU interrupt
3 RTC_WKUP (RTC) — RTC wakeup interrupt
4 FLASH — Flash memory global interrupt and Flash memory ECC single error interrupt
5 RCC — RCC global interrupt
6 EXTI0 (EXTI) — EXTI line 0 interrupt through EXTI
7 EXTI1 (EXTI) — EXTI line 1 interrupt through EXTI
8 EXTI2 (EXTI) — EXTI line 2 interrupt through EXTI
9 EXTI3 (EXTI) — EXTI line 3 interrupt through EXTI
10 EXTI4 (EXTI) — EXTI line 4 interrupt through EXTI
11 DMA1_CH1 (DMA1) — DMA1 channel 1 non-secure interrupt
12 DMA1_CH2 (DMA1) — DMA1 channel 2 non-secure interrupt
13 DMA1_CH3 (DMA1) — DMA1 channel 3 non-secure interrupt
14 DMA1_CH4 (DMA1) — DMA1 channel 4 non-secure interrupt
15 DMA1_CH5 (DMA1) — DMA1 channel 5 non-secure interrupt
16 DMA1_CH6 (DMA1) — DMA1 channel 6 non-secure interrupt
17 DMA1_CH7 (DMA1) — DMA1 channel 7 non-secure interrupt
18 ADC — ADC global interrupt
19 DAC — DAC global interrupt
20 PWR_C2H_C2SEV (PWR) — PWR CPU2 HOLD wakeup interrupt ,CPU2 SEV through EXTI
21 COMP — COMP2 and COMP1 interrupt through EXTI[22:21]
22 EXTI9_5 (EXTI) — EXTI line 9_5 interrupt through EXTI
23 TIM1_BRK (TIM1) — Timer 1 break interrupt
24 TIM1_UP (TIM1) — Timer 1 Update
25 TIM1_TRG_COM (TIM1) — Timer 1 trigger and communication
26 TIM1_CC (TIM1) — Timer 1 capture compare interrupt
27 TIM2 — Timer 2 global interrupt
28 TIM16 — Timer 16 global interrupt
29 TIM17 — Timer 17 global interrupt
30 I2C1_EV (I2C1) — I2C1 event interrupt
31 I2C1_ER (I2C1) — I2C1 event interrupt
32 I2C2_EV (I2C2) — I2C2 event interrupt
33 I2C2_ER (I2C2) — I2C2 error interrupt
34 SPI1 — SPI 1 global interrupt
35 SPI2S2 (SPI2) — SPI2S2 global interrupt
36 USART1 — USART1 global interrupt
37 USART2 — USART2 global interrupt
38 LPUART1 (LPUART) — LPUART1 global interrupt
39 LPTIM1 — LPtimer 1 global interrupt
40 LPTIM2 — LPtimer 2 global interrupt
41 EXTI15_10 (EXTI) — EXTI line 15_10] interrupt through EXTI
42 RTC_ALARM (RTC) — RTC alarms A and B interrupt
43 LPTIM3 — LPtimer 3 global interrupt
44 SUBGHZSPI (SPI3) — Sub-GHz radio SPI global interrupt
45 IPCC_C1_RX_IT (IPCC) — IPCC CPU1 RX occupied interrupt
46 IPCC_C1_TX_IT (IPCC) — IPCC CPU1 TX free interrupt
47 HSEM — Semaphore interrupt 0 to CPU1
48 I2C3_EV (I2C3) — I2C3 event interrupt
49 I2C3_ER (I2C3) — I2C3 error interrupt
50 Radio_IRQ_Busy (EXTI) — Radio IRQs, RFBUSY interrupt through EXTI
51 AES — AES global interrupt
52 True_RNG (RNG) — True random number generator interrupt
53 PKA — Private key accelerator interrupt
54 DMA2_CH1 (DMA2) — DMA2 channel 1 non-secure interrupt
55 DMA2_CH2 (DMA2) — DMA2 channel 2 non-secure interrupt
56 DMA2_CH3 (DMA2) — DMA2 channel 3 non-secure interrupt
57 DMA2_CH4 (DMA2) — DMA2 channel 4 non-secure interrupt
58 DMA2_CH5 (DMA2) — DMA2 channel 5 non-secure interrupt
59 DMA2_CH6 (DMA2) — DMA2 channel 6 non-secure interrupt
60 DMA2_CH7 (DMA2) — DMA2 channel 7 non-secure interrupt
61 DMAMUX1_OVR (DMAMUX) — DMAMUX1 overrun interrupt

## Notices in the file
Copyright (c) 2020 STMicroelectronics.
SPDX-License-Identifier: Apache-2.0
Licensed under the Apache License, Version 2.0 (the "License");
you may not use this file except in compliance with the License.
You may obtain a copy of the License at
http://www.apache.org/licenses/LICENSE-2.0
Unless required by applicable law or agreed to in writing, software
distributed under the License is distributed on an "AS IS" BASIS,
WITHOUT WARRANTIES OR CONDITIONS OF ANY KIND, either express or implied.
See the License for the specific language governing permissions and
limitations under the License.
