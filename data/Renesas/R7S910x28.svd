# R7S910x28 register map
Vendor: Renesas Electronics Corporation; Series: RZT; File version: 1.0
CPU: other r1p4, little endian, MPU, FPU, vendor SysTick, 1 interrupt priority bits
Registers are 32-bit, read-write, no defined reset value unless marked. A register's access mark holds for its fields unless they carry their own. Offsets are from the block's base; [hi:lo] are bit positions; lines under a group give offsets from that group; {n}, {i} and the like mark numbered series.

## RIIC0 — I2C Bus Interface
Base 0xA0080900; register names take the prefix RIIC0_
0x00 ICCR1 8-bit — I2C bus control register 1
0x01 ICCR2 8-bit — I2C bus control register 2
{0x1+i} ICMR{i} 8-bit (i=1..3) — I2C bus mode register {i}
0x05 ICFER 8-bit — I2C bus function enable register
0x06 ICSER 8-bit — I2C bus status enable register
0x07 ICIER 8-bit — I2C bus interrupt enable register
0x08 ICSR1 8-bit — I2C bus status register 1
0x09 ICSR2 8-bit — I2C bus status register 2
{0xA+2i} ICSARL{i} 8-bit (i=0..2) — slave address register L{i}
{0xB+2i} ICSARU{i} 8-bit (i=0..2) — slave address register U{i}
0x10 ICBRL 8-bit — I2C bus bitrate low register
0x11 ICBRH 8-bit — I2C bus bitrate high register
0x12 ICDRT 8-bit — I2C bus transmit data register
0x13 ICDRR 8-bit ro — I2C bus receive data register

## RIIC1 — I2C Bus Interface
Base 0xA0080940; register names take the prefix RIIC1_
Registers as RIIC0.

## TSN — Temperature sensor
Base 0xA0080A00; register names take the prefix TSN_
0x00 TSCR 8-bit — Temperature sensor control register

## ELC — Event link controller
Base 0xA0080B00; register names take the prefix ELC_
0x00 ELCR 8-bit — Event link control register
0x01 ELSR0 8-bit — Event link setting register 0
0x04 ELSR3 8-bit — Event link setting register 3
0x05 ELSR4 8-bit — Event link setting register 4
0x08 ELSR7 8-bit — Event link setting register 7
{0x1+i} ELSR{i} 8-bit (i=10..13) — Event link setting register {i}
0x10 ELSR15 8-bit — Event link setting register 15
{0x1+i} ELSR{i} 8-bit (i=18..27) — Event link setting register {i}
0x1F ELOPA 8-bit — Event link option setting register A
0x20 ELOPB 8-bit — Event link option setting register B
0x21 ELOPC 8-bit — Event link option setting register C
0x22 ELOPD 8-bit — Event link option setting register D
0x23 PGR1 8-bit — Port group setting register 1
0x24 PGR2 8-bit — Port group setting register 2
0x25 PGC1 8-bit — Port group control register 1
0x26 PGC2 8-bit — Port group control register 2
0x27 PDBF1 8-bit — Port buffer register 1
0x28 PDBF2 8-bit — Port buffer register 2
{0x29+i} PEL{i} 8-bit (i=0..3) — Event link port setting register {i}
0x2D ELSEGR 8-bit — Event link software event generation register
0x31 ELSR33 8-bit — Event link setting register 33
{0x10+i} ELSR{i} 8-bit (i=35..38) — Event link setting register {i}
{0x10+i} ELSR{i} 8-bit (i=41..45) — Event link setting register {i}
0x3F ELOPF 8-bit — Event link option setting register F
0x41 ELOPH 8-bit — Event link option setting register H
0x42 ELOPI 8-bit — Event link option setting register I
0x43 ELOPJ 8-bit — Event link option setting register J

## SSI — Serial sound interface
Base 0xA0081000; register names take the prefix SSI_
0x00 SSICR — Control register
0x04 SSISR — Status register
0x10 SSIFCR — FIFO control register
0x14 SSIFSR — FIFO status register
0x18 SSIFTDR wo — Transmit FIFO data register
0x1C SSIFRDR ro — Receive FIFO data register
0x20 SSITDMR — TDM mode register

## DOC — Data operation circuit
Base 0xA0081200; register names take the prefix DOC_
0x00 DOCR 8-bit — DOC control register
0x02 DODIR 16-bit — DOC data input register
0x04 DODSR 16-bit — DOC data setting register

## S12ADC0 — 12-Bit A/D Converter 0
Base 0xA008C000; register names take the prefix S12ADC0_
0x00 ADCSR 16-bit — A/D control register
0x04 ADANSA 16-bit — A/D channel select register A
0x08 ADADS 16-bit — A/D conversion value addition/average mode select register
0x0C ADADC 8-bit — A/D conversion value addition/average number select register
0x0E ADCER 16-bit — A/D control extended register
0x10 ADSTRGR 16-bit — A/D start trigger select register
0x12 ADEXICR 16-bit — A/D conversion extended input control register
0x14 ADANSB 16-bit — A/D channel select register B
0x18 ADDBLDR 16-bit ro — A/D data duplicate register
0x1A ADTSDR 16-bit ro — A/D temperature sensor data register
0x1E ADRD 16-bit ro — A/D self-diagnostic data register
{0x20+2i} ADDR{i} 16-bit ro (i=0..7) — A/D data register {i}
0x60 ADSSTR0 8-bit — A/D sampling state register 0
0x66 ADSHCR 16-bit — A/D sampling state register control register
0x70 ADSSTRT 8-bit — A/D sampling state register T
{0x72+i} ADSSTR{i} 8-bit (i=1..7) — A/D sampling state register {i}
0x7A ADDISCR 8-bit — A/D disconnection detect control register
0x80 ADGSPCR 16-bit — A/D group scan priority control register
0x84 ADDBLDRA 16-bit ro — A/D data duplicate register A
0x86 ADDBLDRB 16-bit ro — A/D data duplicate register B
0x90 ADCMPCR 8-bit — A/D compare control register
0x92 ADCMPANSER 8-bit — A/D compare channel select extended register
0x93 ADCMPLER 8-bit — A/D compare level extended register
0x94 ADCMPANSR 16-bit — A/D compare channel select register
0x98 ADCMPLR 16-bit — A/D compare level register
0x9C ADCMPDR0 16-bit — A/D compare data register 0
0x9E ADCMPDR1 16-bit — A/D compare data register 1
0xA0 ADCMPSR 16-bit — A/D compare status register
0xA4 ADCMPSER 8-bit — A/D compare status extended register
0xC8 ADTDCR 8-bit — A/D pin level self-diagnosis control register
0xCA ADERCR 8-bit — A/D error control register
0xCB ADERCLR 8-bit wo — A/D error clear register
0xD2 ADOWER 16-bit ro — A/D overwrite error register
0xD6 ADOWEER 16-bit ro — A/D overwrite error extended register

## S12ADC1 — 12-Bit A/D Converter 1
Base 0xA008C400; register names take the prefix S12ADC1_
Registers as S12ADC0, without ADTSDR, ADSHCR, ADSSTRT, ADCMPANSER, ADCMPLER, ADCMPSER; these are added or differ:
{0x20+2i} ADDR{i} 16-bit ro (i=8..15) — A/D data register {i}
0x61 ADSSTRL 8-bit — A/D sampling state register L
