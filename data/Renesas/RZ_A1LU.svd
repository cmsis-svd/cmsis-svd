# RZ_A1LU register map
Vendor: Renesas Electronics Corporation.; Series: RZ; File version: 3
CPU: other r3p0, little endian, MPU, no FPU, 3 interrupt priority bits
Registers are 32-bit, read-write, no defined reset value unless marked. A register's access mark holds for its fields unless they carry their own. Offsets are from the block's base; [hi:lo] are bit positions; {n}, {i} and the like mark numbered series.

## SCIF1
Base 0xE8007800
0x00 SCSMR_1 16-bit
0x04 SCBRR_1 8-bit
0x08 SCSCR_1 16-bit
0x0C SCFTDR_1 8-bit
0x10 SCFSR_1 16-bit
0x14 SCFRDR_1 8-bit
0x18 SCFCR_1 16-bit
0x1C SCFDR_1 16-bit
0x20 SCSPTR_1 16-bit
0x24 SCLSR_1 16-bit
0x28 SCEMR_1 16-bit

## SCIF2
Base 0xE8008000
0x00 SCSMR_2 16-bit
0x04 SCBRR_2 8-bit
0x08 SCSCR_2 16-bit
0x0C SCFTDR_2 8-bit
0x10 SCFSR_2 16-bit
0x14 SCFRDR_2 8-bit
0x18 SCFCR_2 16-bit
0x1C SCFDR_2 16-bit
0x20 SCSPTR_2 16-bit
0x24 SCLSR_2 16-bit
0x28 SCEMR_2 16-bit

## SCIF3
Base 0xE8008800
0x00 SCSMR_3 16-bit
0x04 SCBRR_3 8-bit
0x08 SCSCR_3 16-bit
0x0C SCFTDR_3 8-bit
0x10 SCFSR_3 16-bit
0x14 SCFRDR_3 8-bit
0x18 SCFCR_3 16-bit
0x1C SCFDR_3 16-bit
0x20 SCSPTR_3 16-bit
0x24 SCLSR_3 16-bit
0x28 SCEMR_3 16-bit

## SCIF4
Base 0xE8009000
0x00 SCSMR_4 16-bit
0x04 SCBRR_4 8-bit
0x08 SCSCR_4 16-bit
0x0C SCFTDR_4 8-bit
0x10 SCFSR_4 16-bit
0x14 SCFRDR_4 8-bit
0x18 SCFCR_4 16-bit
0x1C SCFDR_4 16-bit
0x20 SCSPTR_4 16-bit
0x24 SCLSR_4 16-bit
0x28 SCEMR_4 16-bit

## SCIM0
Base 0xE800B000
0x00 SMR0 8-bit
0x01 BRR0 8-bit
0x02 SCR0 8-bit
0x03 TDR0 8-bit
0x04 SSR0 8-bit
0x05 RDR0 8-bit
0x06 SCMR0 8-bit
0x07 SEMR0 8-bit
0x08 SNFR0 8-bit
0x0D SECR0 8-bit

## SCIM1
Base 0xE800B800
0x00 SMR1 8-bit
0x01 BRR1 8-bit
0x02 SCR1 8-bit
0x03 TDR1 8-bit
0x04 SSR1 8-bit
0x05 RDR1 8-bit
0x06 SCMR1 8-bit
0x07 SEMR1 8-bit
0x08 SNFR1 8-bit
0x0D SECR1 8-bit

## RSPI0
Base 0xE800C800
0x00 SPCR_0 8-bit
0x01 SSLP_0 8-bit
0x02 SPPCR_0 8-bit
0x03 SPSR_0 8-bit
0x04 SPDR_0
0x08 SPSCR_0 8-bit
0x09 SPSSR_0 8-bit
0x0A SPBR_0 8-bit
0x0B SPDCR_0 8-bit
0x0C SPCKD_0 8-bit
0x0D SSLND_0 8-bit
0x0E SPND_0 8-bit
{0x10+2i} SPCMD{i}_0 16-bit (i=0..3)
0x20 SPBFCR_0 8-bit
0x22 SPBFDR_0 16-bit

## RSPI1
Base 0xE800D000
0x00 SPCR_1 8-bit
0x01 SSLP_1 8-bit
0x02 SPPCR_1 8-bit
0x03 SPSR_1 8-bit
0x04 SPDR_1
0x08 SPSCR_1 8-bit
0x09 SPSSR_1 8-bit
0x0A SPBR_1 8-bit
0x0B SPDCR_1 8-bit
0x0C SPCKD_1 8-bit
0x0D SSLND_1 8-bit
0x0E SPND_1 8-bit
{0x10+2i} SPCMD{i}_1 16-bit (i=0..3)
0x20 SPBFCR_1 8-bit
0x22 SPBFDR_1 16-bit

## RSPI2
Base 0xE800D800
0x00 SPCR_2 8-bit
0x01 SSLP_2 8-bit
0x02 SPPCR_2 8-bit
0x03 SPSR_2 8-bit
0x04 SPDR_2
0x08 SPSCR_2 8-bit
0x09 SPSSR_2 8-bit
0x0A SPBR_2 8-bit
0x0B SPDCR_2 8-bit
0x0C SPCKD_2 8-bit
0x0D SSLND_2 8-bit
0x0E SPND_2 8-bit
{0x10+2i} SPCMD{i}_2 16-bit (i=0..3)
0x20 SPBFCR_2 8-bit
0x22 SPBFDR_2 16-bit

## USB200
Base 0xE8010000
0x00 SYSCFG0_0 16-bit
0x02 BUSWAIT_0 16-bit
0x04 SYSSTS0_0 16-bit
0x08 DVSTCTR0_0 16-bit
0x0C TESTMODE_0 16-bit
0x10 D0FBCFG_0 16-bit
0x12 D1FBCFG_0 16-bit
0x14 CFIFO_0
0x18 D0FIFO_0
0x1C D1FIFO_0
0x20 CFIFOSEL_0 16-bit
0x22 CFIFOCTR_0 16-bit
0x28 D0FIFOSEL_0 16-bit
0x2A D0FIFOCTR_0 16-bit
0x2C D1FIFOSEL_0 16-bit
0x2E D1FIFOCTR_0 16-bit
0x30 INTENB0_0 16-bit
0x32 INTENB1_0 16-bit
0x36 BRDYENB_0 16-bit
0x38 NRDYENB_0 16-bit
0x3A BEMPENB_0 16-bit
0x3C SOFCFG_0 16-bit
0x40 INTSTS0_0 16-bit
0x42 INTSTS1_0 16-bit
0x46 BRDYSTS_0 16-bit
0x48 NRDYSTS_0 16-bit
0x4A BEMPSTS_0 16-bit
0x4C FRMNUM_0 16-bit
0x4E UFRMNUM_0 16-bit
0x50 USBADDR_0 16-bit
0x54 USBREQ_0 16-bit
0x56 USBVAL_0 16-bit
0x58 USBINDX_0 16-bit
0x5A USBLENG_0 16-bit
0x5C DCPCFG_0 16-bit
0x5E DCPMAXP_0 16-bit
0x60 DCPCTR_0 16-bit
0x64 PIPESEL_0 16-bit
0x68 PIPECFG_0 16-bit
0x6A PIPEBUF_0 16-bit
0x6C PIPEMAXP_0 16-bit
0x6E PIPEPERI_0 16-bit
{0x6E+2i} PIPE{i}CTR_0 16-bit (i=1..9)
0x82 PIPEACTR_0 16-bit
0x84 PIPEBCTR_0 16-bit
0x86 PIPECCTR_0 16-bit
0x88 PIPEDCTR_0 16-bit
0x8A PIPEECTR_0 16-bit
0x8C PIPEFCTR_0 16-bit
{0x8C+4i} PIPE{i}TRE_0 16-bit (i=1..5)
{0x8E+4i} PIPE{i}TRN_0 16-bit (i=1..5)
0xA4 PIPEBTRE_0 16-bit
0xA6 PIPEBTRN_0 16-bit
0xA8 PIPECTRE_0 16-bit
0xAA PIPECTRN_0 16-bit
0xAC PIPEDTRE_0 16-bit
0xAE PIPEDTRN_0 16-bit
0xB0 PIPEETRE_0 16-bit
0xB2 PIPEETRN_0 16-bit
0xB4 PIPEFTRE_0 16-bit
0xB6 PIPEFTRN_0 16-bit
0xB8 PIPE9TRE_0 16-bit
0xBA PIPE9TRN_0 16-bit
0xBC PIPEATRE_0 16-bit
0xBE PIPEATRN_0 16-bit
{0xD0+2i} DEVADD{i}_0 16-bit (i=0..9)
0xE4 DEVADDA_0 16-bit
0x102 SUSPMODE_0 16-bit
{0x160+4i} D0FIFOB{i}_0 (i=0..7)
{0x180+4i} D1FIFOB{i}_0 (i=0..7)
