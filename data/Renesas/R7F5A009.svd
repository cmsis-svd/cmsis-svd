# R7F5A009 register map
Vendor: Renesas Electronics Corporation; Series: Tahoe; File version: 1
CPU: CM4 r0p4, little endian, MPU, FPU, 4 interrupt priority bits
Registers are 32-bit, read-write, no defined reset value unless marked. A register's access mark holds for its fields unless they carry their own. Offsets are from the block's base; [hi:lo] are bit positions; {n}, {i} and the like mark numbered series.

## WDT — Watchdog timer
Base 0x40088020; register names take the prefix WDT_
0x00 WDTRR 8-bit — WDT Refresh Register
0x02 WDTCR 16-bit — WDT Control Register
0x04 WDTSR 16-bit — WDT Status Register
0x06 WDTRCR 8-bit — WDT Reset Control Register

## IWDT — Independent watchdog timer
Base 0x40088030; register names take the prefix IWDT_
0x00 IWDTRR 8-bit — IWDT Refresh Register
0x02 IWDTCR 16-bit — IWDT Control Register
0x04 IWDTSR 16-bit — IWDT Status Register
0x06 IWDTRCR 8-bit — IWDT Reset Control Register
0x08 IWDTCSTPR 8-bit — IWDT Count Stop Control Register

## DAC — D/A Converter
Base 0x40088040; register names take the prefix DAC_
0x00 DADR0 16-bit — D/A Data Register 0
0x02 DADR1 16-bit — D/A Data Register 1
0x04 DACR 8-bit — D/A Control Register
0x05 DADPR 8-bit — DADRn Format Selection Register
0x08 DAAMPCR 8-bit — D/A Output Amplifier Control Register

## CRC — CRC Calculator
Base 0x40088280; register names take the prefix CRC_
0x00 CRCCR 8-bit — CRC Control Register
0x01 CRCDIR 8-bit — CRC Data Input Register
0x02 CRCDOR 16-bit — CRC Data Output Register

## RIIC — I2C Bus Interface
Base 0x40088300; register names take the prefix RIIC_
0x00 ICCR1 8-bit — I2C Bus Control Register 1
0x01 ICCR2 8-bit — I2C Bus Control Register 2
{0x1+i} ICMR{i} 8-bit (i=1..3) — I2C Bus Mode Register {i}
0x05 ICFER 8-bit — I2C Bus Function Enable Register
0x06 ICSER 8-bit — I2C Bus Status Enable Register
0x07 ICIER 8-bit — I2C Bus Interrupt Enable Register
0x08 ICSR1 8-bit — I2C Bus Status Register1
0x09 ICSR2 8-bit — I2C Bus Status Register 2
{0xA+2i} SARL{i} 8-bit (i=0..2) — Slave Address Register L{i}
{0xB+2i} SARU{i} 8-bit (i=0..2) — Slave Address Register U{i}
0x10 ICBRL 8-bit — I2C Bus Bit Rate L Level Register
0x11 ICBRh 8-bit — I2C Bus Bit Rate h Level Register
0x12 ICDRT 8-bit — I2CIIC Bus Transmit Data Register
0x13 ICDRR 8-bit ro — I2C Bus Receive Data Register

## SCI3_0 — Serial communications interface 0
Base 0x40088400; register names take the prefix SCI3_0_
0x00 SMR 8-bit — Serial Mode Register
0x04 BRR 8-bit — Bit Rate Register
0x04 MDDR 8-bit (alternate view of BRR) — Modulation Duty Register
0x08 SCR 8-bit — Serial Control Register
0x0C TDR 8-bit — Transmit Data Register
0x10 SSR 8-bit — Serial Status Register
0x14 RDR 8-bit ro — Receive Data Register
0x18 SCMR 8-bit — Extended Mode Register
0x1C SEMR 8-bit — Serial Extended Mode Register

## SCI3_1 — Serial communications interface 1
Base 0x40088440; register names take the prefix SCI3_1_
Registers as SCI3_0.

## SCI3_2 — Serial communications interface 2
Base 0x40088480; register names take the prefix SCI3_2_
Registers as SCI3_0.

## ADC — A/D Converter
Base 0x40089000; register names take the prefix ADC_
0x00 ADCSR 16-bit — A/D Control Register
0x04 ADANSA0 16-bit — A/D Channel Select Register A0
0x08 ADADS0 16-bit — A/D-Converted Value Addition/Average Function Select Register 0
0x0C ADADC 8-bit — A/D-Converted Value Addition/Average Count Select Register
0x0E ADCER 16-bit — A/D Control Extended Register
0x10 ADSTRGR 16-bit — A/D Start Trigger Selection Register
0x12 ADEXICR 16-bit — A/D Conversion Extended Input Control Register
0x14 ADANSB0 16-bit — A/D Channel Select Register B0
0x18 ADDBLDR 16-bit ro — A/D Data Duplication Register
0x1A ADTSDR 16-bit ro — A/D Temperature Sensor Data Register
0x1C ADOCDR 16-bit ro — A/D Internal Reference Voltage Data Register
0x1E ADRD 16-bit ro — A/D Self-Diagnosis Data Register
{0x20+2i} ADDR{i} 16-bit ro (i=0..7) — A/D Data Register {i}
0x60 ADSSTR0 8-bit — A/D Sampling State Register 0
0x70 ADSSTRT 8-bit — A/D Sampling State Register T
0x71 ADSSTRO 8-bit — A/D Sampling State Register O
{0x72+i} ADSSTR{i} 8-bit (i=1..7) — A/D Sampling State Register {i}
0x7A ADDISCR 8-bit — A/D Disconnection Detection Control Register
0x80 ADGSPCR 16-bit — A/D Group Scan Priority Control Register
0x84 ADDBLDRA 16-bit ro — A/D Data Duplication Register A
0x86 ADDBLDRB 16-bit ro — A/D Data Duplication Register B
0x90 ADCMPCR 8-bit — A/D Compare Control Register
0x92 ADCMPANSER 8-bit — A/D Compare Channel Select Extended Register
0x93 ADCMPLER 8-bit — A/D Compare Level Extended Register
0x94 ADCMPANSR0 16-bit — A/D Compare Channel Selection Register 0
0x98 ADCMPLR0 16-bit — A/D Compare Level Register 0
0x9C ADCMPDR0 16-bit — A/D Compare Data Register 0
0x9E ADCMPDR1 16-bit — A/D Compare Data Register 1
0xA0 ADCMPSR0 16-bit — A/D Compare Status Register 0
0xA4 ADCMPSER 8-bit — A/D Compare Status Extended Register
