# RIN32M4_CL2 register map
Vendor: Renesas Electronics Corporation; Series: RIN32M4; File version: 0.1
CPU: CM4F r0p1, little endian, MPU, FPU, 4 interrupt priority bits
Registers are 32-bit, read-write, reset 0x0 unless marked. A register's access mark holds for its fields unless they carry their own. Offsets are from the block's base; [hi:lo] are bit positions; {n}, {i} and the like mark numbered series.

## SYS — System
Base 0x40010000
0x00 MDMNT ro reset not defined — Mode monitor register
0x04 IDCODE ro reset 0x52494E32
0x08 RINVER ro reset 0x11 — Version register
0x100 WREN reset 0x1 — Write enable register
0x108 WAITZSEL reset 0xF — WAITZ select
0x110 SMADSEL0 reset 0x100000FC — External memory I/F select 0
0x114 SMADSEL1 reset 0x140000FC — External memory I/F select 1
0x118 SMADSEL2 reset 0x180000FC — External memory I/F select 2
0x11C SMADSEL3 reset 0x1C0000FC — External memory I/F select 3
0x120 BCLKSEL reset 0x4 — BUSCLK devide
0x124 SMCMD — SMC mode
0x128 SMCBUFMD — SMC352 buffer control
0x180 WDTCLKCFG — WDT input clock selection register
0x1A0 CLKGTD0 reset 0xFFFF — Clock control 0
0x1A4 CLKGTD1 reset 0x6FDF — Clock control 1
0x1C0 SYSRESET 16-bit reset 0x1 — System reset register
0x210 CPURESET reset not defined
{0x220+8i} DRCTLP{i}L reset 0x9999 (i=0..4) — Port {i} buffer select Lo
{0x224+8i} DRCTLP{i}H reset 0x9999 (i=0..2) — Port {i} buffer select Hi
0x23C DRCTLP3H reset 0x5959 — Port 3 buffer select Hi
0x244 DRCTLP4H reset 0x9999 — Port 4 buffer select Hi
0x248 DRCTLP5L reset 0x959 — Port 5 buffer select Lo
0x24C DRCTLP5H reset 0x9000 — Port 5 buffer select Hi
0x250 DRCTLP6L reset 0x9999 — Port 6 buffer select Lo
0x254 DRCTLP6H reset 0x9999 — Port 6 buffer select Hi
0x258 DRCTLP7L reset 0x9999 — Port 7 buffer select Lo
0x25C DRCTLP7H reset 0x9999 — Port 7 buffer select Hi
{0x260+8i} DRCTLRP{i}L (i=0..3) reset 0x9999 — Realtime Port n buffer select Lo
{0x264+8i} DRCTLRP{i}H (i=0..3) reset 0x9999 — Realtime Port n buffer select Hi
0x280 DRCTLEXTP0L reset 0x9999 — EXT Port 0 buffer select Lo
0x284 DRCTLEXTP0H reset 0x9599 — EXT Port 0 buffer select Hi
0x288 DRCTLEXTP1L reset 0x99 — EXT Port 1 buffer select Lo
0x300 SYSPCMD — System protect command
0x400 RTOS_SOFTRST reset 0x1 — HW-RTOS reset register
0x500 SELCNT — Timer input select
0x504 SELCNTD — Timer input select (TAUD)
{0x530+4i} TMTFR{i} (i=0..3) — Timer trigger factor n
0x600 MACSEL — MAC select
0x604 MDCCFG — MDC clock select
0x680 ETHSWMTC reset 0xE001 — EtherSW management TAG
0x684 ETHSWMD — EtherSW mode control
{0x700+4i} NFC{i} (i=0..3) — Noise filter control n
0x710 INTM0 reset 0x400002 — External interrupt mode 0
0x714 INTM1 — External interrupt mode 1
0x718 INTM2 — External interrupt mode 2
0x720 DMAIFC0 — DMA transfer interface signal 0
0x724 DMAIFC1 — DMA transfer interface signal 1
0x728 RTDMAIFC — DMA transfer interface signal RT
{0x730+4i} DTFR{i} (i=0..3) — DMA trigger factor n
0x740 RTDTFR — DMA trigger factor RT
0x804 SRAMBRSEL reset not defined — SRAM bridge select
0x80C CCSMON ro — CC-Link slave monitor
0x810 CCSRUN — CC-Link slave RUN LED control
0x814 CCRES — CC-Link reset register
0x818 CCSMD — CC-Link mode register
0x824 CCSINTMD reset 0x3 — CC-Link slave REFSTB interrupt detection mode
0x828 CCSREFMON — CC-Link slave REFSTB monitor
0x900 SCRATCH{x} (x=0,1,2,3,4,5,6,7,8,9,A,B,C,D; step 0x4) — Scratch n
0x938 CIECLKGTD — CC-Link IE Clock Gate register
0xA00 RPTRGMD — Trigger sync port control
{0xA30+4i} RP{i}TFR (i=0..3) — Trigger sync port factor n
{0xD00+4i} TMDTFR{i} (i=0..7) — Timer trigger factor m (TAUD)
0xE00 MDIOSEL reset 0x1 — GMII/MII management I/F select
0x1100 SWTMEN — Ether switch timer output control
0x1110 SWTMSTSECL — Ether switch timer start setting (sec) 0
0x1114 SWTMSTSECH — Ether switch timer start setting (sec) 1
0x1118 SWTMSTNSL — Ether switch timer start setting (ns) 0
0x111C SWTMSTNSH — Ether switch timer start setting (ns) 1
0x1120 SWTMPSECL — Ether switch timer period setting (sec) 0
0x1124 SWTMPSECH — Ether switch timer period setting (sec) 1
0x1128 SWTMPNSL reset 0xCA00 — Ether switch timer period setting (ns) 0
0x112C SWTMPNSH reset 0x3B9A — Ether switch timer period setting (ns) 1
0x1130 SWTMWTH reset 0x3 — Ether switch timer pulse width setting
0x1134 SWTMMAXPL — Ether switch timer max count setting 0
0x1138 SWTMMAXPH — Ether switch timer max count setting 1
0x1140 SWTMLATSEC — Ether switch timer latch setting (sec)
0x1144 SWTMLATNS — Ether switch timer latch setting (ns)
0x1220 PHYRST — PHY reset
0x1224 PHYRSTCH reset 0x1 — PHY reset select
0x1230 WDTISEL — WDT input filter select
0x1240 TMISEL — Timer I/F select
0x1244 INTSEL — INTPZ/Timer interrupt select
0x1250 NFC4 — Noise filter control 4
0x1260 STOP_TOUTD — TOUTD output control
0x1264 TOUTD_SEL — TOUTD output select
0x1268 ERRDETSEL0 — Error detection signal select 0
0x126C ERRDETSEL1 — Error detection signal select 1
