# R7S910x18 register map
Vendor: Renesas Electronics Corporation; Series: RZT; File version: 1.0
CPU: other r1p4, little endian, MPU, FPU, vendor SysTick, 1 interrupt priority bits
Registers are 32-bit, read-write, no defined reset value unless marked. A register's access mark holds for its fields unless they carry their own. Offsets are from the block's base; [hi:lo] are bit positions; {n}, {i} and the like mark numbered series.

## MPC — Multi-function pin controller
Base 0xA0000200; register names take the prefix MPC_
{0x0+i} P{i:02}PFS 8-bit (i=0..7) — Port {i:02} pin function control register
0x08 P10PFS 8-bit — Port 10 pin function control register
0x09 P11PFS 8-bit — Port 11 pin function control register
0x0A P12PFS 8-bit — Port 12 pin function control register
0x0B P13PFS 8-bit — Port 13 pin function control register
0x0C P14PFS 8-bit — Port 14 pin function control register
0x0D P15PFS 8-bit — Port 15 pin function control register
0x0E P16PFS 8-bit — Port 16 pin function control register
0x0F P17PFS 8-bit — Port 17 pin function control register
0x10 P20PFS 8-bit — Port 20 pin function control register
0x11 P21PFS 8-bit — Port 21 pin function control register
0x12 P22PFS 8-bit — Port 22 pin function control register
0x13 P23PFS 8-bit — Port 23 pin function control register
0x14 P24PFS 8-bit — Port 24 pin function control register
0x15 P25PFS 8-bit — Port 25 pin function control register
0x16 P26PFS 8-bit — Port 26 pin function control register
0x17 P27PFS 8-bit — Port 27 pin function control register
0x18 P30PFS 8-bit — Port 30 pin function control register
0x19 P31PFS 8-bit — Port 31 pin function control register
0x1A P32PFS 8-bit — Port 32 pin function control register
0x1B P33PFS 8-bit — Port 33 pin function control register
0x1C P34PFS 8-bit — Port 34 pin function control register
0x1D P35PFS 8-bit — Port 35 pin function control register
0x1E P36PFS 8-bit — Port 36 pin function control register
0x1F P37PFS 8-bit — Port 37 pin function control register
0x20 P40PFS 8-bit — Port 40 pin function control register
0x21 P41PFS 8-bit — Port 41 pin function control register
0x22 P42PFS 8-bit — Port 42 pin function control register
0x23 P43PFS 8-bit — Port 43 pin function control register
0x24 P44PFS 8-bit — Port 44 pin function control register
0x25 P45PFS 8-bit — Port 45 pin function control register
0x26 P46PFS 8-bit — Port 46 pin function control register
0x27 P47PFS 8-bit — Port 47 pin function control register
0x28 P50PFS 8-bit — Port 50 pin function control register
0x29 P51PFS 8-bit — Port 51 pin function control register
0x2A P52PFS 8-bit — Port 52 pin function control register
0x2B P53PFS 8-bit — Port 53 pin function control register
0x2C P54PFS 8-bit — Port 54 pin function control register
0x2D P55PFS 8-bit — Port 55 pin function control register
0x2E P56PFS 8-bit — Port 56 pin function control register
0x30 P60PFS 8-bit — Port 60 pin function control register
0x31 P61PFS 8-bit — Port 61 pin function control register
0x32 P62PFS 8-bit — Port 62 pin function control register
0x33 P63PFS 8-bit — Port 63 pin function control register
0x34 P64PFS 8-bit — Port 64 pin function control register
0x35 P65PFS 8-bit — Port 65 pin function control register
0x36 P66PFS 8-bit — Port 66 pin function control register
0x37 P67PFS 8-bit — Port 67 pin function control register
0x38 P70PFS 8-bit — Port 70 pin function control register
0x39 P71PFS 8-bit — Port 71 pin function control register
0x3A P72PFS 8-bit — Port 72 pin function control register
0x3B P73PFS 8-bit — Port 73 pin function control register
0x3C P74PFS 8-bit — Port 74 pin function control register
0x3D P75PFS 8-bit — Port 75 pin function control register
0x3E P76PFS 8-bit — Port 76 pin function control register
0x3F P77PFS 8-bit — Port 77 pin function control register
0x40 P80PFS 8-bit — Port 80 pin function control register
0x41 P81PFS 8-bit — Port 81 pin function control register
0x42 P82PFS 8-bit — Port 82 pin function control register
0x43 P83PFS 8-bit — Port 83 pin function control register
0x44 P84PFS 8-bit — Port 84 pin function control register
0x45 P85PFS 8-bit — Port 85 pin function control register
0x46 P86PFS 8-bit — Port 86 pin function control register
0x47 P87PFS 8-bit — Port 87 pin function control register
0x48 P90PFS 8-bit — Port 90 pin function control register
0x49 P91PFS 8-bit — Port 91 pin function control register
0x4A P92PFS 8-bit — Port 92 pin function control register
0x4B P93PFS 8-bit — Port 93 pin function control register
0x4C P94PFS 8-bit — Port 94 pin function control register
0x4D P95PFS 8-bit — Port 95 pin function control register
0x4E P96PFS 8-bit — Port 96 pin function control register
0x4F P97PFS 8-bit — Port 97 pin function control register
{0x50+i} PA{i}PFS 8-bit (i=0..7) — Port A{i} pin function control register
{0x58+i} PB{i}PFS 8-bit (i=0..7) — Port B{i} pin function control register
{0x60+i} PC{i}PFS 8-bit (i=0..7) — Port C{i} pin function control register
{0x68+i} PD{i}PFS 8-bit (i=0..7) — Port D{i} pin function control register
{0x70+i} PE{i}PFS 8-bit (i=0..7) — Port E{i} pin function control register
{0x78+i} PF{i}PFS 8-bit (i=5..7) — Port F{i} pin function control register
{0x80+i} PG{i}PFS 8-bit (i=0..7) — Port G{i} pin function control register
{0x88+i} PH{i}PFS 8-bit (i=0..7) — Port H{i} pin function control register
{0x90+i} PJ{i}PFS 8-bit (i=0..7) — Port J{i} pin function control register
{0x98+i} PK{i}PFS 8-bit (i=0..7) — Port K{i} pin function control register
{0xA0+i} PL{i}PFS 8-bit (i=0..7) — Port L{i} pin function control register
{0xA8+i} PM{i}PFS 8-bit (i=0..7) — Port M{i} pin function control register
{0xB0+i} PN{i}PFS 8-bit (i=0..7) — Port N{i} pin function control register
{0xB8+i} PP{i}PFS 8-bit (i=0..7) — Port P{i} pin function control register
{0xC0+i} PR{i}PFS 8-bit (i=0..7) — Port R{i} pin function control register
{0xC8+i} PS{i}PFS 8-bit (i=0..7) — Port S{i} pin function control register
{0xD0+i} PT{i}PFS 8-bit (i=0..7) — Port T{i} pin function control register
{0xD8+i} PU{i}PFS 8-bit (i=0..7) — Port U{i} pin function control register
0xFF PWPR 8-bit — Write protection register
