# LPC845 register map
Vendor: NXP Semiconductors; Series: LPC; File version: 1.6
CPU: CM0PLUS r0p0, little endian, no MPU, no FPU, VTOR, 2 interrupt priority bits
Registers are 32-bit, read-write, reset 0x0 unless marked. A register's access mark holds for its fields unless they carry their own. Offsets are from the block's base; [hi:lo] are bit positions; {n}, {i} and the like mark numbered series; 'fields as' and 'values as' point back to an identical list.

## GPIO — LPC84x General Purpose I/O (GPIO)
Base 0xA0000000
{0x0+i} B0_{i} 8-bit (i=0..31) — Byte pin registers for all port 0 and 1 GPIO pins
  [0] PBYTE — Read: state of the pin PIOm_n, regardless of direction, masking, or alternate function, except that pins configured as analog I/O always read as 0. One register for each port pin. Supported pins depends on the specific device and package. Write: loads the pin's output bit. One register for each port pin. Supported pins depends on the specific device and package.
{0x20+i} B1_{i} 8-bit (i=0..31) — Byte pin registers for all port 0 and 1 GPIO pins
  fields as B0_0
{0x1000+4i} W0_{i} (i=0..31) — Word pin registers for all port 0 and 1 GPIO pins
  [31:0] PWORD — Read 0: pin PIOm_n is LOW. Write 0: clear output bit. Read 0xFFFF FFFF: pin PIOm_n is HIGH. Write any value 0x0000 0001 to 0xFFFF FFFF: set output bit. Only 0 or 0xFFFF FFFF can be read. Writing any value other than 0 will set the output bit. One register for each port pin. Supported pins depends on the specific device and package.
{0x1080+4i} W1_{i} (i=0..31) — Word pin registers for all port 0 and 1 GPIO pins
  fields as W0_0
0x2000 DIR0 — Direction registers
  [31:0] DIRP — Selects pin direction for pin PIOm_n (bit 0 = PIOn_0, bit 1 = PIOn_1, etc.). Supported pins depends on the specific device and package. 0 = input. 1 = output.
0x2004 DIR1 — Direction registers
  fields as DIR0
0x2080 MASK0 — Mask register
  [31:0] MASKP — Controls which bits corresponding to PIOm_n are active in the MPORT register (bit 0 = PIOn_0, bit 1 = PIOn_1, etc.). Supported pins depends on the specific device and package. 0 = Read MPORT: pin state; write MPORT: load output bit. 1 = Read MPORT: 0; write MPORT: output bit not affected.
0x2084 MASK1 — Mask register
  fields as MASK0
0x2100 PIN0 — Port pin register
  [31:0] PORT — Reads pin states or loads output bits (bit 0 = PIOn_0, bit 1 = PIOn_1, etc.). Supported pins depends on the specific device and package. 0 = Read: pin is low; write: clear output bit. 1 = Read: pin is high; write: set output bit.
0x2104 PIN1 — Port pin register
  fields as PIN0
0x2180 MPIN0 — Masked port register
  [31:0] MPORTP — Masked port register (bit 0 = PIOn_0, bit 1 = PIOn_1, etc.). Supported pins depends on the specific device and package. 0 = Read: pin is LOW and/or the corresponding bit in the MASK register is 1; write: clear output bit if the corresponding bit in the MASK register is 0. 1 = Read: pin is HIGH and the corresponding bit in the MASK register is 0; write: set output bit if the corresponding bit in the MASK register is 0.
0x2184 MPIN1 — Masked port register
  fields as MPIN0
0x2200 SET0 — Write: Set register for port Read: output bits for port
  [31:0] SETP — Read or set output bits (bit 0 = PIOn_0, bit 1 = PIOn_1, etc.). Supported pins depends on the specific device and package. 0 = Read: output bit: write: no operation. 1 = Read: output bit; write: set output bit.
0x2204 SET1 — Write: Set register for port Read: output bits for port
  fields as SET0
0x2280 CLR0 wo reset not defined — Clear port
  [31:0] CLRP — Clear output bits (bit 0 = PIOn_0, bit 1 = PIOn_1, etc.). Supported pins depends on the specific device and package. 0 = No operation. 1 = Clear output bit.
0x2284 CLR1 wo reset not defined — Clear port
  fields as CLR0
0x2300 NOT0 wo reset not defined — Toggle port
  [31:0] NOTP — Toggle output bits (bit 0 = PIOn_0, bit 1 = PIOn_1, etc.). Supported pins depends on the specific device and package. 0 = no operation. 1 = Toggle output bit.
0x2304 NOT1 wo reset not defined — Toggle port
  fields as NOT0
0x2380 DIRSET0 wo reset not defined — Set pin direction bits for port
  [28:0] DIRSETP — Set direction bits (bit 0 = PIOn_0, bit 1 = PIOn_1, etc.). Supported pins depends on the specific device and package. 0 = No operation. 1 = Set direction bit.
0x2384 DIRSET1 wo reset not defined — Set pin direction bits for port
  fields as DIRSET0
0x2400 DIRCLR0 wo reset not defined — Clear pin direction bits for port
  [28:0] DIRCLRP — Clear direction bits (bit 0 = PIOn_0, bit 1 = PIOn_1, etc.). Supported pins depends on the specific device and package. 0 = No operation. 1 = Clear direction bit.
0x2404 DIRCLR1 wo reset not defined — Clear pin direction bits for port
  fields as DIRCLR0
0x2480 DIRNOT0 wo reset not defined — Toggle pin direction bits for port
  [28:0] DIRNOTP — Toggle direction bits (bit 0 = PIOn_0, bit 1 = PIOn_1, etc.). Supported pins depends on the specific device and package. 0 = no operation. 1 = Toggle direction bit.
0x2484 DIRNOT1 wo reset not defined — Toggle pin direction bits for port
  fields as DIRNOT0
