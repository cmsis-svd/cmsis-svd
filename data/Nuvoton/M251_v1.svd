# M251_v1 register map
File version: 1.0
M251_v1 SVD file
Registers are 32-bit, read-write, reset 0x0 unless marked. A register's access mark holds for its fields unless they carry their own. Offsets are from the block's base; lines under a group give offsets from that group; [hi:lo] are bit positions; {n}, {i} and the like mark numbered series; 'fields as' and 'values as' point back to an identical list; <NAME> marks a mode.

## Memory map
0x40000000 SYS blocks up to offset 0x200 — SYS Register Map
0x40000200 CLK blocks up to offset 0xB8 — CLK Register Map
0x40000300 NMI size 0x8 — NMI Register Map
0x40004000 GPIO blocks up to offset 0x960 — GPIO Register Map
0x40008000 PDMA blocks up to offset 0x530 — PDMA Register Map
0x4000C000 FMC blocks up to offset 0xE4 — FMC Register Map
0x40010000 EBI blocks up to offset 0x28 — EBI Register Map
0x40031000 CRC size 0x10 — CRC Register Map
0x40040000 WDT size 0xC — WDT Register Map
0x40040100 WWDT size 0x10 — WWDT Register Map
0x40041000 RTC blocks up to offset 0x138 — RTC Register Map
0x40043000 EADC blocks up to offset 0x20C — EADC Register Map
0x40045000 ACMP01 size 0x10 — ACMP Register Map
0x40046000 OPA size 0x10 — OPA Register Map
0x40047000 DAC size 0x18 — DAC Register Map
0x40050000 TMR01 blocks up to offset 0x178 — TIMER Register Map
0x40051000 TMR23 blocks up to offset 0x178 — TIMER Register Map
0x40058000 PWM0 blocks up to offset 0x334 — PWM Register Map
0x40059000 PWM1 blocks up to offset 0x334 — PWM Register Map
0x4005A000 BPWM0 blocks up to offset 0x334 — BPWM Register Map
0x4005B000 BPWM1 blocks up to offset 0x334 — BPWM Register Map
0x40060000 QSPIx blocks up to offset 0x34 — QSPI Register Map
0x40061000 SPIx blocks up to offset 0x6C — SPI Register Map
0x40070000 UART0 size 0x4C — UART Register Map
0x40071000 UART1 blocks up to offset 0x4C — UART Register Map
0x40072000 UART2 blocks up to offset 0x4C — UART Register Map
0x40080000 I2C0 blocks up to offset 0x6C — I2C Register Map
0x40081000 I2C1 blocks up to offset 0x6C — I2C Register Map
0x40090000 SC0 blocks up to offset 0x50 — SC Register Map
0x400C0000 USBD blocks up to offset 0x5C0 — USBD Register Map
0x400C3000 PSIO blocks up to offset 0x13C — PSIO Register Map
0x400D0000 UUART0 blocks up to offset 0x68 — UUARTUART Register Map
0x400D0000 USPI0 blocks up to offset 0x68 — USCISPI Register Map
0x400D0000 UI2C0 blocks up to offset 0x90 — UI2CI2C Register Map
0x400D1000 UUART1 blocks up to offset 0x68 — UUARTUART Register Map
0x400D1000 USPI1 blocks up to offset 0x68 — USCISPI Register Map
0x400D1000 UI2C1 blocks up to offset 0x90 — UI2CI2C Register Map
0x400D2000 UUART2 blocks up to offset 0x68 — UUARTUART Register Map
0x400D2000 USPI2 blocks up to offset 0x68 — USCISPI Register Map
0x400D2000 UI2C2 blocks up to offset 0x90 — UI2CI2C Register Map
0x50080000 CRYPTO blocks up to offset 0x14C — CRYPTO Register Map
0xE000E000 SCS blocks up to offset 0xD28 — SYST_SCR Register Map
0xE000E100 NVIC blocks up to offset 0x208 — NVIC Register Map

## NVIC — NVIC Register Map
Base 0xE000E100
0x00 NVIC_ISER0 — IRQ0 ~ IRQ31 Set-enable Control Register
  [31:0] SETENA — Interrupt Set Enable Bit. The NVIC_ISER0-NVIC_ISER1 registers enable interrupts, and show which interrupts are enabled. Write Operation:
    0=No effect. Interrupt Disabled; 1=Interrupt Enabled
0x04 NVIC_ISER1 — IRQ32 ~ IRQ63 Set-enable Control Register
  [31:0] SETENA — Interrupt Set Enable Bit. The NVIC_ISER0-NVIC_ISER2 registers enable interrupts, and show which interrupts are enabled. Write Operation:
    0=No effect. Interrupt Disabled; 1=Interrupt Enabled
0x80 NVIC_ICER0 — IRQ0 ~ IRQ31 Clear-enable Control Register
  [31:0] CALENA — Interrupt Clear Enable Bit. The NVIC_ICER0-NVIC_ICER1 registers disable interrupts, and show which interrupts are enabled. Write Operation:
    0=No effect. Interrupt Disabled; 1=Interrupt Disabled. Interrupt Enabled
0x84 NVIC_ICER1 — IRQ32 ~ IRQ63 Clear-enable Control Register
  [31:0] CALENA — Interrupt Clear Enable Bit. The NVIC_ICER0-NVIC_ICER2 registers disable interrupts, and show which interrupts are enabled. Write Operation:
    values as NVIC_ICER0.CALENA
0x100 NVIC_ISPR0 — IRQ0 ~ IRQ31 Set-pending Control Register
  [31:0] SETPEND — Interrupt Set-pending. The NVIC_ISPR0-NVIC_ISPR1 registers force interrupts into the pending state, and show which interrupts are pending. Write Operation:
    0=No effect. Interrupt is not pending; 1=Changes interrupt state to pending. Interrupt is pending
0x104 NVIC_ISPR1 — IRQ32 ~ IRQ63 Set-pending Control Register
  fields as NVIC_ISPR0
0x180 NVIC_ICPR0 — IRQ0 ~ IRQ31 Clear-pending Control Register
  [31:0] CALPEND — Interrupt Clear-pending. The NVIC_ICPR0-NVIC_ICPR1 registers remove the pending state from interrupts, and show which interrupts are pending. Write Operation:
    0=No effect. Interrupt is not pending; 1=Removes pending state an interrupt. Interrupt is pending
0x184 NVIC_ICPR1 — IRQ32 ~ IRQ63 Clear-pending Control Register
  fields as NVIC_ICPR0
0x200 NVIC_IABR0 — IRQ0 ~ IRQ31 Active Bit Register
  [31:0] ACTIVE — Interrupt Active Flags. The NVIC_IABR0-NVIC_IABR1 registers indicate which interrupts are active.
    0=interrupt not active; 1=interrupt active
0x204 NVIC_IABR1 — IRQ32 ~ IRQ63 Active Bit Register
  fields as NVIC_IABR0
