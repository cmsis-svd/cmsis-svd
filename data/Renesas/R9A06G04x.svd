# R9A06G04x register map
Vendor: Renesas Electronics Corporation; Series: EC1; File version: 1
CPU: other r1p4, little endian, MPU, FPU, vendor SysTick, 1 interrupt priority bits
Registers are 32-bit, read-write, no defined reset value unless marked. A register's access mark holds for its fields unless they carry their own. Offsets are from the block's base; [hi:lo] are bit positions; lines under a group give offsets from that group; {n}, {i} and the like mark numbered series.

## ELC — Event link controller
Base 0xA0080B00; register names take the prefix ELC_
0x00 ELCR 8-bit — Event link control register
0x08 ELSR7 8-bit — Event link setting register 7
{0x1+i} ELSR{i} 8-bit (i=18..27) — Event link setting register {i}
0x21 ELOPC 8-bit — Event link option setting register C
0x23 PGR1 8-bit — Port group setting register 1
0x24 PGR2 8-bit — Port group setting register 2
0x25 PGC1 8-bit — Port group control register 1
0x26 PGC2 8-bit — Port group control register 2
0x27 PDBF1 8-bit — Port buffer register 1
0x28 PDBF2 8-bit — Port buffer register 2
{0x29+i} PEL{i} 8-bit (i=0..3) — Event link port setting register {i}
0x2D ELSEGR 8-bit — Event link software event generation register
0x31 ELSR33 8-bit — Event link setting register 33
0x41 ELOPH 8-bit — Event link option setting register H

## DOC — Data operation circuit
Base 0xA0081200; register names take the prefix DOC_
0x00 DOCR 8-bit — DOC control register
0x02 DODIR 16-bit — DOC data input register
0x04 DODSR 16-bit — DOC data setting register

## CLMA0 — Clock monitor circuit 0
Base 0xA0090000; register names take the prefix CLMA0_
0x00 CLMA0CTL0 8-bit — CLMA0 control register 0
0x08 CLMA0CMPL 16-bit — CLMA0 compare register L
0x0C CLMA0CMPH 16-bit — CLMA0 compare register H
0x10 CLMA0PCMD 8-bit wo — CLMA0 command register
0x14 CLMA0PS 8-bit ro — CLMA0 protection status register

## CLMA1 — Clock monitor circuit 1
Base 0xA0090020; register names take the prefix CLMA1_
Registers as CLMA0 (with CLMA0 read as CLMA1).

## CLMA2 — Clock monitor circuit 2
Base 0xA0090040; register names take the prefix CLMA2_
Registers as CLMA0 (with CLMA0 read as CLMA2).

## ICU — Interrupt controller
Base 0xA0094000; register names take the prefix ICU_
{0x0+4i} DMA0SEL{i} (i=0..15) — DMAC unit 0 source select register {i}
{0x40+4i} DMA1SEL{i} (i=0..15) — DMAC unit 1 source select register {i}
0x80 DMASTG — DMAC software start register
{0x200+4i} IRQCR{i} (i=0..4) — IRQ control register {i}
0x218 IRQCR6 — IRQ control register 6
0x21C IRQCR7 — IRQ control register 7
0x224 IRQCR9 — IRQ control register 9
{0x200+4i} IRQCR{i} (i=11..14) — IRQ control register {i}
0x240 IRQFLTE — IRQ pin digital noise filter enable register
0x244 IRQFLTC — IRQ pin digital noise filter setting register
0x248 NMISR — Non-maskable interrupt status register
0x24C NMICLR — Non-maskable interrupt status clear register
0x250 NMICR — NMI pin interrupt control register
0x254 NMIFLTE — NMI pin digital noise filter enable register
0x258 NMIFLTC — NMI pin digital noise filter setting register
0x25C EPHYCR0 — EtherPHY control register 0
0x260 EPHYCR1 — EtherPHY control register 1
0x268 EPHYFLTE — EtherPHY interrupt request pin digital noise filter enable register
0x26C EPHYFLTC — EtherPHY interrupt request pin digital noise filter setting register

## SYSTEM — System controller
Base 0xA00B0000; register names take the prefix SYSTEM_
0x20 SCKCR — System clock control register
0x24 SCKCR2 — System clock control register 2
0x38 PLL1CR2 — PLL1 control register 2
0x40 LOCOCR — Low-speed on-chip oscillator control register
0x4C OSTDCR — Oscillation stop detect control register
0x200 RSTSR0 — Reset status register 0
0x210 SWRR1 — Software reset register
0x248 MRCTLC — Module reset control register C
0x300 MSTPCRA — Module stop control register A
0x304 MSTPCRB — Module stop control register B
0x308 MSTPCRC — Module stop control register C
0x310 MSTPCRE — Module stop control register E
0x314 MSTPCRF — Module stop control register F
0x800 SYTATCMWAIT — ATCM wait control register
0xA00 DBGIFCNT — Debug interface control register
0xA80 ECMMCNT — ECM mask control register
0xB00 PRCR — Protect register

## ETHERSW — Ethernet switch
Base 0xA00BF000; register names take the prefix ETHERSW_
0x00 ETSPCMD — Ethernet system protect command register
0x04 MACSEL — MAC select register
0x14 ETHPHYLNK — Ethernet PHY LINK mode register
0x100 CATOFFADD — EtherCAT PHY offset address setting
0x104 CATEMMD — EtherCAT operation mode setting
0x10C CATTXCSFT — EtherCAT TXC shift setting
0x118 ETHSFTRST — Ethernet peripheral reset register

## ETHERC — Ethernet controller
Base 0xA00E0000; register names take the prefix ETHERC_
0x100A0 GMAC_MIIM — MIM register
0x12100 SPCMD — System protect command register
0x12110 EMACRST — Ethernet MAC reset register
