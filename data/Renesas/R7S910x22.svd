# R7S910x22 register map
Vendor: Renesas Electronics Corporation; Series: RZT; File version: 1.5
CPU: other r1p4, little endian, MPU, FPU, vendor SysTick, 1 interrupt priority bits
Registers are 32-bit, read-write, no defined reset value unless marked. A register's access mark holds for its fields unless they carry their own. Offsets are from the block's base; [hi:lo] are bit positions; {n}, {i} and the like mark numbered series.

## MPC — Multi-function pin controller
Base 0xA0000200; register names take the prefix MPC_
0x00 P00PFS 8-bit — Port 00 pin function control register
0x08 P10PFS 8-bit — Port 10 pin function control register
0x11 P21PFS 8-bit — Port 21 pin function control register
0x12 P22PFS 8-bit — Port 22 pin function control register
0x17 P27PFS 8-bit — Port 27 pin function control register
0x1B P33PFS 8-bit — Port 33 pin function control register
0x1C P34PFS 8-bit — Port 34 pin function control register
0x1D P35PFS 8-bit — Port 35 pin function control register
0x20 P40PFS 8-bit — Port 40 pin function control register
0x22 P42PFS 8-bit — Port 42 pin function control register
0x24 P44PFS 8-bit — Port 44 pin function control register
0x28 P50PFS 8-bit — Port 50 pin function control register
0x29 P51PFS 8-bit — Port 51 pin function control register
0x2A P52PFS 8-bit — Port 52 pin function control register
0x2B P53PFS 8-bit — Port 53 pin function control register
0x2C P54PFS 8-bit — Port 54 pin function control register
0x2D P55PFS 8-bit — Port 55 pin function control register
0x2E P56PFS 8-bit — Port 56 pin function control register
0x30 P60PFS 8-bit — Port 60 pin function control register
0x31 P61PFS 8-bit — Port 61 pin function control register
0x32 P62PFS 8-bit — Port 62 pin function control register
0x33 P63PFS 8-bit — Port 63 pin function control register
0x34 P64PFS 8-bit — Port 64 pin function control register
0x35 P65PFS 8-bit — Port 65 pin function control register
0x39 P71PFS 8-bit — Port 71 pin function control register
0x3A P72PFS 8-bit — Port 72 pin function control register
0x3B P73PFS 8-bit — Port 73 pin function control register
0x48 P90PFS 8-bit — Port 90 pin function control register
0x49 P91PFS 8-bit — Port 91 pin function control register
0x4A P92PFS 8-bit — Port 92 pin function control register
0x4B P93PFS 8-bit — Port 93 pin function control register
0x4C P94PFS 8-bit — Port 94 pin function control register
0x4D P95PFS 8-bit — Port 95 pin function control register
0x4E P96PFS 8-bit — Port 96 pin function control register
0x4F P97PFS 8-bit — Port 97 pin function control register
{0x50+i} PA{i}PFS 8-bit (i=3..5) — Port A{i} pin function control register
0x62 PC2PFS 8-bit — Port C2 pin function control register
0x63 PC3PFS 8-bit — Port C3 pin function control register
0x66 PC6PFS 8-bit — Port C6 pin function control register
0x67 PC7PFS 8-bit — Port C7 pin function control register
{0x70+i} PE{i}PFS 8-bit (i=0..7) — Port E{i} pin function control register
{0x80+i} PG{i}PFS 8-bit (i=2..6) — Port G{i} pin function control register

## SPIBSC — SPI multi I/O bus controller
Base 0xA0005000; register names take the prefix SPIBSC_
0x00 CMNCR — Common control register
0x04 SSLDR — SSL delay register
0x08 SPBCR — Bit rate register
0x0C DRCR — Data read control register
0x10 DRCMR — Data read command setting register
0x14 DREAR — Data read extended address setting register
0x18 DROPR — Data read option setting register
0x1C DRENR — Data read enable setting register
0x20 SMCR — SPI mode control register
0x24 SMCMR — SPI mode command setting register
0x28 SMADR — SPI mode address setting register
0x2C SMOPR — SPI mode option setting register
0x30 SMENR — SPI mode enable setting register
0x38 SMRDR0 ro — SPI mode read data register 0
0x40 SMWDR0 — SPI mode write data register 0
0x48 CMNSR ro — Common status register
0x58 DRDMCR — Data read dummy cycle setting register
0x60 SMDMCR — SPI mode dummy cycle setting register

## VIC — Vectored interrupt controller
Base 0xA0010000; register names take the prefix VIC_
{0x0+4i} IRQS{i} ro (i=0..7) — IRQ status register {i}
{0x40+4i} RAIS{i} ro (i=0..7) — Interrupt input status register {i}
{0x80+4i} IEN{i} (i=0..7) — Interrupt enable register {i}
{0xA0+4i} IEC{i} wo (i=0..7) — Interrupt enable clear register {i}
{0x100+4i} PLS{i} (i=0..7) — Interrupt detection type select register {i}
{0x120+4i} PIC{i} wo (i=0..7) — Edge detection bit clear register {i}
0x1C0 PRLM0 — Interrupt priority level mask register 0
0x1C4 PRLC0 wo — Interrupt priority level mask clear register 0
0x1C8 UEN0 — User mode enable register 0
0x200 HVA0 wo — Interrupt address register 0
{0x210+4i} ISS{i} ro (i=0..7) — Interrupt service status register {i}
{0x230+4i} ISC{i} ro (i=0..7) — Interrupt service current register {i}
{0x400+4i} VAD{i} (i=1..255) — Interrupt address storage register {i}
{0x800+4i} PRL{i} (i=1..255) — Interrupt priority level storage register {i}
0x1000 IRQS8 ro — IRQ status register 8
0x1004 IRQS9 ro — IRQ status register 9
0x1040 RAIS8 ro — Interrupt input status register 8
0x1044 RAIS9 ro — Interrupt input status register 9
0x1080 IEN8 — Interrupt enable register 8
0x1084 IEN9 — Interrupt enable register 9
0x10A0 IEC8 wo — Interrupt enable clear register 8
0x10A4 IEC9 wo — Interrupt enable clear register 9
0x1100 PLS8 — Interrupt detection type select register 8
0x1104 PLS9 — Interrupt detection type select register 9
0x1120 PIC8 wo — Edge detection bit clear register 8
0x1124 PIC9 wo — Edge detection bit clear register 9
0x11C0 PRLM1 — Interrupt priority level mask register 1
0x11C4 PRLC1 wo — Interrupt priority level mask clear register 1
0x11C8 UEN1 — User mode enable register 1
0x1210 ISS8 ro — Interrupt service status register 8
0x1214 ISS9 ro — Interrupt service status register 9
0x1230 ISC8 ro — Interrupt service current register 8
0x1234 ISC9 ro — Interrupt service current register 9
{0x1000+4i} VAD{i} (i=256..300) — Interrupt address storage register {i}
{0x1400+4i} PRL{i} (i=256..300) — Interrupt priority level storage register {i}
