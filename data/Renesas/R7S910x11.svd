# R7S910x11 register map
Vendor: Renesas Electronics Corporation; Series: RZT; File version: 1.0
CPU: other r1p4, little endian, MPU, FPU, vendor SysTick, 1 interrupt priority bits
Registers are 32-bit, read-write, no defined reset value unless marked. A register's access mark holds for its fields unless they carry their own. Offsets are from the block's base; [hi:lo] are bit positions; {n}, {i} and the like mark numbered series.

## MTU — Multi-function timer pulse unit
Base 0xA006A000; register names take the prefix MTU_
0x00 MTU3_TCR 8-bit — Timer control register
0x01 MTU4_TCR 8-bit — Timer control register
0x02 MTU3_TMDR1 8-bit — Timer mode register 1
0x03 MTU4_TMDR1 8-bit — Timer mode register 1
0x04 MTU3_TIORH 8-bit — Timer I/O control register H
0x05 MTU3_TIORL 8-bit — Timer I/O control register L
0x06 MTU4_TIORH 8-bit — Timer I/O control register H
0x07 MTU4_TIORL 8-bit — Timer I/O control register L
0x08 MTU3_TIER 8-bit — Timer interrupt enable register
0x09 MTU4_TIER 8-bit — Timer interrupt enable register
0x0A MTU_TOERA 8-bit — Timer output master enable register A
0x0D MTU_TGCRA 8-bit — Timer gate control register A
0x0E MTU_TOCR1A 8-bit — Timer output control register 1A
0x0F MTU_TOCR2A 8-bit — Timer output control register 2A
0x10 MTU3_TCNT 16-bit — Timer counter
0x12 MTU4_TCNT 16-bit — Timer counter
0x14 MTU_TCDRA 16-bit — Timer cycle data register A
0x16 MTU_TDDRA 16-bit — Timer dead time data register A
0x18 MTU3_TGRA 16-bit — Timer general register A
0x1A MTU3_TGRB 16-bit — Timer general register B
0x1C MTU4_TGRA 16-bit — Timer general register A
0x1E MTU4_TGRB 16-bit — Timer general register B
0x20 MTU_TCNTSA 16-bit ro — Timer subcounter A
0x22 MTU_TCBRA 16-bit — Timer cycle buffer register A
0x24 MTU3_TGRC 16-bit — Timer general register C
0x26 MTU3_TGRD 16-bit — Timer general register D
0x28 MTU4_TGRC 16-bit — Timer general register C
0x2A MTU4_TGRD 16-bit — Timer general register D
0x2C MTU3_TSR 8-bit ro — Timer status register
0x2D MTU4_TSR 8-bit ro — Timer status register
0x30 MTU_TITCR1A 8-bit — Timer interrupt skipping set register 1A
0x31 MTU_TITCNT1A 8-bit ro — Timer interrupt skipping counter 1A
0x32 MTU_TBTERA 8-bit — Timer buffer transfer set register A
0x34 MTU_TDERA 8-bit — Timer dead time enable register A
0x36 MTU_TOLBRA 8-bit — Timer output level buffer register A
0x38 MTU3_TBTM 8-bit — Timer buffer operation transfer mode register
0x39 MTU4_TBTM 8-bit — Timer buffer operation transfer mode register
0x3A MTU_TITMRA 8-bit — Timer interrupt skipping mode register A
0x3B MTU_TITCR2A 8-bit — Timer interrupt skipping set register 2A
0x3C MTU_TITCNT2A 8-bit ro — Timer interrupt skipping counter 2A
0x40 MTU4_TADCR 16-bit — Timer A/D converter start request control register
0x44 MTU4_TADCORA 16-bit — Timer A/D converter start request cycle set register A
0x46 MTU4_TADCORB 16-bit — Timer A/D converter start request cycle set register B
0x48 MTU4_TADCOBRA 16-bit — Timer A/D converter start request cycle set buffer register A
0x4A MTU4_TADCOBRB 16-bit — Timer A/D converter start request cycle set buffer register B
0x4C MTU3_TCR2 8-bit — Timer control register 2
0x4D MTU4_TCR2 8-bit — Timer control register 2
0x60 MTU_TWCRA 8-bit — Timer waveform control register A
0x70 MTU_TMDR2A 8-bit — Timer mode register 2A
0x72 MTU3_TGRE 16-bit — Timer general register E
0x74 MTU4_TGRE 16-bit — Timer general register E
0x76 MTU4_TGRF 16-bit — Timer general register F
0x80 MTU_TSTRA 8-bit — Timer start register A
0x81 MTU_TSYRA 8-bit — Timer synchronous register A
0x82 MTU_TCSYSTR 8-bit — Timer counter synchronous start register
0x84 MTU_TRWERA 8-bit — Timer read-write enable register A
{0x90+i} MTU{i}_NFCR{i} 8-bit (i=0..4) — Noise filter control register
0x98 MTU8_NFCR8 8-bit — Noise filter control register
0x99 MTU0_NFCRC 8-bit — Noise filter control register
{0x100+0x80*i} MTU{i}_TCR 8-bit (i=0..2) — Timer control register
{0x101+0x80*i} MTU{i}_TMDR1 8-bit (i=0..2) — Timer mode register 1
0x102 MTU0_TIORH 8-bit — Timer I/O control register H
0x103 MTU0_TIORL 8-bit — Timer I/O control register L
{0x104+0x80*i} MTU{i}_TIER 8-bit (i=0..2) — Timer interrupt enable register
{0x106+0x80*i} MTU{i}_TCNT 16-bit (i=0..2) — Timer counter
{0x108+0x80*i} MTU{i}_TGRA 16-bit (i=0..2) — Timer general register A
{0x10A+0x80*i} MTU{i}_TGRB 16-bit (i=0..2) — Timer general register B
0x10C MTU0_TGRC 16-bit — Timer general register C
0x10E MTU0_TGRD 16-bit — Timer general register D
0x120 MTU0_TGRE 16-bit — Timer general register E
0x122 MTU0_TGRF 16-bit — Timer general register F
0x124 MTU0_TIER2 8-bit — Timer interrupt enable register 2
0x126 MTU0_TBTM 8-bit — Timer buffer operation transfer mode register
0x128 MTU0_TCR2 8-bit — Timer control register 2
0x182 MTU1_TIOR 8-bit — Timer I/O control register
0x185 MTU1_TSR 8-bit ro — Timer status register
0x190 MTU1_TICCR 8-bit — Timer input capture control register
0x191 MTU1_TMDR3 8-bit — Timer mode register 3
0x194 MTU1_TCR2 8-bit — Timer control register 2
0x1A0 MTU1_TCNTLW — Timer longword counter
0x1A4 MTU1_TGRALW — Timer longword general register A
0x1A8 MTU1_TGRBLW — Timer longword general register B
0x202 MTU2_TIOR 8-bit — Timer I/O control register
0x205 MTU2_TSR 8-bit ro — Timer status register
0x20C MTU2_TCR2 8-bit — Timer control register 2
0x400 MTU8_TCR 8-bit — Timer control register
0x401 MTU8_TMDR1 8-bit — Timer mode register 1
0x402 MTU8_TIORH 8-bit — Timer I/O control register H
0x403 MTU8_TIORL 8-bit — Timer I/O control register L
0x404 MTU8_TIER 8-bit — Timer interrupt enable register
0x406 MTU8_TCR2 8-bit — Timer control register 2
0x408 MTU8_TCNT — Timer counter
0x40C MTU8_TGRA — Timer general register A
0x410 MTU8_TGRB — Timer general register B
0x414 MTU8_TGRC — Timer general register C
0x418 MTU8_TGRD — Timer general register D
0x800 MTU6_TCR 8-bit — Timer control register
0x801 MTU7_TCR 8-bit — Timer control register
0x802 MTU6_TMDR1 8-bit — Timer mode register 1
0x803 MTU7_TMDR1 8-bit — Timer mode register 1
0x804 MTU6_TIORH 8-bit — Timer I/O control register H
0x805 MTU6_TIORL 8-bit — Timer I/O control register L
0x806 MTU7_TIORH 8-bit — Timer I/O control register H
0x807 MTU7_TIORL 8-bit — Timer I/O control register L
0x808 MTU6_TIER 8-bit — Timer interrupt enable register
0x809 MTU7_TIER 8-bit — Timer interrupt enable register
0x80A MTU_TOERB 8-bit — Timer output master enable register B
0x80E MTU_TOCR1B 8-bit — Timer output control register 1B
0x80F MTU_TOCR2B 8-bit — Timer output control register 2B
0x810 MTU6_TCNT 16-bit — Timer counter
0x812 MTU7_TCNT 16-bit — Timer counter
0x814 MTU_TCDRB 16-bit — Timer cycle data register B
0x816 MTU_TDDRB 16-bit — Timer dead time data register B
0x818 MTU6_TGRA 16-bit — Timer general register A
0x81A MTU6_TGRB 16-bit — Timer general register B
0x81C MTU7_TGRA 16-bit — Timer general register A
0x81E MTU7_TGRB 16-bit — Timer general register B
0x820 MTU_TCNTSB 16-bit ro — Timer subcounter B
0x822 MTU_TCBRB 16-bit — Timer cycle buffer register B
0x824 MTU6_TGRC 16-bit — Timer general register C
0x826 MTU6_TGRD 16-bit — Timer general register D
0x828 MTU7_TGRC 16-bit — Timer general register C
0x82A MTU7_TGRD 16-bit — Timer general register D
0x82C MTU6_TSR 8-bit ro — Timer status register
0x82D MTU7_TSR 8-bit ro — Timer status register
0x830 MTU_TITCR1B 8-bit — Timer interrupt skipping set register 1B
0x831 MTU_TITCNT1B 8-bit ro — Timer interrupt skipping counter 1B
0x832 MTU_TBTERB 8-bit — Timer buffer transfer set register B
0x834 MTU_TDERB 8-bit — Timer dead time enable register B
0x836 MTU_TOLBRB 8-bit — Timer output level buffer register B
0x838 MTU6_TBTM 8-bit — Timer buffer operation transfer mode register
0x839 MTU7_TBTM 8-bit — Timer buffer operation transfer mode register
0x83A MTU_TITMRB 8-bit — Timer interrupt skipping mode register B
0x83B MTU_TITCR2B 8-bit — Timer interrupt skipping set register 2B
0x83C MTU_TITCNT2B 8-bit ro — Timer interrupt skipping counter 2B
0x840 MTU7_TADCR 16-bit — Timer A/D converter start request control register
0x844 MTU7_TADCORA 16-bit — Timer A/D converter start request cycle set register A
0x846 MTU7_TADCORB 16-bit — Timer A/D converter start request cycle set register B
0x848 MTU7_TADCOBRA 16-bit — Timer A/D converter start request cycle set buffer register A
0x84A MTU7_TADCOBRB 16-bit — Timer A/D converter start request cycle set buffer register B
0x84C MTU6_TCR2 8-bit — Timer control register 2
0x84D MTU7_TCR2 8-bit — Timer control register 2
0x850 MTU6_TSYCR 8-bit — Timer synchronous clear register
0x860 MTU_TWCRB 8-bit — Timer waveform control register B
0x870 MTU_TMDR2B 8-bit — Timer mode register 2B
0x872 MTU6_TGRE 16-bit — Timer general register E
0x874 MTU7_TGRE 16-bit — Timer general register E
0x876 MTU7_TGRF 16-bit — Timer general register F
0x880 MTU_TSTRB 8-bit — Timer start register B
0x881 MTU_TSYRB 8-bit — Timer synchronous register B
0x884 MTU_TRWERB 8-bit — Timer read-write enable register B
0x893 MTU6_NFCR6 8-bit — Noise filter control register
0x894 MTU7_NFCR7 8-bit — Noise filter control register
0x895 MTU5_NFCR5 8-bit — Noise filter control register
0xA80 MTU5_TCNTU 16-bit — Timer counter U
0xA82 MTU5_TGRU 16-bit — Timer general register U
0xA84 MTU5_TCRU 8-bit — Timer control register U
0xA85 MTU5_TCR2U 8-bit — Timer control register 2U
0xA86 MTU5_TIORU 8-bit — Timer I/O control register U
0xA90 MTU5_TCNTV 16-bit — Timer counter V
0xA92 MTU5_TGRV 16-bit — Timer general register V
0xA94 MTU5_TCRV 8-bit — Timer control register V
0xA95 MTU5_TCR2V 8-bit — Timer control register 2V
0xA96 MTU5_TIORV 8-bit — Timer I/O control register V
0xAA0 MTU5_TCNTW 16-bit — Timer counter W
0xAA2 MTU5_TGRW 16-bit — Timer general register W
0xAA4 MTU5_TCRW 8-bit — Timer control register W
0xAA5 MTU5_TCR2W 8-bit — Timer control register 2W
0xAA6 MTU5_TIORW 8-bit — Timer I/O control register W
0xAB2 MTU5_TIER 8-bit — Timer interrupt enable register
0xAB4 MTU5_TSTR 8-bit — Timer start register
0xAB6 MTU5_TCNTCMPCLR 8-bit — Timer compare match clear register
