# R7F5A009 register map
Vendor: Renesas Electronics Corporation; Series: Tahoe; File version: 1
CPU: CM4 r0p4, little endian, MPU, FPU, 4 interrupt priority bits
Registers are 32-bit, read-write, no defined reset value unless marked. A register's access mark holds for its fields unless they carry their own. Offsets are from the block's base; [hi:lo] are bit positions; {n}, {i} and the like mark numbered series.

## MTU — Multi-function timer pulse unit
Base 0x400C1200; register names take the prefix MTU_
0x00 MTU3_TCR 8-bit — Timer Control Register (MTU3)
0x01 MTU4_TCR 8-bit — Timer Control Register (MTU4)
0x02 MTU3_TMDR1 8-bit — Timer Mode Register 1 (MTU3)
0x03 MTU4_TMDR1 8-bit — Timer Mode Register 1 (MTU4)
0x04 MTU3_TIORh 8-bit — Timer I/O Control Register h (MTU3)
0x05 MTU3_TIORL 8-bit — Timer I/O Control Register L (MTU3)
0x06 MTU4_TIORh 8-bit — Timer I/O Control Register h (MTU4)
0x07 MTU4_TIORL 8-bit — Timer I/O Control Register L (MTU4)
0x08 MTU3_TIER 8-bit — Timer Interrupt Enable Register (MTU3)
0x09 MTU4_TIER 8-bit — Timer Interrupt Enable Register (MTU4)
0x0A MTU_TOERA 8-bit — Timer Output Master Enable Register A
0x0D MTU_TGCRA 8-bit — Timer Gate Control Register
0x0E MTU_TOCR1A 8-bit — Timer Output Control Register 1A
0x0F MTU_TOCR2A 8-bit — Timer Output Control Register 2A
0x10 MTU3_TCNT 16-bit — Timer Counter (MTU3)
0x12 MTU4_TCNT 16-bit — Timer Counter (MTU4)
0x18 MTU3_TGRA 16-bit — Timer General Register A (MTU3)
0x1A MTU3_TGRB 16-bit — Timer General Register B (MTU3)
0x1C MTU4_TGRA 16-bit — Timer General Register A (MTU4)
0x1E MTU4_TGRB 16-bit — Timer General Register B (MTU4)
0x24 MTU3_TGRC 16-bit — Timer General Register C (MTU3)
0x26 MTU3_TGRD 16-bit — Timer General Register D (MTU3)
0x28 MTU4_TGRC 16-bit — Timer General Register C (MTU4)
0x2A MTU4_TGRD 16-bit — Timer General Register D (MTU4)
0x2C MTU3_TSR 8-bit ro — Timer Status Register (MTU3)
0x2D MTU4_TSR 8-bit ro — Timer Status Register (MTU4)
0x36 MTU_TOLBRA 8-bit — Timer Output Level Buffer Register A
0x38 MTU3_TBTM 8-bit — Timer Buffer Operation Transfer Mode Register (MTU3)
0x39 MTU4_TBTM 8-bit — Timer Buffer Operation Transfer Mode Register (MTU4)
0x40 MTU4_TADCR 16-bit — Timer A/D Converter Start Request Control Register (MTU4)
0x44 MTU4_TADCORA 16-bit — Timer A/D Converter Start Request Cycle Set Register A (MTU4)
0x46 MTU4_TADCORB 16-bit — Timer A/D Converter Start Request Cycle Set Register B (MTU4)
0x48 MTU4_TADCOBRA 16-bit — Timer A/D Converter Start Request Cycle Set Buffer Register A (MTU4)
0x4A MTU4_TADCOBRB 16-bit — Timer A/D Converter Start Request Cycle Set Buffer Register B (MTU4)
0x4C MTU3_TCR2 8-bit — Timer Control Register 2 (MTU3)
0x4D MTU4_TCR2 8-bit — Timer Control Register 2 (MTU4)
0x72 MTU3_TGRE 16-bit — Timer General Register E (MTU3)
0x74 MTU4_TGRE 16-bit — Timer General Register E (MTU4)
0x76 MTU4_TGRF 16-bit — Timer General Register F (MTU4)
0x80 MTU_TSTRA 8-bit — Timer Start Register A
0x81 MTU_TSYRA 8-bit — Timer Synchronous Register A
0x82 MTU_TCSYSTR 8-bit — Timer Counter Synchronous Start Register
0x84 MTU_TRWERA 8-bit — Timer Read/Write Enable Register A
{0x90+i} MTU{i}_NFCR{i} 8-bit (i=0..4) — Noise Filter Control Register {i} (MTU{i})
0x98 MTU8_NFCR8 8-bit — Noise Filter Control Register 8 (MTU8)
0x99 MTU0_NFCRC 8-bit — Noise Filter Control Register C (MTU0)
{0x100+0x80*i} MTU{i}_TCR 8-bit (i=0..2) — Timer Control Register (MTU{i})
{0x101+0x80*i} MTU{i}_TMDR1 8-bit (i=0..2) — Timer Mode Register 1 (MTU{i})
0x102 MTU0_TIORh 8-bit — Timer I/O Control Register h (MTU0)
0x103 MTU0_TIORL 8-bit — Timer I/O Control Register L (MTU0)
{0x104+0x80*i} MTU{i}_TIER 8-bit (i=0..2) — Timer Interrupt Enable Register (MTU{i})
{0x106+0x80*i} MTU{i}_TCNT 16-bit (i=0..2) — Timer Counter (MTU{i})
{0x108+0x80*i} MTU{i}_TGRA 16-bit (i=0..2) — Timer General Register A (MTU{i})
{0x10A+0x80*i} MTU{i}_TGRB 16-bit (i=0..2) — Timer General Register B (MTU{i})
0x10C MTU0_TGRC 16-bit — Timer General Register C (MTU0)
0x10E MTU0_TGRD 16-bit — Timer General Register D (MTU0)
0x120 MTU0_TGRE 16-bit — Timer General Register E (MTU0)
0x122 MTU0_TGRF 16-bit — Timer General Register F (MTU0)
0x124 MTU0_TIER2 8-bit — Timer Interrupt Enable Register 2 (MTU0)
0x126 MTU0_TBTM 8-bit — Timer Buffer Operation Transfer Mode Register (MTU0)
0x128 MTU0_TCR2 8-bit — Timer Control Register 2 (MTU0)
0x182 MTU1_TIOR 8-bit — Timer I/O Control Register (MTU1)
0x185 MTU1_TSR 8-bit — Timer Status Register (MTU1)
0x190 MTU1_TICCR 8-bit — Timer Input Capture Control Register (MTU1)
0x191 MTU1_TMDR3 8-bit — Timer Mode Register 3 (MTU1)
0x194 MTU1_TCR2 8-bit — Timer Control Register 2 (MTU1)
0x1A0 MTU1_TCNTLW — Timer Longword Counter (MTU1)
0x1A4 MTU1_TGRALW — Timer Longword General Register A (MTU1)
0x1A8 MTU1_TGRBLW — Timer Longword General Register B (MTU1)
0x202 MTU2_TIOR 8-bit — Timer I/O Control Register (MTU2)
0x205 MTU2_TSR 8-bit — Timer Status Register (MTU2)
0x20C MTU2_TCR2 8-bit — Timer Control Register 2 (MTU2)
0x400 MTU8_TCR 8-bit — Timer Control Register (MTU8)
0x401 MTU8_TMDR1 8-bit — Timer Mode Register 1 (MTU8)
0x402 MTU8_TIORh 8-bit — Timer I/O Control Register h (MTU8)
0x403 MTU8_TIORL 8-bit — Timer I/O Control Register L (MTU8)
0x404 MTU8_TIER 8-bit — Timer Interrupt Enable Register (MTU8)
0x406 MTU8_TCR2 8-bit — Timer Control Register 2 (MTU8)
0x408 MTU8_TCNT — Timer Counter (MTU8)
0x40C MTU8_TGRA — Timer General Register A (MTU8)
0x410 MTU8_TGRB — Timer General Register B (MTU8)
0x414 MTU8_TGRC — Timer General Register C (MTU8)
0x418 MTU8_TGRD — Timer General Register D (MTU8)
0x800 MTU6_TCR 8-bit — Timer Control Register (MTU6)
0x801 MTU7_TCR 8-bit — Timer Control Register (MTU7)
0x802 MTU6_TMDR1 8-bit — Timer Mode Register 1 (MTU6)
0x803 MTU7_TMDR1 8-bit — Timer Mode Register 1 (MTU7)
0x804 MTU6_TIORh 8-bit — Timer I/O Control Register h (MTU6)
0x805 MTU6_TIORL 8-bit — Timer I/O Control Register L (MTU6)
0x806 MTU7_TIORh 8-bit — Timer I/O Control Register h (MTU7)
0x807 MTU7_TIORL 8-bit — Timer I/O Control Register L (MTU7)
0x808 MTU6_TIER 8-bit — Timer Interrupt Enable Register (MTU6)
0x809 MTU7_TIER 8-bit — Timer Interrupt Enable Register (MTU7)
0x80A MTU_TOERB 8-bit — Timer Output Master Enable Register B
0x80E MTU_TOCR1B 8-bit — Timer Output Control Register 1B
0x80F MTU_TOCR2B 8-bit — Timer Output Control Register 2B
0x810 MTU6_TCNT 16-bit — Timer Counter (MTU6)
0x812 MTU7_TCNT 16-bit — Timer Counter (MTU7)
0x818 MTU6_TGRA 16-bit — Timer General Register A (MTU6)
0x81A MTU6_TGRB 16-bit — Timer General Register B (MTU6)
0x81C MTU7_TGRA 16-bit — Timer General Register A (MTU7)
0x81E MTU7_TGRB 16-bit — Timer General Register B (MTU7)
0x824 MTU6_TGRC 16-bit — Timer General Register C (MTU6)
0x826 MTU6_TGRD 16-bit — Timer General Register D (MTU6)
0x828 MTU7_TGRC 16-bit — Timer General Register C (MTU7)
0x82A MTU7_TGRD 16-bit — Timer General Register D (MTU7)
0x82C MTU6_TSR 8-bit ro — Timer Status Register (MTU6)
0x82D MTU7_TSR 8-bit ro — Timer Status Register (MTU7)
0x836 MTU_TOLBRB 8-bit — Timer Output Level Buffer Register B
0x838 MTU6_TBTM 8-bit — Timer Buffer Operation Transfer Mode Register (MTU6)
0x839 MTU7_TBTM 8-bit — Timer Buffer Operation Transfer Mode Register (MTU7)
0x840 MTU7_TADCR 16-bit — Timer A/D Converter Start Request Control Register (MTU7)
0x844 MTU7_TADCORA 16-bit — Timer A/D Converter Start Request Cycle Set Register A (MTU7)
0x846 MTU7_TADCORB 16-bit — Timer A/D Converter Start Request Cycle Set Register B (MTU7)
0x848 MTU7_TADCOBRA 16-bit — Timer A/D Converter Start Request Cycle Set Buffer Register A (MTU7)
0x84A MTU7_TADCOBRB 16-bit — Timer A/D Converter Start Request Cycle Set Buffer Register B (MTU7)
0x84C MTU6_TCR2 8-bit — Timer Control Register 2 (MTU6)
0x84D MTU7_TCR2 8-bit — Timer Control Register 2 (MTU7)
0x850 MTU6_TSYCR 8-bit — Timer Synchronous Clear Register (MTU6)
0x872 MTU6_TGRE 16-bit — Timer General Register E (MTU6)
0x874 MTU7_TGRE 16-bit — Timer General Register E (MTU7)
0x876 MTU7_TGRF 16-bit — Timer General Register F (MTU7)
0x880 MTU_TSTRB 8-bit — Timer Start Register B
0x881 MTU_TSYRB 8-bit — Timer Synchronous Register B
0x884 MTU_TRWERB 8-bit — Timer Read/Write Enable Register B
0x893 MTU6_NFCR6 8-bit — Noise Filter Control Register 6 (MTU6)
0x894 MTU7_NFCR7 8-bit — Noise Filter Control Register 7 (MTU7)
0x895 MTU5_NFCR5 8-bit — Noise Filter Control Register 5 (MTU5)
0xA80 MTU5_TCNTU 16-bit — Timer Counter U (MTU5)
0xA82 MTU5_TGRU 16-bit — Timer General Register U (MTU5)
0xA84 MTU5_TCRU 8-bit — Timer Control Register U (MTU5)
0xA85 MTU5_TCR2U 8-bit — Timer Control Register 2U (MTU5)
0xA86 MTU5_TIORU 8-bit — Timer I/O Control Register U (MTU5)
0xA90 MTU5_TCNTV 16-bit — Timer Counter V (MTU5)
0xA92 MTU5_TGRV 16-bit — Timer General Register V (MTU5)
0xA94 MTU5_TCRV 8-bit — Timer Control Register V (MTU5)
0xA95 MTU5_TCR2V 8-bit — Timer Control Register 2V (MTU5)
0xA96 MTU5_TIORV 8-bit — Timer I/O Control Register V (MTU5)
0xAA0 MTU5_TCNTW 16-bit — Timer Counter W (MTU5)
0xAA2 MTU5_TGRW 16-bit — Timer General Register W (MTU5)
0xAA4 MTU5_TCRW 8-bit — Timer Control Register W (MTU5)
0xAA5 MTU5_TCR2W 8-bit — Timer Control Register 2W (MTU5)
0xAA6 MTU5_TIORW 8-bit — Timer I/O Control Register W (MTU5)
0xAB2 MTU5_TIER 8-bit — Timer Interrupt Enable Register (MTU5)
0xAB4 MTU5_TSTR 8-bit — Timer Start Register (MTU5)
0xAB6 MTU5_TCNTCMPCLR 8-bit — Timer Compare Match Clear Register (MTU5)
