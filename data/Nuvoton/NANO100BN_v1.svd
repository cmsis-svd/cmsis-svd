# NANO100BN_v1 register map
File version: 1.0
NANO100BN_v1 SVD file
Registers are 32-bit, read-write, reset 0x0 unless marked. A register's access mark holds for its fields unless they carry their own. Offsets are from the block's base; lines under a group give offsets from that group; [hi:lo] are bit positions; {n}, {i} and the like mark numbered series; 'fields as' and 'values as' point back to an identical list; <NAME> marks a mode.

## Memory map
0x40004000 WDT size 0xC — WDT Register Map
0x40004100 WWDT size 0x14 — WWDT Register Map
0x40008000 RTC blocks up to offset 0x90 — RTC Register Map
0x40010000 TMR0 blocks up to offset 0x218 — TMR Register Map
0x40010100 TMR1 size 0x1C — TMR Register Map
0x40020000 I2C0 blocks up to offset 0x44 — I2C Register Map
0x40030000 SPI0 blocks up to offset 0x54 — SPI Register Map
0x40040000 PWM0 blocks up to offset 0x88 — PWM Register Map
0x40050000 UART0 blocks up to offset 0x3C — UART Register Map
0x40060000 USB blocks up to offset 0xA8 — USB Register Map
0x400A0000 DAC blocks up to offset 0x24 — DAC Register Map
0x400B0000 LCD size 0x38 — LCD Register Map
0x400D0000 SPI2 blocks up to offset 0x54 — SPI Register Map
0x400E0000 ADC blocks up to offset 0x78 — ADC Register Map
0x40110000 TMR2 size 0x1C — TMR Register Map
0x40110100 TMR3 size 0x1C — TMR Register Map
0x40120000 I2C1 blocks up to offset 0x44 — I2C Register Map
0x40130000 SPI1 blocks up to offset 0x54 — SPI Register Map
0x40140000 PWM1 blocks up to offset 0x88 — PWM Register Map
0x40150000 UART1 blocks up to offset 0x3C — UART Register Map
0x40190000 SC0 size 0x40 — SC Register Map
0x401A0000 I2S size 0x18 — I2S Register Map
0x401B0000 SC1 size 0x40 — SC Register Map
0x401C0000 SC2 size 0x40 — SC Register Map
0x50000000 GCR blocks up to offset 0x104 — GCR Register Map
0x50000200 CLK blocks up to offset 0x34 — CLK Register Map
0x50000300 INT size 0x88 — SCS Register Map
0x50004000 GP blocks up to offset 0x358 — GP Register Map
0x50008000 VDMA blocks up to offset 0x88 — VDMA Register Map
0x50008100 PDMA_CH1 blocks up to offset 0x84 — PDMA Register Map
0x50008200 PDMA_CH2 blocks up to offset 0x84 — PDMA Register Map
0x50008300 PDMA_CH3 blocks up to offset 0x84 — PDMA Register Map
0x50008400 PDMA_CH4 blocks up to offset 0x84 — PDMA Register Map
0x50008500 PDMA_CH5 blocks up to offset 0x84 — PDMA Register Map
0x50008600 PDMA_CH6 blocks up to offset 0x84 — PDMA Register Map
0x50008E00 CRC blocks up to offset 0x8C — CRC Register Map
0x50008F00 DMA_GCR size 0x10 — DMA Register Map
0x5000C000 FMC blocks up to offset 0x44 — FMC Register Map
0x50010000 EBI size 0x8 — EBI Register Map
0xE000E000 SCS blocks up to offset 0xD24 — SCS Register Map

## INT — SCS Register Map
Base 0x50000300
{0x0+4i} IRQ{i}_SRC ro reset not defined (i=0..16) — MCU IRQ{i} (BOD_INT) interrupt source identify
  [3:0] INT_SRC — Interrupt Source. Define the interrupt sources for interrupt event.
0x44 IRQ17_SRC ro reset not defined — MCU IRQ017 (BOD_INT) interrupt source identify
  fields as IRQ0_SRC
{0x0+4i} IRQ{i}_SRC ro reset not defined (i=18..31) — MCU IRQ{i} (BOD_INT) interrupt source identify
  fields as IRQ0_SRC
0x80 NMI_SEL — NMI source interrupt select control register
  [4:0] NMI_SEL — The NMI interrupt to Cortex-M0 can be selected from one of the interrupt[31:0]. The NMI_SEL bit[4:0] used to select the NMI interrupt source
0x84 MCU_IRQ — MCU interrupt request source register
  [31:0] MCU_IRQ — MCU IRQ Source Register. The MCU_IRQ collects all the interrupts from the peripherals and generates the synchronous interrupt to MCU Cortex-M0. There are two modes to generate interrupt to Cortex-M0, the normal mode and test mode. In Test mode, all the interrupts from peripheral are blocked, and the interrupts sent to MCU are replaced by set the bit31~bit0. When the MCU_IRQ[n] is "0", setting MCU_IRQ[n] "1" will generate an interrupt to Cortex_M0 NVIC[n]. When the MCU_IRQ[n] is "1" (means an interrupt is asserted), setting the MCU_bit[n] will clear the interrupt. Set MCU_IRQ[n] "0" : no any effect
