# R7S910x18 register map
Vendor: Renesas Electronics Corporation; Series: RZT; File version: 1.0
CPU: other r1p4, little endian, MPU, FPU, vendor SysTick, 1 interrupt priority bits
Registers are 32-bit, read-write, no defined reset value unless marked. A register's access mark holds for its fields unless they carry their own. Offsets are from the block's base; [hi:lo] are bit positions; {n}, {i} and the like mark numbered series.

## SCIFA0 — FIFO embedded serial communications interface 0
Base 0xA0065000; register names take the prefix SCIFA0_
0x00 SMR 16-bit — Serial mode register
0x02 BRR 8-bit — Bit rate register
0x02 MDDR 8-bit (alternate view of BRR) — Modulation duty register
0x04 SCR 16-bit — Serial control register
0x06 FTDR 8-bit wo — Transmit FIFO data register
0x08 FSR 16-bit — Serial status register
0x0A FRDR 8-bit ro — Receive FIFO data register
0x0C FCR 16-bit — FIFO control register
0x0E FDR 16-bit ro — FIFO data count register
0x10 SPTR 16-bit — Serial port register
0x12 LSR 16-bit — Line status register
0x14 SEMR 8-bit — Serial extended mode register
0x16 FTCR 16-bit — FIFO trigger control register

## SCIFA1 — FIFO embedded serial communications interface 1
Base 0xA0065400; register names take the prefix SCIFA1_
Registers as SCIFA0.

## SCIFA2 — FIFO embedded serial communications interface 2
Base 0xA0065800; register names take the prefix SCIFA2_
Registers as SCIFA0.

## SCIFA3 — FIFO embedded serial communications interface 3
Base 0xA0065C00; register names take the prefix SCIFA3_
Registers as SCIFA0.

## SCIFA4 — FIFO embedded serial communications interface 4
Base 0xA0066000; register names take the prefix SCIFA4_
Registers as SCIFA0.

## RSPI0 — Serial peripheral interface 0
Base 0xA0068000; register names take the prefix RSPI0_
0x00 SPCR 8-bit — RSPI control register
0x01 SSLP 8-bit — RSPI slave select polarity register
0x02 SPPCR 8-bit — RSPI pin control register
0x03 SPSR 8-bit — RSPI status register
0x04 SPDR — RSPI data register
0x08 SPSCR 8-bit — RSPI sequence control register
0x09 SPSSR 8-bit ro — RSPI sequence status register
0x0A SPBR 8-bit — RSPI bit rate register
0x0B SPDCR 8-bit — RSPI data control register
0x0C SPCKD 8-bit — RSPI clock delay register
0x0D SSLND 8-bit — RSPI slave select negation delay register
0x0E SPND 8-bit — RSPI next-access delay register
0x0F SPCR2 8-bit — RSPI control register 2
{0x10+2i} SPCMD{i} 16-bit (i=0..7) — RSPI command register {i}

## RSPI1 — Serial peripheral interface 1
Base 0xA0068400; register names take the prefix RSPI1_
Registers as RSPI0.

## RSPI2 — Serial peripheral interface 2
Base 0xA0068800; register names take the prefix RSPI2_
Registers as RSPI0.

## RSPI3 — Serial peripheral interface 3
Base 0xA0068C00; register names take the prefix RSPI3_
Registers as RSPI0.

## DSMIF — Delta sigma interface
Base 0xA0072000; register names take the prefix DSMIF_
0x00 UVWCTL — UVW control register
0x04 UVWSTA — UVW status register
0x08 UVWIUNCMP — UVW overcurrent abnormality detection lower limit setting register
0x0C UVWIOVCMP — UVW overcurrent abnormality detection upper limit setting register
0x10 UVWSCUNCMP — UVW short abnormality detection 0 data input threshold setting register
0x14 UVWSCOVCMP — UVW short abnormality detection 1 data input threshold setting register
0x18 UVWIGUNCMP — UVW total current abnormality detection lower limit setting register
0x1C UVWIGOVCMP — UVW total current abnormality detection upper limit setting register
0x20 U1DATA ro — Channel U current value register 1
0x24 U1CDATA ro — Channel U current value peak trigger capture register 1
0x28 U1VDATA ro — Channel U current value valley trigger capture register 1
0x2C U2DATA ro — Channel U current value register 2
0x30 V1DATA ro — Channel V current value register 1
0x34 V1CDATA ro — Channel V current value 1 peak trigger capture register
0x38 V1VDATA ro — Channel V current value 1 valley trigger capture register
0x3C V2DATA ro — Channel V current value register 2
0x40 W1DATA ro — Channel W current value register 1
0x44 W1CDATA ro — Channel W current value 1 peak trigger capture register
0x48 W1VDATA ro — Channel W current value 1 valley trigger capture register
0x4C W2DATA ro — Channel W current value register 2
0x80 XYZCTL — XYZ control register
0x84 XYZSTA — XYZ status register
0x90 XYZSCUNCMP — XYZ short abnormality detection 0 data input threshold setting register
0x94 XYZSCOVCMP — XYZ short abnormality detection 1 data input threshold setting register
0x98 XYZIUNCMP — XYZ overcurrent abnormality detection lower limit setting register
0x9C XYZIOVCMP — XYZ overcurrent abnormality detection upper limit setting register
0xA0 X1DATA ro — Channel X current value register 1
0xA4 X1CDATA ro — Channel X current value peak trigger capture register 1
0xA8 X1VDATA ro — Channel X current value valley trigger capture register 1
0xAC X2DATA ro — Channel X current value register 2
