# RZ_A1LC register map
Vendor: Renesas Electronics Corporation.; Series: RZ; File version: 3
CPU: other r3p0, little endian, MPU, no FPU, 3 interrupt priority bits
Registers are 32-bit, read-write, no defined reset value unless marked. A register's access mark holds for its fields unless they carry their own. Offsets are from the block's base; [hi:lo] are bit positions; {n}, {i} and the like mark numbered series.

## SCUX
Base 0xE8208000
{0x0+0x100*i} IPCIR_IPC0_{i} (i=0..3)
{0x4+0x100*i} IPSLR_IPC0_{i} (i=0..3)
{0x400+0x100*i} OPCIR_OPC0_{i} (i=0..3)
{0x404+0x100*i} OPSLR_OPC0_{i} (i=0..3)
{0x800+0x100*i} FFDIR_FFD0_{i} (i=0..3)
{0x804+0x100*i} FDAIR_FFD0_{i} (i=0..3)
{0x808+0x100*i} DRQSR_FFD0_{i} (i=0..3)
{0x80C+0x100*i} FFDPR_FFD0_{i} (i=0..3)
{0x810+0x100*i} FFDBR_FFD0_{i} (i=0..3)
{0x814+0x100*i} DEVMR_FFD0_{i} (i=0..3)
{0x81C+0x100*i} DEVCR_FFD0_{i} (i=0..3)
{0xC00+0x100*i} FFUIR_FFU0_{i} (i=0..3)
{0xC04+0x100*i} FUAIR_FFU0_{i} (i=0..3)
{0xC08+0x100*i} URQSR_FFU0_{i} (i=0..3)
{0xC0C+0x100*i} FFUPR_FFU0_{i} (i=0..3)
{0xC10+0x100*i} UEVMR_FFU0_{i} (i=0..3)
{0xC18+0x100*i} UEVCR_FFU0_{i} (i=0..3)
0x1000 SRCIR0_2SRC0_0
0x1004 SADIR0_2SRC0_0
0x1008 SRCBR0_2SRC0_0
0x100C IFSCR0_2SRC0_0
0x1010 IFSVR0_2SRC0_0
0x1014 SRCCR0_2SRC0_0
0x1018 MNFSR0_2SRC0_0
0x101C BFSSR0_2SRC0_0
0x1020 SC2SR0_2SRC0_0
0x1024 WATSR0_2SRC0_0
0x1028 SEVMR0_2SRC0_0
0x1030 SEVCR0_2SRC0_0
0x1034 SRCIR1_2SRC0_0
0x1038 SADIR1_2SRC0_0
0x103C SRCBR1_2SRC0_0
0x1040 IFSCR1_2SRC0_0
0x1044 IFSVR1_2SRC0_0
0x1048 SRCCR1_2SRC0_0
0x104C MNFSR1_2SRC0_0
0x1050 BFSSR1_2SRC0_0
0x1054 SC2SR1_2SRC0_0
0x1058 WATSR1_2SRC0_0
0x105C SEVMR1_2SRC0_0
0x1064 SEVCR1_2SRC0_0
0x1068 SRCIRR_2SRC0_0
0x1100 SRCIR0_2SRC0_1
0x1104 SADIR0_2SRC0_1
0x1108 SRCBR0_2SRC0_1
0x110C IFSCR0_2SRC0_1
0x1110 IFSVR0_2SRC0_1
0x1114 SRCCR0_2SRC0_1
0x1118 MNFSR0_2SRC0_1
0x111C BFSSR0_2SRC0_1
0x1120 SC2SR0_2SRC0_1
0x1124 WATSR0_2SRC0_1
0x1128 SEVMR0_2SRC0_1
0x1130 SEVCR0_2SRC0_1
0x1134 SRCIR1_2SRC0_1
0x1138 SADIR1_2SRC0_1
0x113C SRCBR1_2SRC0_1
0x1140 IFSCR1_2SRC0_1
0x1144 IFSVR1_2SRC0_1
0x1148 SRCCR1_2SRC0_1
0x114C MNFSR1_2SRC0_1
0x1150 BFSSR1_2SRC0_1
0x1154 SC2SR1_2SRC0_1
0x1158 WATSR1_2SRC0_1
0x115C SEVMR1_2SRC0_1
0x1164 SEVCR1_2SRC0_1
0x1168 SRCIRR_2SRC0_1
{0x1200+0x100*i} DVUIR_DVU0_{i} (i=0..3)
{0x1204+0x100*i} VADIR_DVU0_{i} (i=0..3)
{0x1208+0x100*i} DVUBR_DVU0_{i} (i=0..3)
{0x120C+0x100*i} DVUCR_DVU0_{i} (i=0..3)
{0x1210+0x100*i} ZCMCR_DVU0_{i} (i=0..3)
{0x1214+0x100*i} VRCTR_DVU0_{i} (i=0..3)
{0x1218+0x100*i} VRPDR_DVU0_{i} (i=0..3)
{0x121C+0x100*i} VRDBR_DVU0_{i} (i=0..3)
{0x1220+0x100*i} VRWTR_DVU0_{i} (i=0..3)
{0x1224+4i} VOL{i}R_DVU0_0 (i=0..7)
{0x1244+0x100*i} DVUER_DVU0_{i} (i=0..3)
{0x1248+0x100*i} DVUSR_DVU0_{i} (i=0..3)
{0x124C+0x100*i} VEVMR_DVU0_{i} (i=0..3)
{0x1254+0x100*i} VEVCR_DVU0_{i} (i=0..3)
{0x1324+4i} VOL{i}R_DVU0_1 (i=0..7)
{0x1424+4i} VOL{i}R_DVU0_2 (i=0..7)
{0x1524+4i} VOL{i}R_DVU0_3 (i=0..7)
0x1600 MIXIR_MIX0_0
0x1604 MADIR_MIX0_0
0x1608 MIXBR_MIX0_0
0x160C MIXMR_MIX0_0
0x1610 MVPDR_MIX0_0
0x1614 MDBAR_MIX0_0
0x1618 MDBBR_MIX0_0
0x161C MDBCR_MIX0_0
0x1620 MDBDR_MIX0_0
0x1624 MDBER_MIX0_0
0x1628 MIXSR_MIX0_0
0x1700 SWRSR_CIM
0x1704 DMACR_CIM
{0x1708+4i} DMATD{i}_CIM (i=0..3)
{0x1718+4i} DMATU{i}_CIM (i=0..3)
0x1738 SSIRSEL_CIM
{0x173C+4i} FDTSEL{i}_CIM (i=0..3)
{0x174C+4i} FUTSEL{i}_CIM (i=0..3)
0x175C SSIPMD_CIM
0x1760 SSICTRL_CIM
{0x1764+4i} SRCRSEL{i}_CIM (i=0..3)
0x1774 MIXRSEL_CIM

## SSIF0
Base 0xE820B000
0x00 SSICR_0
0x04 SSISR_0
0x10 SSIFCR_0
0x14 SSIFSR_0
0x18 SSIFTDR_0
0x1C SSIFRDR_0
0x20 SSITDMR_0
0x24 SSIFCCR_0
0x28 SSIFCMR_0
0x2C SSIFCSR_0

## SSIF1
Base 0xE820B800
0x00 SSICR_1
0x04 SSISR_1
0x10 SSIFCR_1
0x14 SSIFSR_1
0x18 SSIFTDR_1
0x1C SSIFRDR_1
0x20 SSITDMR_1
0x24 SSIFCCR_1
0x28 SSIFCMR_1
0x2C SSIFCSR_1

## SSIF2
Base 0xE820C000
0x00 SSICR_2
0x04 SSISR_2
0x10 SSIFCR_2
0x14 SSIFSR_2
0x18 SSIFTDR_2
0x1C SSIFRDR_2
0x20 SSITDMR_2
0x24 SSIFCCR_2
0x28 SSIFCMR_2
0x2C SSIFCSR_2

## SSIF3
Base 0xE820C800
0x00 SSICR_3
0x04 SSISR_3
0x10 SSIFCR_3
0x14 SSIFSR_3
0x18 SSIFTDR_3
0x1C SSIFRDR_3
0x20 SSITDMR_3
0x24 SSIFCCR_3
0x28 SSIFCMR_3
0x2C SSIFCSR_3
