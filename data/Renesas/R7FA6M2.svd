# RA6M2 register map
Vendor: Renesas Electronics Corporation; Series: RA6; File version: 1.1
ARM 32-bit Cortex-M23 Microcontroller based device, CPU clock up to 48MHz, etc.
CPU: CM4 r0p1, little endian, MPU, FPU, VTOR, 4 interrupt priority bits
Registers are 8-bit, read-write, reset 0x0 unless marked. A register's access mark holds for its fields unless they carry their own. Offsets are from the block's base; lines under a group give offsets from that group; [hi:lo] are bit positions; {n}, {i} and the like mark numbered series; 'fields as' and 'values as' point back to an identical list; <NAME> marks a mode.

## Memory map
0x40000000 MMPU blocks up to offset 0x800 — Bus Master MPU
0x40000C00 SMPU blocks up to offset 0x3A — Bus Slave MPU
0x40000D00 SPMON blocks up to offset 0x20 — CPU Stack Pointer Monitor
0x40001000 MMF size 0x8 — Memory Mirror Function
0x40002000 SRAM blocks up to offset 0xD9 — SRAM Control
0x40003000 BUS blocks up to offset 0x1854 — BUS Control
{0x40005000+0x40*n} DMAC{n} blocks up to offset 0x1F (n=0..7) — Direct memory access controller {n}
0x40005200 DMA size 0x1 — DMAC Module Activation
0x40005400 DTC blocks up to offset 0x10 — Data Transfer Controller
0x40006000 ICU blocks up to offset 0x480 — Interrupt Controller
0x4001B000 DBG blocks up to offset 0x24 — Debug Function
0x4001C000 FCACHE blocks up to offset 0x140 — Flash Cache
0x4001E000 SYSTEM blocks up to offset 0x700 — System Control
0x40040000 PORT0 blocks up to offset 0xC — Port 0 Control Registers
0x40040020 PORT1 blocks up to offset 0x10 — Port 1 Control Registers
0x40040040 PORT2 blocks up to offset 0x10 — Port 2 Control Registers
0x40040060 PORT3 blocks up to offset 0x10 — Port 3 Control Registers
0x40040080 PORT4 blocks up to offset 0x10 — Port 4 Control Registers
0x400400A0 PORT5 blocks up to offset 0xC — Port 5 Control Registers
0x400400C0 PORT6 blocks up to offset 0xC — Port 6 Control Registers
0x400400E0 PORT7 blocks up to offset 0xC — Port 7 Control Registers
0x40040100 PORT8 blocks up to offset 0xC — Port 8 Control Registers
0x40040800 PFS blocks up to offset 0x20B — Pmn Pin Function Control Register
0x40040D00 PMISC size 0x4 — Miscellaneous Port Control Register
0x40041000 ELC blocks up to offset 0x5C — Event Link Controller
0x40042000 POEG size 0x400 — Port Output Enable Module for GPT
0x40044000 RTC blocks up to offset 0x8C — Realtime Clock
0x40044200 WDT blocks up to offset 0x9 — Watchdog Timer
0x40044400 IWDT blocks up to offset 0x6 — Independent Watchdog Timer
0x40044600 CAC blocks up to offset 0xC — Clock Frequency Accuracy Measurement Circuit
0x40047000 MSTP size 0xC — Module Stop Control B,C,D
0x40048000 SRCRAM size 0x56C0 — Sampling Rate Converter RAM
0x4004DFF0 SRC size 0x10 — Sampling Rate Converter
0x4004E000 SSIE0 blocks up to offset 0x28 — Serial Sound Interface Enhanced (SSIE)
0x40050000 CAN0 blocks up to offset 0x859 — CAN0 Module
0x40051000 CAN1 blocks up to offset 0x859 — CAN1 Module
0x40053000 IIC0 blocks up to offset 0x18 — Inter-Integrated Circuit 0
0x40053100 IIC1 blocks up to offset 0x16 — Inter-Integrated Circuit 1
0x40053200 IIC2 blocks up to offset 0x16 — Inter-Integrated Circuit 2
0x40054100 DOC blocks up to offset 0x6 — Data Operation Circuit
0x4005C000 ADC120 blocks up to offset 0x1E1 — 12bit A/D Converter 0
0x4005C200 ADC121 blocks up to offset 0x1E1 — 12bit A/D Converter 1
0x4005D000 TSN size 0x1 — Temperature Sensor
0x4005E000 DAC12 blocks up to offset 0x10C1 — 12-bit D/A converter
0x40062000 SDHI0 blocks up to offset 0x200 — SD Host Interface 0
0x40062400 SDHI1 blocks up to offset 0x200 — SD Host Interface 1
0x40064000 EDMAC0 blocks up to offset 0xDC — DMA Controller for the Ethernet Controller Channel 0
0x40064100 ETHERC0 blocks up to offset 0x1974 — Ethernet Controller Channel 0
{0x40070000+0x20*n} SCI{n} blocks up to offset 0x1D (n=0..9) — Serial Communication Interface {n}
0x40070F00 IRDA size 0x1 — Infrared Data Association
0x40072000 SPI0 blocks up to offset 0x21 — Serial Peripheral Interface 0
0x40072100 SPI1 blocks up to offset 0x21 — Serial Peripheral Interface 1
0x40074000 CRC blocks up to offset 0xE — CRC Calculator
0x40078000 GPT32EH0 blocks up to offset 0xA4 — General PWM Timer 0 (32-bit Enhanced High Resolution)
0x40078100 GPT32EH1 blocks up to offset 0xA4 — General PWM Timer 1 (32-bit Enhanced High Resolution)
0x40078200 GPT32EH2 blocks up to offset 0xA4 — General PWM Timer 2 (32-bit Enhanced High Resolution)
0x40078300 GPT32EH3 blocks up to offset 0xA4 — General PWM Timer 3 (32-bit Enhanced High Resolution)
0x40078400 GPT32E4 blocks up to offset 0xA4 — General PWM Timer 4 (32-bit Enhanced)
0x40078500 GPT32E5 blocks up to offset 0xA4 — General PWM Timer 5 (32-bit Enhanced)
0x40078600 GPT32E6 blocks up to offset 0xA4 — General PWM Timer 6 (32-bit Enhanced)
0x40078700 GPT32E7 blocks up to offset 0xA4 — General PWM Timer 7 (32-bit Enhanced)
0x40078800 GPT328 blocks up to offset 0xA4 — General PWM Timer 8 (32-bit Enhanced)
0x40078900 GPT329 blocks up to offset 0xA4 — General PWM Timer 9 (32-bit Enhanced)
0x40078A00 GPT3210 blocks up to offset 0xA4 — General PWM Timer 10 (32-bit Enhanced)
0x40078B00 GPT3211 blocks up to offset 0xA4 — General PWM Timer 11 (32-bit Enhanced)
0x40078C00 GPT3212 blocks up to offset 0xA4 — General PWM Timer 12 (32-bit Enhanced)
0x40078D00 GPT3213 blocks up to offset 0xA4 — General PWM Timer 13 (32-bit Enhanced)
0x40078FF0 GPT_OPS size 0x4 — Output Phase Switching Controller
0x4007B000 GPT_ODC blocks up to offset 0x3A — PWM Delay Generation Circuit
0x40080000 KINT blocks up to offset 0x9 — Key Interrupt Function
0x40081000 CTSU blocks up to offset 0x1E — Capacitive Touch Sensing Unit
0x40084000 AGT0 blocks up to offset 0x10 — Asynchronous General purpose Timer 0
0x40084100 AGT1 blocks up to offset 0x10 — Asynchronous General purpose Timer 1
0x40085000 ACMPHS0 blocks up to offset 0x11 — High-Speed Analog Comparator 0
0x40085100 ACMPHS1 blocks up to offset 0x11 — High-Speed Analog Comparator 1
0x40085200 ACMPHS2 blocks up to offset 0x11 — High-Speed Analog Comparator 2
0x40085300 ACMPHS3 blocks up to offset 0x11 — High-Speed Analog Comparator 3
0x40085400 ACMPHS4 blocks up to offset 0x11 — High-Speed Analog Comparator 4
0x40085500 ACMPHS5 blocks up to offset 0x11 — High-Speed Analog Comparator 5
0x40090000 USBFS blocks up to offset 0x408 — USB 2.0 FS Module
0x40094000 PDC size 0x1C — Parallel Data Capture Unit
0x64000000 QSPI blocks up to offset 0x80C — Quad-SPI

## Interrupts
{n} IEL{n} (ICU) (n=0..95) — ICU Interrupt {n}

## Licence text in the file
This software is supplied by Renesas Electronics Corporation and is only intended for use with Renesas products. No other uses are authorized. This software is owned by. Renesas Electronics Corporation and is protected under all applicable laws, including copyright laws. . THIS SOFTWARE IS PROVIDED "AS IS" AND RENESAS MAKES NO WARRANTIES REGARDING. THIS SOFTWARE, WHETHER EXPRESS, IMPLIED OR STATUTORY, INCLUDING BUT NOT LIMITED TO. WARRANTIES OF MERCHANTABILITY, FITNESS FOR A PARTICULAR PURPOSE AND NON-INFRINGEMENT. ALL SUCH WARRANTIES ARE EXPRESSLY DISCLAIMED. TO THE MAXIMUM EXTENT PERMITTED NOT. PROHIBITED BY LAW, NEITHER RENESAS ELECTRONICS CORPORATION NOR ANY OF ITS AFFILIATED. COMPANIES SHALL BE LIABLE FOR ANY DIRECT, INDIRECT, SPECIAL, INCIDENTAL OR CONSEQUENTIAL. DAMAGES FOR ANY REASON RELATED TO THIS SOFTWARE, EVEN IF RENESAS OR ITS AFFILIATES HAVE. BEEN ADVISED OF THE POSSIBILITY OF SUCH DAMAGES. . Renesas reserves the right, without notice, to make changes to this software and to discontinue the availability of this software. By using this software, you agree to the additional terms and conditions found by accessing the following link: http://www.renesas.com/disclaimer
