# RZA1H register map
File version: 1.00
Registers are 32-bit, read-write, no defined reset value unless marked. A register's access mark holds for its fields unless they carry their own. Offsets are from the block's base; [hi:lo] are bit positions; {n}, {i} and the like mark numbered series.

## RSCAN0
Base 0xE803A000
{0x0+0x10*i} RSCAN0C{i}CFG (i=0..5)
{0x4+0x10*i} RSCAN0C{i}CTR (i=0..5)
{0x8+0x10*i} RSCAN0C{i}STS (i=0..5)
{0xC+0x10*i} RSCAN0C{i}ERFL (i=0..5)
0x84 RSCAN0GCFG
0x88 RSCAN0GCTR
0x8C RSCAN0GSTS
0x90 RSCAN0GERFL
0x94 RSCAN0GTSC
0x98 RSCAN0GAFLECTR
0x9C RSCAN0GAFLCFG0
0xA0 RSCAN0GAFLCFG1
0xA4 RSCAN0RMNB
{0xA8+4i} RSCAN0RMND{i} (i=0..2)
{0xB8+4i} RSCAN0RFCC{i} (i=0..7)
{0xD8+4i} RSCAN0RFSTS{i} (i=0..7)
{0xF8+4i} RSCAN0RFPCTR{i} (i=0..7)
{0x118+4i} RSCAN0CFCC{i} (i=0..17)
{0x178+4i} RSCAN0CFSTS{i} (i=0..17)
{0x1D8+4i} RSCAN0CFPCTR{i} (i=0..17)
0x238 RSCAN0FESTS
0x23C RSCAN0FFSTS
0x240 RSCAN0FMSTS
0x244 RSCAN0RFISTS
0x248 RSCAN0CFRISTS
0x24C RSCAN0CFTISTS
{0x250+i} RSCAN0TMC{i} 8-bit (i=0..95)
{0x2D0+i} RSCAN0TMSTS{i} 8-bit (i=0..95)
{0x350+4i} RSCAN0TMTRSTS{i} (i=0..2)
{0x360+4i} RSCAN0TMTARSTS{i} (i=0..2)
{0x370+4i} RSCAN0TMTCSTS{i} (i=0..2)
{0x380+4i} RSCAN0TMTASTS{i} (i=0..2)
{0x390+4i} RSCAN0TMIEC{i} (i=0..2)
{0x3A0+4i} RSCAN0TXQCC{i} (i=0..5)
{0x3C0+4i} RSCAN0TXQSTS{i} (i=0..5)
{0x3E0+4i} RSCAN0TXQPCTR{i} (i=0..5)
{0x400+4i} RSCAN0THLCC{i} (i=0..5)
{0x420+4i} RSCAN0THLSTS{i} (i=0..5)
{0x440+4i} RSCAN0THLPCTR{i} (i=0..5)
0x460 RSCAN0GTINTSTS0
0x464 RSCAN0GTINTSTS1
0x468 RSCAN0GTSTCFG
0x46C RSCAN0GTSTCTR
0x47C RSCAN0GLOCKK
{0x500+0x10*i} RSCAN0GAFLID{i} (i=0..15)
{0x504+0x10*i} RSCAN0GAFLM{i} (i=0..15)
{0x508+0x10*i} RSCAN0GAFLP{i:02} (i=0..9)
0x50C RSCAN0GAFLP10
0x51C RSCAN0GAFLP11
0x52C RSCAN0GAFLP12
0x53C RSCAN0GAFLP13
0x54C RSCAN0GAFLP14
0x55C RSCAN0GAFLP15
{0x46C+0x10*i} RSCAN0GAFLP{i} (i=16..19)
0x5A8 RSCAN0GAFLP010
0x5AC RSCAN0GAFLP110
0x5B8 RSCAN0GAFLP011
0x5BC RSCAN0GAFLP111
0x5C8 RSCAN0GAFLP012
0x5CC RSCAN0GAFLP112
0x5D8 RSCAN0GAFLP013
0x5DC RSCAN0GAFLP113
0x5E8 RSCAN0GAFLP014
0x5EC RSCAN0GAFLP114
0x5F8 RSCAN0GAFLP015
0x5FC RSCAN0GAFLP115
{0x600+0x10*i} RSCAN0RMID{i} (i=0..95)
{0x604+0x10*i} RSCAN0RMPTR{i} (i=0..95)
{0x608+0x10*i} RSCAN0RMDF{i:02} (i=0..9)
0x60C RSCAN0RMDF10
0x61C RSCAN0RMDF11
0x62C RSCAN0RMDF12
0x63C RSCAN0RMDF13
0x64C RSCAN0RMDF14
0x65C RSCAN0RMDF15
0x66C RSCAN0RMDF16
0x67C RSCAN0RMDF17
0x68C RSCAN0RMDF18
0x69C RSCAN0RMDF19
0x6A8 RSCAN0RMDF010
0x6AC RSCAN0RMDF110
0x6B8 RSCAN0RMDF011
0x6BC RSCAN0RMDF111
0x6C8 RSCAN0RMDF012
0x6CC RSCAN0RMDF112
0x6D8 RSCAN0RMDF013
0x6DC RSCAN0RMDF113
0x6E8 RSCAN0RMDF014
0x6EC RSCAN0RMDF114
0x6F8 RSCAN0RMDF015
0x6FC RSCAN0RMDF115
0x708 RSCAN0RMDF016
0x70C RSCAN0RMDF116
0x718 RSCAN0RMDF017
0x71C RSCAN0RMDF117
0x728 RSCAN0RMDF018
0x72C RSCAN0RMDF118
{0x608+0x10*i} RSCAN0RMDF{i:03} (i=19..95)
0x73C RSCAN0RMDF119
0x74C RSCAN0RMDF120
0x75C RSCAN0RMDF121
0x76C RSCAN0RMDF122
0x77C RSCAN0RMDF123
0x78C RSCAN0RMDF124
0x79C RSCAN0RMDF125
0x7AC RSCAN0RMDF126
0x7BC RSCAN0RMDF127
0x7CC RSCAN0RMDF128
0x7DC RSCAN0RMDF129
0x7EC RSCAN0RMDF130
0x7FC RSCAN0RMDF131
0x80C RSCAN0RMDF132
0x81C RSCAN0RMDF133
0x82C RSCAN0RMDF134
0x83C RSCAN0RMDF135
0x84C RSCAN0RMDF136
0x85C RSCAN0RMDF137
0x86C RSCAN0RMDF138
0x87C RSCAN0RMDF139
0x88C RSCAN0RMDF140
0x89C RSCAN0RMDF141
0x8AC RSCAN0RMDF142
0x8BC RSCAN0RMDF143
0x8CC RSCAN0RMDF144
0x8DC RSCAN0RMDF145
0x8EC RSCAN0RMDF146
0x8FC RSCAN0RMDF147
0x90C RSCAN0RMDF148
0x91C RSCAN0RMDF149
0x92C RSCAN0RMDF150
0x93C RSCAN0RMDF151
0x94C RSCAN0RMDF152
0x95C RSCAN0RMDF153
0x96C RSCAN0RMDF154
0x97C RSCAN0RMDF155
0x98C RSCAN0RMDF156
0x99C RSCAN0RMDF157
0x9AC RSCAN0RMDF158
0x9BC RSCAN0RMDF159
0x9CC RSCAN0RMDF160
0x9DC RSCAN0RMDF161
0x9EC RSCAN0RMDF162
0x9FC RSCAN0RMDF163
0xA0C RSCAN0RMDF164
0xA1C RSCAN0RMDF165
0xA2C RSCAN0RMDF166
0xA3C RSCAN0RMDF167
0xA4C RSCAN0RMDF168
0xA5C RSCAN0RMDF169
0xA6C RSCAN0RMDF170
0xA7C RSCAN0RMDF171
0xA8C RSCAN0RMDF172
0xA9C RSCAN0RMDF173
0xAAC RSCAN0RMDF174
0xABC RSCAN0RMDF175
0xACC RSCAN0RMDF176
0xADC RSCAN0RMDF177
0xAEC RSCAN0RMDF178
0xAFC RSCAN0RMDF179
0xB0C RSCAN0RMDF180
0xB1C RSCAN0RMDF181
0xB2C RSCAN0RMDF182
0xB3C RSCAN0RMDF183
0xB4C RSCAN0RMDF184
0xB5C RSCAN0RMDF185
0xB6C RSCAN0RMDF186
0xB7C RSCAN0RMDF187
0xB8C RSCAN0RMDF188
0xB9C RSCAN0RMDF189
0xBAC RSCAN0RMDF190
0xBBC RSCAN0RMDF191
0xBCC RSCAN0RMDF192
0xBDC RSCAN0RMDF193
0xBEC RSCAN0RMDF194
0xBFC RSCAN0RMDF195
{0xE00+0x10*i} RSCAN0RFID{i} (i=0..7)
{0xE04+0x10*i} RSCAN0RFPTR{i} (i=0..7)
{0xE08+0x10*i} RSCAN0RFDF{i:02} (i=0..7)
{0xD6C+0x10*i} RSCAN0RFDF{i} (i=10..17)
{0xE80+0x10*i} RSCAN0CFID{i} (i=0..17)
{0xE84+0x10*i} RSCAN0CFPTR{i} (i=0..17)
{0xE88+0x10*i} RSCAN0CFDF{i:02} (i=0..9)
0xE8C RSCAN0CFDF10
0xE9C RSCAN0CFDF11
0xEAC RSCAN0CFDF12
0xEBC RSCAN0CFDF13
0xECC RSCAN0CFDF14
0xEDC RSCAN0CFDF15
0xEEC RSCAN0CFDF16
0xEFC RSCAN0CFDF17
0xF0C RSCAN0CFDF18
0xF1C RSCAN0CFDF19
0xF28 RSCAN0CFDF010
{0x84C+0x10*i} RSCAN0CFDF{i} (i=110..117)
0xF38 RSCAN0CFDF011
0xF48 RSCAN0CFDF012
0xF58 RSCAN0CFDF013
0xF68 RSCAN0CFDF014
0xF78 RSCAN0CFDF015
0xF88 RSCAN0CFDF016
0xF98 RSCAN0CFDF017
{0x1000+0x10*i} RSCAN0TMID{i} (i=0..95)
{0x1004+0x10*i} RSCAN0TMPTR{i} (i=0..95)
{0x1008+0x10*i} RSCAN0TMDF{i:02} (i=0..9)
0x100C RSCAN0TMDF10
0x101C RSCAN0TMDF11
0x102C RSCAN0TMDF12
0x103C RSCAN0TMDF13
0x104C RSCAN0TMDF14
0x105C RSCAN0TMDF15
0x106C RSCAN0TMDF16
0x107C RSCAN0TMDF17
0x108C RSCAN0TMDF18
0x109C RSCAN0TMDF19
0x10A8 RSCAN0TMDF010
{0x9CC+0x10*i} RSCAN0TMDF{i} (i=110..195)
0x10B8 RSCAN0TMDF011
0x10C8 RSCAN0TMDF012
0x10D8 RSCAN0TMDF013
0x10E8 RSCAN0TMDF014
0x10F8 RSCAN0TMDF015
0x1108 RSCAN0TMDF016
0x1118 RSCAN0TMDF017
0x1128 RSCAN0TMDF018
{0x1008+0x10*i} RSCAN0TMDF{i:03} (i=19..95)
{0x1800+4i} RSCAN0THLACC{i} (i=0..5)
{0x1900+4i} RSCAN0RPGACC{i} (i=0..63)
