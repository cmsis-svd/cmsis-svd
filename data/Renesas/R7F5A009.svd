# R7F5A009 register map
Vendor: Renesas Electronics Corporation; Series: Tahoe; File version: 1
CPU: CM4 r0p4, little endian, MPU, FPU, 4 interrupt priority bits
Registers are 32-bit, read-write, no defined reset value unless marked. A register's access mark holds for its fields unless they carry their own. Offsets are from the block's base; [hi:lo] are bit positions; {n}, {i} and the like mark numbered series.

## TSN — Temperature sensor
Base 0x4008C500; register names take the prefix TSN_
0x00 TSCR 8-bit — Temperature Sensor Control Register

## CMT2_0 — Compare match timer
Base 0x40094200; register names take the prefix CMT2_0_
0x00 CMT2_0_CM2STR 16-bit — Timer Start Register
0x04 CMT2_0_CM2CR 16-bit — Timer Control Register
0x08 CMT2_0_CM2IOR 16-bit — Timer I/O Control Register
0x10 CMT2_0_CM2CNT — Timer Counter
0x14 CMT2_0_CM2COR — Compare Match Constant Register
0x18 CMT2_0_CM2ICR0 ro — Input Capture Register 0
0x1C CMT2_0_CM2ICR1 ro — Input Capture Register 1
0x20 CMT2_0_CM2OCR0 — Output Compare Register 0
0x24 CMT2_0_CM2OCR1 — Output Compare Register 1

## CMT2_1 — Compare match timer
Base 0x40094280; register names take the prefix CMT2_1_
Registers as CMT2_0 (with CMT2_0 read as CMT2_1).

## CMT2_2 — Compare match timer
Base 0x40094300; register names take the prefix CMT2_2_
Registers as CMT2_0 (with CMT2_0 read as CMT2_2).

## CMT2_3 — Compare match timer
Base 0x40094380; register names take the prefix CMT2_3_
Registers as CMT2_0 (with CMT2_0 read as CMT2_3).

## RSPI0 — Serial peripheral interface 0
Base 0x400D0100; register names take the prefix RSPI0_
0x00 SPCR 8-bit — RSPI Control Register
0x01 SSLP 8-bit — RSPI Slave Select Polarity Register
0x02 SPPCR 8-bit — RSPI Pin Control Register
0x03 SPSR 8-bit — RSPI Status Register
0x04 SPDR — RSPI Data Register
0x08 SPSCR 8-bit — RSPI Sequence Control Register
0x09 SPSSR 8-bit ro — RSPI Sequence Status Register
0x0A SPBR 8-bit — RSPI Bit Rate Register
0x0B SPDCR 8-bit — RSPI Data Control Register
0x0C SPCKD 8-bit — RSPI Clock Delay Register
0x0D SSLND 8-bit — RSPI Slave Select Negation Delay Register
0x0E SPND 8-bit — RSPI Next-Access Delay Register
0x0F SPCR2 8-bit — RSPI Control Register 2
{0x10+2i} SPCMD{i} 16-bit (i=0..7) — RSPI Command Register {i}

## RSPI1 — Serial peripheral interface 1
Base 0x400D0120; register names take the prefix RSPI1_
Registers as RSPI0.

## USBhS — USB2.0 Host/Function module
Base 0x400D0400; register names take the prefix USBhS_
0x00 SYSCFG 16-bit — System Configuration Control Register
0x02 BUSWAIT 16-bit — CPU Bus Wait Register
0x04 SYSSTS0 16-bit ro — System Configuration Status Register
0x06 PLLSTA 16-bit ro — PLL Status Register
0x08 DVSTCTR0 16-bit — Device State Control Register 0
0x0C TESTMODE 16-bit — USB Test Mode Register
0x14 CFIFO — CFIFO Port Register
0x18 D0FIFO — D0FIFO Port Register
0x1C D1FIFO — D1FIFO Port Register
0x20 CFIFOSEL 16-bit — CFIFO Port Select Register
0x22 CFIFOCTR 16-bit — CFIFO Port Control Register
0x28 D0FIFOSEL 16-bit — D0FIFO Port Select Register
0x2A D0FIFOCTR 16-bit — D0FIFO Port Control Register
0x2C D1FIFOSEL 16-bit — D1FIFO Port Select Register
0x2E D1FIFOCTR 16-bit — D1FIFO Port Control Register
0x30 INTENB0 16-bit — Interrupt Enable Register 0
0x32 INTENB1 16-bit — Interrupt Enable Register 1
0x36 BRDYENB 16-bit — BRDY Interrupt Enable Register
0x38 NRDYENB 16-bit — NRDY Interrupt Enable Register
0x3A BEMPENB 16-bit — BEMP Interrupt Enable Register
0x3C SOFCFG 16-bit — SOF Pin Configuration Register
0x3E PhYSET 16-bit — PhY Setting Register
0x40 INTSTS0 16-bit — Interrupt Status Register 0
0x42 INTSTS1 16-bit — Interrupt Status Register 1
0x46 BRDYSTS 16-bit — BRDY Interrupt Status Register
0x48 NRDYSTS 16-bit — NRDY Interrupt Status Register
0x4A BEMPSTS 16-bit — BEMP Interrupt Status Register
0x4C FRMNUM 16-bit — Frame Number Register
0x4E UFRMNUM 16-bit ro — uFrame Number Register
0x50 USBADDR 16-bit ro — USB Address Register
0x54 USBREQ 16-bit — USB Request Type Register
0x56 USBVAL 16-bit — USB Request Value Register
0x58 USBINDX 16-bit — USB Request Index Register
0x5A USBLENG 16-bit — USB Request Length Register
0x5C DCPCFG 16-bit — DCP Configuration Register
0x5E DCPMAXP 16-bit — DCP Maximum Packet Size Register
0x60 DCPCTR 16-bit — DCP Control Register
0x64 PIPESEL 16-bit — Pipe Window Selection Register
0x68 PIPECFG 16-bit — Pipe Configuration Register
0x6A PIPEBUF 16-bit — Pipe Buffer Register
0x6C PIPEMAXP 16-bit — Pipe Maximum Packet Size Register
0x6E PIPEPERI 16-bit — Pipe Cycle Control Register
{0x6E+2i} PIPE{i}CTR 16-bit (i=1..9) — PIPE{i} Control Register
{0x8C+4i} PIPE{i}TRE 16-bit (i=1..5) — PIPE{i} Transaction Counter Enable Register
{0x8E+4i} PIPE{i}TRN 16-bit (i=1..5) — PIPE{i} Transaction Counter Register
{0xD0+2i} DEVADD{i} 16-bit (i=0..5) — Device Address {i} Configuration Register
0x100 LPCTRL 16-bit — Low Power Control Register
0x102 LPSTS 16-bit — Low Power Status Register
0x140 BCCTRL 16-bit — Battery Charging Control Register
0x144 PL1CTRL1 16-bit — Function L1 Control Register 1
0x146 PL1CTRL2 16-bit — Function L1 Control Register 2
0x148 hL1CTRL1 16-bit — host L1 Control Register 1
0x14A hL1CTRL2 16-bit — host L1 Control Register 2
0x150 PhYTRIM1 16-bit — PhY Timing Register 1
0x152 PhYTRIM2 16-bit — PhY Timing Register 2
0x160 DPUSR0R ro — Deep Standby USB Transceiver Control/Pin Monitor Register

## OFS — Option Function Select Read
Base 0x40120040; register names take the prefix OFS_
0x00 SPCC ro — Command Control Register
{0x10+4i} OSIS{i} ro (i=0..3) — OCD ID Setting Register {i}
0x28 OFS0 ro — Optional Function Select Register 0
0x2C OFS1 ro — Optional Function Select Register 1

## ITM — Instrumentation Trace Macrocell
Base 0xE0000000; register names take the prefix ITM_
{0x0+4i} STIM{i} (i=0..31) — Stimulus Port registers {i}
0xE00 TER — Trace Enable Registers
0xE40 TPR — Trace Privilege Register
0xE80 TCR — Trace Control Register
{0xFC0+4i} PID{i} ro (i=4..7) — Peripheral identification registers {i}
{0xFE0+4i} PID{i} ro (i=0..3) — Peripheral identification registers {i}
{0xFF0+4i} CID{i} ro (i=0..3) — Component identification registers {i}

## DWT — Data Watchpoint and Trace
Base 0xE0001000; register names take the prefix DWT_
0x00 CTRL — Control Register
0x04 CYCCNT — Cycle Count Register
0x08 CPICNT — CPI Count Register
0x0C EXCCNT — Exception Overhead Count Register
0x10 SLEEPCNT — Sleep Count Register
0x14 LSUCNT — LSU Count Register
0x18 FOLDCNT — Folded-Instruction Count Register
0x1C PCSR ro — Program Counter Sample Register
{0x20+0x10*i} COMP{i} (i=0..3) — Comparator Registers {i}
{0x24+0x10*i} MASK{i} (i=0..3) — Comparator Mask Registers {i}
{0x28+0x10*i} FUNCTION{i} (i=0..3) — Comparator Function Registers {i}
{0xFC0+4i} PID{i} ro (i=4..7) — Peripheral identification registers {i}
{0xFE0+4i} PID{i} ro (i=0..3) — Peripheral identification registers {i}
{0xFF0+4i} CID{i} ro (i=0..3) — Component identification registers {i}

## NVIC_ICTR — Nested Vectored interrupt controller
Base 0xE000E000; register names take the prefix NVIC_ICTR_
0x04 ICTR ro — Interrupt Controller Type Register

## SYSTEM_2 — System controller
Base 0xE000E008; register names take the prefix SYSTEM_2_
0x00 ACTLR — Auxiliary Control Register
0x08 STCSR — SysTick Control and Status Register
0x0C STRVR — SysTick Reload Value Register
0x10 STCVR — SysTick Current Value Register
0x14 STCR ro — STCALIB SysTick Calibration Value Register

## NVIC — Nested Vectored interrupt controller
Base 0xE000E100; register names take the prefix NVIC_
{0x0+4i} ISER{i} (i=0..7) — Interrupt Set-Enable Registers {i}
{0x80+4i} ICER{i} (i=0..7) — Interrupt Clear-Enable Registers {i}
{0x100+4i} ISPR{i} (i=0..7) — Interrupt Set-Pending Registers {i}
{0x180+4i} ICPR{i} (i=0..2) — Interrupt Clear-Pending Registers {i}
{0x180+4i} ICPR{i} ro (i=3..7) — Interrupt Clear-Pending Registers {i}
{0x200+4i} IABR{i} ro (i=0..2) — Interrupt Active Bit Registers {i}
{0x200+4i} IABR{i} (i=3..7) — Interrupt Active Bit Registers {i}
{0x300+4i} IPR{i} (i=0..54) — Interrupt Priority Registers {i}
0x3DC IPR55 ro — Interrupt Priority Registers 55
{0x300+4i} IPR{i} (i=56..58) — Interrupt Priority Registers {i}
0x3EC IPR59 ro — Interrupt Priority Registers 59

## TPIU — Trace Port Interface Unit
Base 0xE0040000; register names take the prefix TPIU_
0x00 SSPSR — Supported Parallel Port Size Register
0x04 CSPSR ro — Current Parallel Port Size Register
0x10 ACPR ro — Asynchronous Clock Prescaler Register
0xF0 SPPR ro — Selected Pin Protocol Register
0x300 FFSR ro — Formatter and Flush Status Register
0x304 FFCR ro — Formatter and Flush Control Register
0x308 FSCR ro — Formatter Synchronization Counter Register
