# LPC51U68 register map
Vendor: nxp.com; File version: 1.0
LPC51U68JBD48,LPC51U68JBD64
CPU: CM0PLUS r0p0, little endian, no MPU, no FPU, VTOR, 2 interrupt priority bits
Registers are 32-bit, read-write, reset 0x0 unless marked. A register's access mark holds for its fields unless they carry their own. Offsets are from the block's base; lines under a group give offsets from that group; [hi:lo] are bit positions; {n}, {i} and the like mark numbered series; 'fields as' and 'values as' point back to an identical list; <NAME> marks a mode.

## Memory map
0x40000000 SYSCON size 0x20048 — LPC51u68 System configuration (SYSCON)
0x40001000 IOCON size 0x100 — LPC51u68 I/O pin configuration (IOCON)
0x40002000 GINT0 size 0x48 — LPC51u68 Group GPIO input interrupt (GINT0/1)
0x40003000 GINT1 size 0x48 — LPC51u68 Group GPIO input interrupt (GINT0/1)
0x40004000 PINT size 0x34 — LPC51u68 Pin interrupt and pattern match (PINT)
0x40005000 INPUTMUX size 0x188 — LPC51u68 Input multiplexing (INPUT MUX)
0x40008000 CTIMER0 size 0x78 — LPC51u68 Standard counter/timers (CTIMER0 to 4)
0x40009000 CTIMER1 size 0x78 — LPC51u68 Standard counter/timers (CTIMER0 to 4)
0x4000C000 WWDT size 0x1C — LPC51u68 Windowed Watchdog Timer (WWDT)
0x4000D000 MRT0 size 0xFC — LPC51u68 Multi-Rate Timer (MRT)
0x4000E000 UTICK0 size 0x20 — LPC51u68 Micro-tick Timer (UTICK)
0x4002C000 RTC size 0x10 — LPC51u68 Real-Time Clock (RTC)
0x40034000 FMC size 0xFEC — LPC51u68 Flash signature generator
0x40040000 ASYNC_SYSCON size 0x24 — LPC51u68 Asynchronous system configuration (ASYNC_SYSCON)
0x40048000 CTIMER3 size 0x78 — LPC51u68 Standard counter/timers (CTIMER0 to 4)
0x40082000 DMA0 size 0x53C — LPC51u68 DMA controller
0x40084000 USB0 size 0x38 — LPC51u68 USB 2.0 Device Controller
0x40085000 SCT0 size 0x540 — LPC51u68 SCTimer/PWM (SCT)
0x40086000 FLEXCOMM0 size 0x1000 — LPC51u68 Flexcomm serial communication
0x40086000 I2C0 size 0x1000 — LPC51u68 I2C-bus interfaces
0x40086000 SPI0 size 0x1000 — LPC51u68 Serial Peripheral Interfaces (SPI)
0x40086000 USART0 size 0x1000 — LPC51u68 USARTs
0x40087000 FLEXCOMM1 size 0x1000 — LPC51u68 Flexcomm serial communication
0x40087000 I2C1 size 0x1000 — LPC51u68 I2C-bus interfaces
0x40087000 SPI1 size 0x1000 — LPC51u68 Serial Peripheral Interfaces (SPI)
0x40087000 USART1 size 0x1000 — LPC51u68 USARTs
0x40088000 FLEXCOMM2 size 0x1000 — LPC51u68 Flexcomm serial communication
0x40088000 I2C2 size 0x1000 — LPC51u68 I2C-bus interfaces
0x40088000 SPI2 size 0x1000 — LPC51u68 Serial Peripheral Interfaces (SPI)
0x40088000 USART2 size 0x1000 — LPC51u68 USARTs
0x40089000 FLEXCOMM3 size 0x1000 — LPC51u68 Flexcomm serial communication
0x40089000 I2C3 size 0x1000 — LPC51u68 I2C-bus interfaces
0x40089000 SPI3 size 0x1000 — LPC51u68 Serial Peripheral Interfaces (SPI)
0x40089000 USART3 size 0x1000 — LPC51u68 USARTs
0x4008A000 FLEXCOMM4 size 0x1000 — LPC51u68 Flexcomm serial communication
0x4008A000 I2C4 size 0x1000 — LPC51u68 I2C-bus interfaces
0x4008A000 SPI4 size 0x1000 — LPC51u68 Serial Peripheral Interfaces (SPI)
0x4008A000 USART4 size 0x1000 — LPC51u68 USARTs
0x4008C000 GPIO size 0x2488 — LPC51u68 General Purpose I/O (GPIO)
0x40095000 CRC_ENGINE size 0xC — LPC51u68 CRC engine
0x40096000 FLEXCOMM5 size 0x1000 — LPC51u68 Flexcomm serial communication
0x40096000 I2C5 size 0x1000 — LPC51u68 I2C-bus interfaces
0x40096000 SPI5 size 0x1000 — LPC51u68 Serial Peripheral Interfaces (SPI)
0x40096000 USART5 size 0x1000 — LPC51u68 USARTs
0x40097000 FLEXCOMM6 size 0x1000 — LPC51u68 Flexcomm serial communication
0x40097000 I2C6 size 0x1000 — LPC51u68 I2C-bus interfaces
0x40097000 SPI6 size 0x1000 — LPC51u68 Serial Peripheral Interfaces (SPI)
0x40097000 USART6 size 0x1000 — LPC51u68 USARTs
0x40097000 I2S0 size 0x1000 — LPC51u68 I2S interface
0x40098000 FLEXCOMM7 size 0x1000 — LPC51u68 Flexcomm serial communication
0x40098000 I2C7 size 0x1000 — LPC51u68 I2C-bus interfaces
0x40098000 SPI7 size 0x1000 — LPC51u68 Serial Peripheral Interfaces (SPI)
0x40098000 USART7 size 0x1000 — LPC51u68 USARTs
0x40098000 I2S1 size 0x1000 — LPC51u68 I2S interface
0x400A0000 ADC0 size 0x74 — LPC51u68 12-bit ADC controller (ADC)

## Interrupts
0 WDT_BOD (WWDT)
1 DMA0
2 GINT0
3 GINT1
4 PIN_INT0 (PINT)
5 PIN_INT1 (PINT)
6 PIN_INT2 (PINT)
7 PIN_INT3 (PINT)
8 UTICK0
9 MRT0
10 CTIMER0
11 CTIMER1
12 SCT0
13 CTIMER3
14 FLEXCOMM0 (FLEXCOMM0, I2C0, SPI0, USART0)
15 FLEXCOMM1 (FLEXCOMM1, I2C1, SPI1, USART1)
16 FLEXCOMM2 (FLEXCOMM2, I2C2, SPI2, USART2)
17 FLEXCOMM3 (FLEXCOMM3, I2C3, SPI3, USART3)
18 FLEXCOMM4 (FLEXCOMM4, I2C4, SPI4, USART4)
19 FLEXCOMM5 (FLEXCOMM5, I2C5, SPI5, USART5)
20 FLEXCOMM6 (FLEXCOMM6, I2C6, SPI6, USART6, I2S0)
21 FLEXCOMM7 (FLEXCOMM7, I2C7, SPI7, USART7, I2S1)
22 ADC0_SEQA (ADC0)
23 ADC0_SEQB (ADC0)
24 ADC0_THCMP (ADC0)
27 USB0_NEEDCLK (USB0)
28 USB0
29 RTC

## Licence text in the file
The Clear BSD License Copyright 2016-2017 NXP All rights reserved. Redistribution and use in source and binary forms, with or without modification, are permitted (subject to the limitations in the disclaimer below) provided that the following conditions are met: * Redistributions of source code must retain the above copyright notice, this list of conditions and the following disclaimer. * Redistributions in binary form must reproduce the above copyright notice, this list of conditions and the following disclaimer in the documentation and/or other materials provided with the distribution. * Neither the name of the copyright holder nor the names of its contributors may be used to endorse or promote products derived from this software without specific prior written permission. NO EXPRESS OR IMPLIED LICENSES TO ANY PARTY'S PATENT RIGHTS ARE GRANTED BY THIS LICENSE. THIS SOFTWARE IS PROVIDED BY THE COPYRIGHT HOLDERS AND CONTRIBUTORS "AS IS" AND ANY EXPRESS OR IMPLIED WARRANTIES, INCLUDING, BUT NOT LIMITED TO, THE IMPLIED WARRANTIES OF MERCHANTABILITY AND FITNESS FOR A PARTICULAR PURPOSE ARE DISCLAIMED. IN NO EVENT SHALL THE COPYRIGHT HOLDER OR CONTRIBUTORS BE LIABLE FOR ANY DIRECT, INDIRECT, INCIDENTAL, SPECIAL, EXEMPLARY, OR CONSEQUENTIAL DAMAGES (INCLUDING, BUT NOT LIMITED TO, PROCUREMENT OF SUBSTITUTE GOODS OR SERVICES; LOSS OF USE, DATA, OR PROFITS; OR BUSINESS INTERRUPTION) HOWEVER CAUSED AND ON ANY THEORY OF LIABILITY, WHETHER IN CONTRACT, STRICT LIABILITY, OR TORT (INCLUDING NEGLIGENCE OR OTHERWISE) ARISING IN ANY WAY OUT OF THE USE OF THIS SOFTWARE, EVEN IF ADVISED OF THE POSSIBILITY OF SUCH DAMAGE.
