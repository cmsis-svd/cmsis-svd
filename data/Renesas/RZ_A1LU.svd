# RZ_A1LU register map
Vendor: Renesas Electronics Corporation.; Series: RZ; File version: 3
CPU: other r3p0, little endian, MPU, no FPU, 3 interrupt priority bits
Registers are 32-bit, read-write, no defined reset value unless marked. A register's access mark holds for its fields unless they carry their own. Offsets are from the block's base; [hi:lo] are bit positions; {n}, {i} and the like mark numbered series.

## SPDIF
Base 0xE8012000
0x00 TLCA
0x04 TRCA
0x08 TLCS
0x0C TRCS
0x10 TUI
0x14 RLCA
0x18 RRCA
0x1C RLCS
0x20 RRCS
0x24 RUI
0x28 CTRL
0x2C STAT
0x30 TDAD
0x34 RDAD

## IRDA
Base 0xE8014000
0x00 IRCR 8-bit

## JCU
Base 0xE8017000
0x00 JCMOD 8-bit
0x01 JCCMD 8-bit
0x03 JCQTN 8-bit
0x04 JCHTN 8-bit
0x05 JCDRIU 8-bit
0x06 JCDRID 8-bit
0x07 JCVSZU 8-bit
0x08 JCVSZD 8-bit
0x09 JCHSZU 8-bit
0x0A JCHSZD 8-bit
0x0B JCDTCU 8-bit
0x0C JCDTCM 8-bit
0x0D JCDTCD 8-bit
0x0E JINTE0 8-bit
0x0F JINTS0 8-bit
0x10 JCDERR 8-bit
0x11 JCRST 8-bit
0x40 JIFECNT
0x44 JIFESA
0x48 JIFESOFST
0x4C JIFEDA
0x50 JIFESLC
0x54 JIFEDDC
0x58 JIFDCNT
0x5C JIFDSA
0x60 JIFDDOFST
0x64 JIFDDA
0x68 JIFDSDC
0x6C JIFDDLC
0x70 JIFDADT
0x8C JINTE1
0x90 JINTS1
0x94 JIFESVSZ
0x98 JIFESHSZ
{0x100+0x40*i} JCQTBL{i} 8-bit (i=0..3)
0x200 JCHTBD0 8-bit
0x220 JCHTBA0 8-bit
0x300 JCHTBD1 8-bit
0x320 JCHTBA1 8-bit

## MMC
Base 0xE804C800
0x00 CE_CMD_SET_WORD_H 16-bit
0x02 CE_CMD_SET_WORD_L 16-bit
0x08 CE_ARG
0x0C CE_ARG_CMD12
0x10 CE_CMD_CTRL
0x14 CE_BLOCK_SET
0x18 CE_CLK_CTRL
0x1C CE_BUF_ACC
0x20 CE_RESP3
0x24 CE_RESP2
0x28 CE_RESP1
0x2C CE_RESP0
0x30 CE_RESP_CMD12
0x34 CE_DATA
0x40 CE_INT
0x44 CE_INT_EN
0x48 CE_HOST_STS1
0x4C CE_HOST_STS2
0x5C CE_DMA_MODE
0x70 CE_DETECT
0x74 CE_ADD_MODE
0x7C CE_VERSION

## DMAC
Base 0xE8200000
{0x0+0x40*i} N0SA_{i} (i=0..7)
{0x4+0x40*i} N0DA_{i} (i=0..7)
{0x8+0x40*i} N0TB_{i} (i=0..7)
{0xC+0x40*i} N1SA_{i} (i=0..7)
{0x10+0x40*i} N1DA_{i} (i=0..7)
{0x14+0x40*i} N1TB_{i} (i=0..7)
{0x18+0x40*i} CRSA_{i} (i=0..7)
{0x1C+0x40*i} CRDA_{i} (i=0..7)
{0x20+0x40*i} CRTB_{i} (i=0..7)
{0x24+0x40*i} CHSTAT_{i} (i=0..7)
{0x28+0x40*i} CHCTRL_{i} (i=0..7)
{0x2C+0x40*i} CHCFG_{i} (i=0..7)
{0x30+0x40*i} CHITVL_{i} (i=0..7)
{0x34+0x40*i} CHEXT_{i} (i=0..7)
{0x38+0x40*i} NXLA_{i} (i=0..7)
{0x3C+0x40*i} CRLA_{i} (i=0..7)
0x300 DCTRL_0_7
0x310 DSTAT_EN_0_7
0x314 DSTAT_ER_0_7
0x318 DSTAT_END_0_7
0x31C DSTAT_TC_0_7
0x320 DSTAT_SUS_0_7
{0x200+0x40*i} N0SA_{i} (i=8..15)
{0x204+0x40*i} N0DA_{i} (i=8..15)
{0x208+0x40*i} N0TB_{i} (i=8..15)
{0x20C+0x40*i} N1SA_{i} (i=8..15)
{0x210+0x40*i} N1DA_{i} (i=8..15)
{0x214+0x40*i} N1TB_{i} (i=8..15)
{0x218+0x40*i} CRSA_{i} (i=8..15)
{0x21C+0x40*i} CRDA_{i} (i=8..15)
{0x220+0x40*i} CRTB_{i} (i=8..15)
{0x224+0x40*i} CHSTAT_{i} (i=8..15)
{0x228+0x40*i} CHCTRL_{i} (i=8..15)
{0x22C+0x40*i} CHCFG_{i} (i=8..15)
{0x230+0x40*i} CHITVL_{i} (i=8..15)
{0x234+0x40*i} CHEXT_{i} (i=8..15)
{0x238+0x40*i} NXLA_{i} (i=8..15)
{0x23C+0x40*i} CRLA_{i} (i=8..15)
0x700 DCTRL_8_15
0x710 DSTAT_EN_8_15
0x714 DSTAT_ER_8_15
0x718 DSTAT_END_8_15
0x71C DSTAT_TC_8_15
0x720 DSTAT_SUS_8_15
{0x14DE1000+4i} DMARS{i} (i=0..7)

## INTC
Base 0xE8201000
0x00 ICDDCR
0x04 ICDICTR
0x08 ICDIIDR
{0x80+4i} ICDISR{i} (i=0..16)
{0x100+4i} ICDISER{i} (i=0..16)
{0x180+4i} ICDICER{i} (i=0..16)
{0x200+4i} ICDISPR{i} (i=0..16)
{0x280+4i} ICDICPR{i} (i=0..16)
{0x300+4i} ICDABR{i} (i=0..16)
{0x400+4i} ICDIPR{i} (i=0..134)
{0x800+4i} ICDIPTR{i} (i=0..134)
{0xC00+4i} ICDICFR{i} (i=0..33)
0xD00 PPI_STATUS
{0xD04+4i} SPI_STATUS{i} (i=0..14)
0xF00 ICDSGIR
0x1000 ICCICR
0x1004 ICCPMR
0x1008 ICCBPR
0x100C ICCIAR
0x1010 ICCEOIR
0x1014 ICCRPR
0x1018 ICCHPIR
0x101C ICCABPR
0x10FC ICCIIDR
0x14DEE800 ICR0 16-bit
0x14DEE802 ICR1 16-bit
0x14DEE804 IRQRR 16-bit
0x14DEE80A USBSSCR0 16-bit
0x14DEE80C USBSSCR1 16-bit

## ETHER
Base 0xE8203000
0x00 EDSR0
0x10 TDLAR0
0x14 TDFAR0
0x18 TDFXR0
0x1C TDFFR0
0x30 RDLAR0
0x34 RDFAR0
0x38 RDFXR0
0x3C RDFFR0
0x400 EDMR0
0x408 EDTRR0
0x410 EDRRR0
0x428 EESR0
0x430 EESIPR0
0x438 TRSCER0
0x440 RMFCR0
0x448 TFTR0
0x450 FDR0
0x458 RMCR0
0x460 RPADIR0
0x468 FCFTR0
0x4E4 CSMR
0x4E8 CSSBM
0x4EC CSSMR
0x500 ECMR0
0x508 RFLR0
0x510 ECSR0
0x518 ECSIPR0
0x520 PIR0
0x554 APR0
0x558 MPR0
0x55C PFTCR0
0x560 PFRCR0
0x564 TPAUSER0
0x5C0 MAHR0
0x5C8 MALR0
0x740 CEFCR0
0x748 FRECR0
0x750 TSFRCR0
0x758 TLFRCR0
0x760 RFCR0
0x778 MAFCR0
0x1800 ARSTR
0x1804 TSU_CTRST
0x1858 TSU_VTAG0
0x1860 TSU_ADSBSY
0x1864 TSU_TEN
0x1880 TXNLCR0
0x1884 TXALCR0
0x1888 RXNLCR0
0x188C RXALCR0
{0x1900+8i} TSU_ADRH{i} (i=0..31)
{0x1904+8i} TSU_ADRL{i} (i=0..31)
