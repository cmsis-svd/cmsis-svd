# R7S910x01 register map
Vendor: Renesas Electronics Corporation; Series: RZT; File version: 1.0
RZ/T1 Group
CPU: other r1p4, little endian, MPU, FPU, vendor SysTick, 1 interrupt priority bits
Registers are 32-bit, read-write, no defined reset value unless marked. A register's access mark holds for its fields unless they carry their own. Offsets are from the block's base; lines under a group give offsets from that group; [hi:lo] are bit positions; {n}, {i} and the like mark numbered series; 'fields as' and 'values as' point back to an identical list; <NAME> marks a mode.

## Memory map
0xA0000000 PORT size 0x200 — I/O port
0xA0000200 MPC size 0x200 — Multi-function pin controller
0xA0002000 BSC size 0x3000 — Bus state controller
0xA0005000 SPIBSC size 0x1000 — SPI multi I/O bus controller
0xA0010000 VIC size 0x2000 — Vectored interrupt controller
0xA0040000 USBh size 0x20000 — USB2.0 Host module
0xA0060000 USBf size 0x400 — USB2.0 Function module
0xA0062000 DMA0 size 0x800 — Direct memory access controller 0
0xA0063000 DMA1 size 0x800 — Direct memory access controller 1
0xA0065000 SCIFA0 size 0x20 — FIFO embedded serial communications interface 0
0xA0065400 SCIFA1 size 0x20 — FIFO embedded serial communications interface 1
0xA0065800 SCIFA2 size 0x20 — FIFO embedded serial communications interface 2
0xA0065C00 SCIFA3 size 0x20 — FIFO embedded serial communications interface 3
0xA0066000 SCIFA4 size 0x20 — FIFO embedded serial communications interface 4
0xA0068000 RSPI0 size 0x20 — Serial peripheral interface 0
0xA0068400 RSPI1 size 0x20 — Serial peripheral interface 1
0xA0068800 RSPI2 size 0x20 — Serial peripheral interface 2
0xA0068C00 RSPI3 size 0x20 — Serial peripheral interface 3
0xA006A000 MTU size 0x1000 — Multi-function timer pulse unit
0xA006C000 GPT size 0x400 — General PWM timer
0xA0072000 DSMIF size 0x100 — Delta sigma interface
0xA0078000 RSCAN size 0x3400 — CAN module
0xA007C000 CRC size 0x40 — CRC Calculator
0xA007D000 ECMM size 0x40 — Error control module master
0xA007D040 ECMC size 0x40 — Error control module checker
0xA007D080 ECM size 0x80 — Error control module common
0xA0080000 CMT size 0x60 — Compare match timer
0xA0080100 TPU size 0x104 — 16-bit timer pulse unit
0xA0080300 CMTW size 0x200 — Compare match timer W
0xA0080500 PPG0 blocks up to offset 0x10 — Programmable pulse generator 0
0xA0080600 WDT0 size 0x10 — Watchdog timer 0
0xA0080700 IWDT size 0x10 — Independent watchdog timer
0xA0080800 POE3 size 0x40 — Port output enable
0xA0080900 RIIC0 size 0x20 — I2C Bus Interface
0xA0080940 RIIC1 size 0x20 — I2C Bus Interface
0xA0080A00 TSN size 0x4 — Temperature sensor
0xA0080B00 ELC size 0x80 — Event link controller
0xA0081000 SSI size 0x40 — Serial sound interface
0xA0081200 DOC size 0x8 — Data operation circuit
0xA008C000 S12ADC0 size 0x100 — 12-Bit A/D Converter 0
0xA0090000 CLMA0 size 0x20 — Clock monitor circuit 0
0xA0090020 CLMA1 size 0x20 — Clock monitor circuit 1
0xA0090040 CLMA2 size 0x20 — Clock monitor circuit 2
0xA0094000 ICU size 0x400 — Interrupt controller
0xA00B0000 SYSTEM size 0xC00 — System controller
0xA00BF000 ETHERSW size 0x11000 — Ethernet switch
0xA00E0000 ETHERC size 0x13000 — Ethernet controller

## MPC — Multi-function pin controller
Base 0xA0000200; register names take the prefix MPC_
{0x0+i} P{i:02}PFS 8-bit (i=0..7) — Port {i:02} pin function control register
0x08 P10PFS 8-bit — Port 10 pin function control register
0x0B P13PFS 8-bit — Port 13 pin function control register
0x0C P14PFS 8-bit — Port 14 pin function control register
0x0D P15PFS 8-bit — Port 15 pin function control register
0x0E P16PFS 8-bit — Port 16 pin function control register
0x0F P17PFS 8-bit — Port 17 pin function control register
0x10 P20PFS 8-bit — Port 20 pin function control register
0x11 P21PFS 8-bit — Port 21 pin function control register
0x12 P22PFS 8-bit — Port 22 pin function control register
0x13 P23PFS 8-bit — Port 23 pin function control register
0x14 P24PFS 8-bit — Port 24 pin function control register
0x15 P25PFS 8-bit — Port 25 pin function control register
0x16 P26PFS 8-bit — Port 26 pin function control register
0x17 P27PFS 8-bit — Port 27 pin function control register
0x18 P30PFS 8-bit — Port 30 pin function control register
0x1B P33PFS 8-bit — Port 33 pin function control register
0x1C P34PFS 8-bit — Port 34 pin function control register
0x1D P35PFS 8-bit — Port 35 pin function control register
0x1E P36PFS 8-bit — Port 36 pin function control register
0x1F P37PFS 8-bit — Port 37 pin function control register
0x20 P40PFS 8-bit — Port 40 pin function control register
0x22 P42PFS 8-bit — Port 42 pin function control register
0x23 P43PFS 8-bit — Port 43 pin function control register
0x27 P47PFS 8-bit — Port 47 pin function control register
0x29 P51PFS 8-bit — Port 51 pin function control register
0x2C P54PFS 8-bit — Port 54 pin function control register
0x2E P56PFS 8-bit — Port 56 pin function control register
0x30 P60PFS 8-bit — Port 60 pin function control register
0x31 P61PFS 8-bit — Port 61 pin function control register
0x32 P62PFS 8-bit — Port 62 pin function control register
0x33 P63PFS 8-bit — Port 63 pin function control register
0x34 P64PFS 8-bit — Port 64 pin function control register
0x35 P65PFS 8-bit — Port 65 pin function control register
0x38 P70PFS 8-bit — Port 70 pin function control register
0x39 P71PFS 8-bit — Port 71 pin function control register
0x3A P72PFS 8-bit — Port 72 pin function control register
0x3B P73PFS 8-bit — Port 73 pin function control register
0x3C P74PFS 8-bit — Port 74 pin function control register
0x3D P75PFS 8-bit — Port 75 pin function control register
0x3E P76PFS 8-bit — Port 76 pin function control register
0x3F P77PFS 8-bit — Port 77 pin function control register
0x42 P82PFS 8-bit — Port 82 pin function control register
0x45 P85PFS 8-bit — Port 85 pin function control register
0x46 P86PFS 8-bit — Port 86 pin function control register
0x47 P87PFS 8-bit — Port 87 pin function control register
{0x50+i} PA{i}PFS 8-bit (i=0..7) — Port A{i} pin function control register
{0x58+i} PB{i}PFS 8-bit (i=0..7) — Port B{i} pin function control register
{0x60+i} PC{i}PFS 8-bit (i=0..3) — Port C{i} pin function control register
{0x68+i} PD{i}PFS 8-bit (i=5..7) — Port D{i} pin function control register
{0x70+i} PE{i}PFS 8-bit (i=0..7) — Port E{i} pin function control register
0x7D PF5PFS 8-bit — Port F5 pin function control register
0x7E PF6PFS 8-bit — Port F6 pin function control register
{0x80+i} PG{i}PFS 8-bit (i=0..7) — Port G{i} pin function control register
{0x88+i} PH{i}PFS 8-bit (i=0..7) — Port H{i} pin function control register
0xFF PWPR 8-bit — Write protection register
