# RA4M1 register map
Vendor: Renesas Electronics Corporation; Series: RA4; File version: 1.2
ARM 32-bit Cortex-M4F Microcontroller based device, CPU clock up to 48MHz, etc.
CPU: CM4 r0p1, little endian, MPU, FPU, VTOR, 4 interrupt priority bits
Registers are 8-bit, read-write, reset 0x0 unless marked. A register's access mark holds for its fields unless they carry their own. Offsets are from the block's base; lines under a group give offsets from that group; [hi:lo] are bit positions; {n}, {i} and the like mark numbered series; 'fields as' and 'values as' point back to an identical list; <NAME> marks a mode.

## Memory map
0x40000000 MMPU blocks up to offset 0x308 — Bus Master MPU
0x40000C00 SMPU blocks up to offset 0x3A — Bus Slave MPU
0x40000D00 SPMON blocks up to offset 0x20 — CPU Stack Pointer Monitor
0x40002000 SRAM blocks up to offset 0xD9 — SRAM Control
0x40003000 BUS blocks up to offset 0x1844 — BUS Control
0x40005000 DMAC0 blocks up to offset 0x1F — Direct memory access controller 0
0x40005040 DMAC1 blocks up to offset 0x1F — Direct memory access controller 1
0x40005080 DMAC2 blocks up to offset 0x1F — Direct memory access controller 2
0x400050C0 DMAC3 blocks up to offset 0x1F — Direct memory access controller 3
0x40005200 DMA size 0x1 — DMAC Module Activation
0x40005400 DTC blocks up to offset 0x10 — Data Transfer Controller
0x40006000 ICU blocks up to offset 0x380 — Interrupt Controller
0x4001B000 DBG blocks up to offset 0x24 — Debug Function
0x4001C000 FCACHE blocks up to offset 0x11D — Flash Cache
0x4001E000 SYSTEM blocks up to offset 0x700 — System Control
0x40040000 PORT0 blocks up to offset 0xC — Port 0 Control Registers
0x40040020 PORT1 blocks up to offset 0x10 — Port 1 Control Registers
0x40040040 PORT2 blocks up to offset 0x10 — Port 2 Control Registers
0x40040060 PORT3 blocks up to offset 0x10 — Port 3 Control Registers
0x40040080 PORT4 blocks up to offset 0x10 — Port 4 Control Registers
0x400400A0 PORT5 blocks up to offset 0xC — Port 5 Control Registers
0x400400C0 PORT6 blocks up to offset 0xC — Port 6 Control Registers
0x400400E0 PORT7 blocks up to offset 0xC — Port 7 Control Registers
0x40040100 PORT8 blocks up to offset 0xC — Port 8 Control Registers
0x40040120 PORT9 blocks up to offset 0xC — Port 9 Control Registers
0x40040800 PFS blocks up to offset 0x283 — Pmn Pin Function Control Register
0x40040D00 PMISC size 0x4 — Miscellaneous Port Control Register
0x40041000 ELC blocks up to offset 0x5C — Event Link Controller
0x40042000 POEG size 0x200 — Port Output Enable Module for GPT
0x40044000 RTC blocks up to offset 0x8C — Realtime Clock
0x40044200 WDT blocks up to offset 0x9 — Watchdog Timer
0x40044400 IWDT blocks up to offset 0x6 — Independent Watchdog Timer
0x40044600 CAC blocks up to offset 0xC — Clock Frequency Accuracy Measurement Circuit
0x40047000 MSTP size 0xC — Module Stop Control B,C,D
0x4004E000 SSIE0 blocks up to offset 0x28 — Serial Sound Interface Ver.2.0
0x40050000 CAN0 blocks up to offset 0x859 — CAN0 Module
0x40053000 IIC0 blocks up to offset 0x18 — Inter-Integrated Circuit 0
0x40053100 IIC1 blocks up to offset 0x14 — Inter-Integrated Circuit 1
0x40054100 DOC blocks up to offset 0x6 — Data Operation Circuit
0x4005C000 ADC140 blocks up to offset 0x1E1 — 14bit A/D Converter
0x4005E000 DAC12 blocks up to offset 0x8 — 12-bit D/A converter
0x40070000 SCI0 blocks up to offset 0x1D — Serial Communication Interface 0
0x40070020 SCI1 blocks up to offset 0x1D — Serial Communication Interface 1
0x40070040 SCI2 blocks up to offset 0x1D — Serial Communication Interface 2
0x40070120 SCI9 blocks up to offset 0x1D — Serial Communication Interface 9
0x40072000 SPI0 blocks up to offset 0x12 — Serial Peripheral Interface 0
0x40072100 SPI1 blocks up to offset 0x12 — Serial Peripheral Interface 1
0x40074000 CRC blocks up to offset 0xE — CRC Calculator
0x40078000 GPT320 blocks up to offset 0xA4 — General PWM Timer 0 (32-bit)
0x40078100 GPT321 blocks up to offset 0xA4 — General PWM Timer 1 (32-bit)
0x40078200 GPT162 blocks up to offset 0xA4 — General PWM Timer 2 (16-bit)
0x40078300 GPT163 blocks up to offset 0xA4 — General PWM Timer 3 (16-bit)
0x40078400 GPT164 blocks up to offset 0xA4 — General PWM Timer 4 (16-bit)
0x40078500 GPT165 blocks up to offset 0xA4 — General PWM Timer 5 (16-bit)
0x40078600 GPT166 blocks up to offset 0xA4 — General PWM Timer 6 (16-bit)
0x40078700 GPT167 blocks up to offset 0xA4 — General PWM Timer 7 (16-bit)
0x40078FF0 GPT_OPS size 0x4 — Output Phase Switching Controller
0x40080000 KINT blocks up to offset 0x9 — Key Interrupt Function
0x40081000 CTSU size 0x1E — Capacitive Touch Sensing Unit
0x40082000 SLCDC blocks up to offset 0x126 — Segment LCD Controller/Driver
0x40084000 AGT0 blocks up to offset 0x10 — Asynchronous General purpose Timer 0
0x40084100 AGT1 blocks up to offset 0x10 — Asynchronous General purpose Timer 1
0x40085E00 ACMPLP blocks up to offset 0x6 — Low-Power Analog Comparator
0x40086000 OPAMP blocks up to offset 0xD — OperationalAmplifier
0x40090000 USBFS blocks up to offset 0xDC — USB 2.0 FS Module
0x4009E000 DAC8 blocks up to offset 0x4 — 8-bit D/A converter
0x407EC000 TSN blocks up to offset 0x22A — Temperature Sensor

## Interrupts
{n} IEL{n} (ICU) (n=0..31) — ICU Interrupt {n}

## Licence text in the file
This software is supplied by Renesas Electronics Corporation and is only intended for use with Renesas products. No other uses are authorized. This software is owned by. Renesas Electronics Corporation and is protected under all applicable laws, including copyright laws. . THIS SOFTWARE IS PROVIDED "AS IS" AND RENESAS MAKES NO WARRANTIES REGARDING. THIS SOFTWARE, WHETHER EXPRESS, IMPLIED OR STATUTORY, INCLUDING BUT NOT LIMITED TO. WARRANTIES OF MERCHANTABILITY, FITNESS FOR A PARTICULAR PURPOSE AND NON-INFRINGEMENT. ALL SUCH WARRANTIES ARE EXPRESSLY DISCLAIMED. TO THE MAXIMUM EXTENT PERMITTED NOT. PROHIBITED BY LAW, NEITHER RENESAS ELECTRONICS CORPORATION NOR ANY OF ITS AFFILIATED. COMPANIES SHALL BE LIABLE FOR ANY DIRECT, INDIRECT, SPECIAL, INCIDENTAL OR CONSEQUENTIAL. DAMAGES FOR ANY REASON RELATED TO THIS SOFTWARE, EVEN IF RENESAS OR ITS AFFILIATES HAVE. BEEN ADVISED OF THE POSSIBILITY OF SUCH DAMAGES. . Renesas reserves the right, without notice, to make changes to this software and to discontinue the availability of this software. By using this software, you agree to the additional terms and conditions found by accessing the following link: http://www.renesas.com/disclaimer
