# R7S910x23 register map
Vendor: Renesas Electronics Corporation; Series: RZT; File version: 1.5
CPU: other r1p4, little endian, MPU, FPU, vendor SysTick, 1 interrupt priority bits
Registers are 32-bit, read-write, no defined reset value unless marked. A register's access mark holds for its fields unless they carry their own. Offsets are from the block's base; [hi:lo] are bit positions; {n}, {i} and the like mark numbered series.

## CMT — Compare match timer
Base 0xA0080000; register names take the prefix CMT_
{0x0+0x20*i} CMT_CMSTR{i} 16-bit (i=0..2) — Compare match timer start register {i}
0x02 CMT0_CMCR 16-bit — Compare match timer control register
0x04 CMT0_CMCNT 16-bit — Compare match counter
0x06 CMT0_CMCOR 16-bit — Compare match constant register
0x08 CMT1_CMCR 16-bit — Compare match timer control register
0x0A CMT1_CMCNT 16-bit — Compare match counter
0x0C CMT1_CMCOR 16-bit — Compare match constant register
0x22 CMT2_CMCR 16-bit — Compare match timer control register
0x24 CMT2_CMCNT 16-bit — Compare match counter
0x26 CMT2_CMCOR 16-bit — Compare match constant register
0x28 CMT3_CMCR 16-bit — Compare match timer control register
0x2A CMT3_CMCNT 16-bit — Compare match counter
0x2C CMT3_CMCOR 16-bit — Compare match constant register
0x42 CMT4_CMCR 16-bit — Compare match timer control register
0x44 CMT4_CMCNT 16-bit — Compare match counter
0x46 CMT4_CMCOR 16-bit — Compare match constant register
0x48 CMT5_CMCR 16-bit — Compare match timer control register
0x4A CMT5_CMCNT 16-bit — Compare match counter
0x4C CMT5_CMCOR 16-bit — Compare match constant register

## TPU — 16-bit timer pulse unit
Base 0xA0080100; register names take the prefix TPU_
0x00 TPUA_TSTRA 8-bit — Timer start register
0x01 TPUA_TSYRA 8-bit — Timer synchronous register
{0x8+i} TPU{i}_NFCR 8-bit (i=0..5) — Noise filter control register
{0x10+0x10*i} TPU{i}_TCR 8-bit (i=0..5) — Timer control register
{0x11+0x10*i} TPU{i}_TMDR 8-bit (i=0..5) — Timer mode register
0x12 TPU0_TIORH 8-bit — Timer I/O control register
0x13 TPU0_TIORL 8-bit — Timer I/O control register
{0x14+0x10*i} TPU{i}_TIER 8-bit (i=0..5) — Timer interrupt enable register
{0x15+0x10*i} TPU{i}_TSR 8-bit (i=0..5) — Timer status register
{0x16+0x10*i} TPU{i}_TCNT 16-bit (i=0..5) — Timer counter
{0x18+0x10*i} TPU{i}_TGRA 16-bit (i=0..5) — Timer general register A
{0x1A+0x10*i} TPU{i}_TGRB 16-bit (i=0..5) — Timer general register B
0x1C TPU0_TGRC 16-bit — Timer general register C
0x1E TPU0_TGRD 16-bit — Timer general register D
0x22 TPU1_TIOR 8-bit — Timer I/O control register
0x32 TPU2_TIOR 8-bit — Timer I/O control register
0x42 TPU3_TIORH 8-bit — Timer I/O control register
0x43 TPU3_TIORL 8-bit — Timer I/O control register
0x4C TPU3_TGRC 16-bit — Timer general register C
0x4E TPU3_TGRD 16-bit — Timer general register D
0x52 TPU4_TIOR 8-bit — Timer I/O control register
0x62 TPU5_TIOR 8-bit — Timer I/O control register
0x100 TPUSL_PWMFBSLR — PWM feedback select register

## CMTW — Compare match timer W
Base 0xA0080300; register names take the prefix CMTW_
0x00 CMTW0_CMWSTR 16-bit — Timer start register
0x04 CMTW0_CMWCR 16-bit — Timer control register
0x08 CMTW0_CMWIOR 16-bit — Timer I/O control register
0x10 CMTW0_CMWCNT — Timer counter
0x14 CMTW0_CMWCOR — Compare match constant register
0x18 CMTW0_CMWICR0 ro — Input capture register 0
0x1C CMTW0_CMWICR1 ro — Input capture register 1
0x20 CMTW0_CMWOCR0 — Output compare register 0
0x24 CMTW0_CMWOCR1 — Output compare register 1
0x80 CMTW1_CMWSTR 16-bit — Timer start register
0x84 CMTW1_CMWCR 16-bit — Timer control register
0x88 CMTW1_CMWIOR 16-bit — Timer I/O control register
0x90 CMTW1_CMWCNT — Timer counter
0x94 CMTW1_CMWCOR — Compare match constant register
0x98 CMTW1_CMWICR0 ro — Input capture register 0
0x9C CMTW1_CMWICR1 ro — Input capture register 1
0xA0 CMTW1_CMWOCR0 — Output compare register 0
0xA4 CMTW1_CMWOCR1 — Output compare register 1
0x100 CMTW_NFCR0 — Digital noise filter control register 0
0x104 CMTW_NFCR1 — Digital noise filter control register 1
0x110 CMTW_ECDMESLR — ECM dynamic mode error output select register
