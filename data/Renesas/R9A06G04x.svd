# R9A06G04x register map
Vendor: Renesas Electronics Corporation; Series: EC1; File version: 1
CPU: other r1p4, little endian, MPU, FPU, vendor SysTick, 1 interrupt priority bits
Registers are 32-bit, read-write, no defined reset value unless marked. A register's access mark holds for its fields unless they carry their own. Offsets are from the block's base; [hi:lo] are bit positions; {n}, {i} and the like mark numbered series.

## CMT — Compare match timer
Base 0xA0080000; register names take the prefix CMT_
{0x0+0x20*i} CMT_CMSTR{i} 16-bit (i=0..2) — Compare match timer start register {i}
0x02 CMT0_CMCR 16-bit — Compare match timer control register
0x04 CMT0_CMCNT 16-bit — Compare match counter
0x06 CMT0_CMCOR 16-bit — Compare match constant register
0x08 CMT1_CMCR 16-bit — Compare match timer control register
0x0A CMT1_CMCNT 16-bit — Compare match counter
0x0C CMT1_CMCOR 16-bit — Compare match constant register
0x22 CMT2_CMCR 16-bit — Compare match timer control register
0x24 CMT2_CMCNT 16-bit — Compare match counter
0x26 CMT2_CMCOR 16-bit — Compare match constant register
0x28 CMT3_CMCR 16-bit — Compare match timer control register
0x2A CMT3_CMCNT 16-bit — Compare match counter
0x2C CMT3_CMCOR 16-bit — Compare match constant register
0x42 CMT4_CMCR 16-bit — Compare match timer control register
0x44 CMT4_CMCNT 16-bit — Compare match counter
0x46 CMT4_CMCOR 16-bit — Compare match constant register
0x48 CMT5_CMCR 16-bit — Compare match timer control register
0x4A CMT5_CMCNT 16-bit — Compare match counter
0x4C CMT5_CMCOR 16-bit — Compare match constant register

## CMTW — Compare match timer W
Base 0xA0080300; register names take the prefix CMTW_
0x00 CMTW0_CMWSTR 16-bit — Timer start register
0x04 CMTW0_CMWCR 16-bit — Timer control register
0x08 CMTW0_CMWIOR 16-bit — Timer I/O control register
0x10 CMTW0_CMWCNT — Timer counter
0x14 CMTW0_CMWCOR — Compare match constant register
0x18 CMTW0_CMWICR0 ro — Input capture register 0
0x1C CMTW0_CMWICR1 ro — Input capture register 1
0x20 CMTW0_CMWOCR0 — Output compare register 0
0x24 CMTW0_CMWOCR1 — Output compare register 1
0x80 CMTW1_CMWSTR 16-bit — Timer start register
0x84 CMTW1_CMWCR 16-bit — Timer control register
0x88 CMTW1_CMWIOR 16-bit — Timer I/O control register
0x90 CMTW1_CMWCNT — Timer counter
0x94 CMTW1_CMWCOR — Compare match constant register
0x98 CMTW1_CMWICR0 ro — Input capture register 0
0x9C CMTW1_CMWICR1 ro — Input capture register 1
0xA0 CMTW1_CMWOCR0 — Output compare register 0
0xA4 CMTW1_CMWOCR1 — Output compare register 1
0x100 CMTW_NFCR0 — Digital noise filter control register 0
0x104 CMTW_NFCR1 — Digital noise filter control register 1
0x110 CMTW_ECDMESLR — ECM dynamic mode error output select register

## WDT0 — Watchdog timer 0
Base 0xA0080600; register names take the prefix WDT0_
0x00 WDTRR 8-bit — WDT refresh register
0x02 WDTCR 16-bit — WDT control register
0x04 WDTSR 16-bit — WDT status register
0x06 WDTRCR 8-bit — WDT reset control register

## IWDT — Independent watchdog timer
Base 0xA0080700; register names take the prefix IWDT_
0x00 IWDTRR 8-bit — IWDT refresh register
0x02 IWDTCR 16-bit — IWDT control register
0x04 IWDTSR 16-bit — IWDT status register
0x06 IWDTRCR 8-bit — IWDT reset control register

## RIIC1 — I2C Bus Interface
Base 0xA0080940; register names take the prefix RIIC1_
0x00 ICCR1 8-bit — I2C bus control register 1
0x01 ICCR2 8-bit — I2C bus control register 2
{0x1+i} ICMR{i} 8-bit (i=1..3) — I2C bus mode register {i}
0x05 ICFER 8-bit — I2C bus function enable register
0x06 ICSER 8-bit — I2C bus status enable register
0x07 ICIER 8-bit — I2C bus interrupt enable register
0x08 ICSR1 8-bit — I2C bus status register 1
0x09 ICSR2 8-bit — I2C bus status register 2
{0xA+2i} ICSARL{i} 8-bit (i=0..2) — slave address register L{i}
{0xB+2i} ICSARU{i} 8-bit (i=0..2) — slave address register U{i}
0x10 ICBRL 8-bit — I2C bus bitrate low register
0x11 ICBRH 8-bit — I2C bus bitrate high register
0x12 ICDRT 8-bit — I2C bus transmit data register
0x13 ICDRR 8-bit ro — I2C bus receive data register
