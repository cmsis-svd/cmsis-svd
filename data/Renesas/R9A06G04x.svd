# R9A06G04x register map
Vendor: Renesas Electronics Corporation; Series: EC1; File version: 1
CPU: other r1p4, little endian, MPU, FPU, vendor SysTick, 1 interrupt priority bits
Registers are 32-bit, read-write, no defined reset value unless marked. A register's access mark holds for its fields unless they carry their own. Offsets are from the block's base; [hi:lo] are bit positions; {n}, {i} and the like mark numbered series.

## SCIFA0 — FIFO embedded serial communications interface 0
Base 0xA0065000; register names take the prefix SCIFA0_
0x00 SMR 16-bit — Serial mode register
0x02 BRR 8-bit — Bit rate register
0x02 MDDR 8-bit (alternate view of BRR) — Modulation duty register
0x04 SCR 16-bit — Serial control register
0x06 FTDR 8-bit wo — Transmit FIFO data register
0x08 FSR 16-bit — Serial status register
0x0A FRDR 8-bit ro — Receive FIFO data register
0x0C FCR 16-bit — FIFO control register
0x0E FDR 16-bit ro — FIFO data count register
0x10 SPTR 16-bit — Serial port register
0x12 LSR 16-bit — Line status register
0x14 SEMR 8-bit — Serial extended mode register
0x16 FTCR 16-bit — FIFO trigger control register

## SCIFA1 — FIFO embedded serial communications interface 1
Base 0xA0065400; register names take the prefix SCIFA1_
Registers as SCIFA0.

## SCIFA2 — FIFO embedded serial communications interface 2
Base 0xA0065800; register names take the prefix SCIFA2_
Registers as SCIFA0.

## SCIFA3 — FIFO embedded serial communications interface 3
Base 0xA0065C00; register names take the prefix SCIFA3_
Registers as SCIFA0.

## SCIFA4 — FIFO embedded serial communications interface 4
Base 0xA0066000; register names take the prefix SCIFA4_
Registers as SCIFA0.

## RSPI0 — Serial peripheral interface 0
Base 0xA0068000; register names take the prefix RSPI0_
0x00 SPCR 8-bit — RSPI control register
0x01 SSLP 8-bit — RSPI slave select polarity register
0x02 SPPCR 8-bit — RSPI pin control register
0x03 SPSR 8-bit — RSPI status register
0x04 SPDR — RSPI data register
0x08 SPSCR 8-bit — RSPI sequence control register
0x09 SPSSR 8-bit ro — RSPI sequence status register
0x0A SPBR 8-bit — RSPI bit rate register
0x0B SPDCR 8-bit — RSPI data control register
0x0C SPCKD 8-bit — RSPI clock delay register
0x0D SSLND 8-bit — RSPI slave select negation delay register
0x0E SPND 8-bit — RSPI next-access delay register
0x0F SPCR2 8-bit — RSPI control register 2
{0x10+2i} SPCMD{i} 16-bit (i=0..7) — RSPI command register {i}

## RSPI1 — Serial peripheral interface 1
Base 0xA0068400; register names take the prefix RSPI1_
Registers as RSPI0.

## CRC — CRC Calculator
Base 0xA007C000; register names take the prefix CRC_
0x00 CRCDIR — CRC data input register
0x04 CRCDOR — CRC data output register
0x20 CRCCR 8-bit — CRC control register

## ECMM — Error control module master
Base 0xA007D000; register names take the prefix ECMM_
0x00 ECMMESET 8-bit wo — ECM master error set trigger register
0x04 ECMMECLR 8-bit wo — ECM master error clear trigger register
{0x8+4i} ECMMESSTR{i} ro (i=0..2) — ECM master error source status register {i}
0x14 ECMMPCMD0 wo — ECM master protection command register

## ECMC — Error control module checker
Base 0xA007D040; register names take the prefix ECMC_
0x00 ECMCESET 8-bit wo — ECM checker error set trigger register
0x04 ECMCECLR 8-bit wo — ECM checker error clear trigger register
{0x8+4i} ECMCESSTR{i} ro (i=0..2) — ECM checker error source status register {i}
0x14 ECMCPCMD0 wo — ECM checker protection command register

## ECM — Error control module common
Base 0xA007D080; register names take the prefix ECM_
0x00 ECMEPCFG 8-bit — ECM error pulse configuration register
{0x4+4i} ECMMICFG{i} (i=0..2) — ECM maskable interrupt configuration register {i}
{0x10+4i} ECMNMICFG{i} (i=0..2) — ECM non-maskable interrupt configuration register {i}
{0x1C+4i} ECMIRCFG{i} (i=0..2) — ECM internal reset configuration register {i}
{0x28+4i} ECMEMK{i} (i=0..2) — ECM error mask register {i}
{0x34+4i} ECMESSTC{i} wo (i=0..2) — ECM error source status clear trigger register {i}
0x40 ECMPCMD1 wo — ECM protection command register
0x44 ECMPS 8-bit ro — ECM protection status register
{0x48+4i} ECMPE{i} wo (i=0..2) — ECM pseudo error trigger register {i}
0x54 ECMDTMCTL 8-bit — ECM delay timer control register
0x58 ECMDTMR 16-bit ro — ECM delay timer register
0x5C ECMDTMCMP — ECM delay timer compare register
{0x60+4i} ECMDTMCFG{i} (i=0..5) — ECM delay timer configuration register {i}
0x78 ECMEOCCFG — ECM error output clear invalidation configuration register
