# RIN32M3_EC register map
Vendor: Renesas Electronics Corporation; Series: RIN32M3; File version: 0.1
CPU: CM3 r2p1, little endian, MPU, no FPU, 4 interrupt priority bits
Registers are 32-bit, read-write, reset 0x0 unless marked. A register's access mark holds for its fields unless they carry their own. Offsets are from the block's base; [hi:lo] are bit positions; {n}, {i} and the like mark numbered series.

## ETHSW — Ethernet Switch
Base 0x40070000
0x00 REVISION ro
0x04 SCRATCH
0x08 PORT_ENA — Port Enable Bits
0x0C UCAST_DEFAULT_MASK — Default unicast flooding resonution
0x10 VLAN_VERIFY — Verify VLAN domain
0x14 BCAST_DEFAULT_MASK — Default broadcast resolution
0x18 MCAST_DEFAULT_MASK — Default multicast resolution
0x1C INPUT_LEARN_BLOCK — Define port in blocking state and enable or disable learning
0x20 MGMT_CONFIG — Bridge Management Port Config
0x24 MODE_CONFIG — Define global config settings
0x34 VLAN_TAG_ID reset 0x8100 — VLAN type field value
0x80 OQMGR_STATUS — OQMGR status info
0x84 QMGR_MINCELLS — OQMGR Low memory threshold
0x88 QMGR_ST_MINCELLS — OQMGR Statistic lowest free cells
0x8C QMGR_CGS_STAT ro — OQMGR Congestion Status
0x90 QMGR_IFACE_STAT ro — OQMGR Internal I/F handshaking
0x94 QMGR_WEIGHTS — OQMGR weights
{0x100+4i} VLAN_PRIORITY[{i}] (i=0..2) — VLAN priority resolution map
{0x140+4i} IP_PRIORITY[{i}] (i=0..2) — IPv4 priority resolution
{0x180+4i} PRIORITY_CFG[{i}] (i=0..2) — priority resolution config.
0x1C0 HUB_CONTROL
0x1C4 HUB_STATS ro — HUB status
{0x1C8+8i} HUB_FLT_MAC{i}lo (i=0..6) — first 4 octets of MAC address {i}
{0x1CC+8i} HUB_FLT_MAC{i}hi (i=0..6) — last 2 octets of MAC address {i}
{0x280+4i} VLAN_RES_TABLE[{i}] (i=0..31) — VLAN domain entries 0-31
0x300 TOTAL_BYT_FRM ro — Sum of bytes of frames in TOTAL_FRM
0x304 TOTAL_BYT_DISC ro — Sum of bytes of frames in TOTAL_DISC
0x308 TOTAL_FRM ro — Total number of incoming frames
0x30C TOTAL_DISC ro — Total number of incoming frames discarded in SW
{0x310+8i} ODISC{i} ro (i=0..2) — Port {i} outgoing frames discarded
{0x314+8i} IDISC_BLOCKED{i} ro (i=0..2) — Port {i} incoming frames discarded
0x500 LRN_REC_A ro — Learning Records A and B
0x504 LRN_REC_B ro — Learning Records B
0x508 LRN_STATUS ro — Learning data available status
0x8000 REV ro reset 0x10003 — Revision register
0x8004 MAC_SCRATCH — Scratch Register
0x8008 COMMAND_CONFIG reset 0x10 — Command Register
0x800C MAC_0 — MAC Address 32bit Word 0
0x8010 MAC_1 — MAC Address 32bit Word 1
0x8014 FRM_LENGTH reset 0x5F2 — Max frame length
0x8018 PAUSE_QUANT — Receive Pause Quanta
0x801C RX_SECTION_EMPTY — receive FIFO section empty threshold
0x8020 RX_SECTION_FULL — receive FIFO section full threshold
0x8024 TX_SECTION_EMPTY reset 0x48 — transmit FIFO section empty threshold
0x8028 TX_SECTION_FULL reset 0x14 — transmit FIFO section full threshold
0x802C RX_ALMOST_EMPTY reset 0x8 — receive FIFO almost empty threshold
0x8030 RX_ALMOST_FULL reset 0xA — receive FIFO almost full threshold
0x8034 TX_ALMOST_EMPTY reset 0x4 — transmit FIFO almost empty threshold
0x8038 TX_ALMOST_FULL reset 0x10 — transmit FIFO almost full threshold
0x803C MDIO_ADDR0 — MDIO Address
0x8058 STATUS ro — informal status info for both MACs
0x805C TX_IPG_LENGTH reset 0xC — Programmable Inter-Packet Gap
0xC000 VERSION ro — TSM Version
0xC004 CONFIG — TSM Module config
0xC008 TSM_IRQ_STAT_ACK — TSM Interrupt Status/Ack
0xC020 PORT0_CTRL — TSM Port 0 timestamp control/status
0xC024 PORT0_TIME ro — TSM Port0 memorized timestamp
0xC028 PORT1_CTRL — TSM Port 1 timestamp control/status
0xC02C PORT1_TIME ro — TSM Port1 memorized timestamp
0xC120 ATIME_CTRL — TSM Time control
0xC124 ATIME — TSM Time value
0xC128 ATIME_OFFSET — TSM offset corrections
0xC12C ATIME_EVT_PERIOD — TSM periodic events
0xC130 ATIME_CORR — TSM correction value
0xC134 ATIME_INC — TSM correction increment value
0xC138 ATIME_SEC — TSM second time value
0xC13C ATIME_CORR_OFFS — TSM offset correction counter
0xE000 CONTROL reset 0x3200 — DLR Control register
0xE004 DLR_STATUS ro
0xE008 DLR_ETH_TYP reset 0x80E1 — Ethernet Type to compare for DLR frame
0xE00C IRQ_CTRL — Interrupt Control
0xE010 IRQ_STAT_ACK — Interrupt Status Acknowledgement.
0xE014 LOC_MAClo — Local MAC address
0xE018 LOC_MAChi — Local MAC address
0xE020 SUPR_MAClo ro — Active ring supervisor's MAC address
0xE024 SUPR_MAChi ro — Active ring supervisor's MAC address
0xE028 STATE_VLAN ro — DLR Ring state
0xE02C BEC_TMOUT ro — Beacon timeout timer value
0xE030 BEC_INTRVL ro — Beacon interval
0xE034 SUPR_IPADR ro — Ring supervisor's IP address
0xE038 ETH_STYP_VER ro — DLR Ring Ether sub Type and Protocol Version
0xE03C INV_TMOUT ro — Last out of range Beacon timeout timer value
0xE040 SEQ_ID ro — Sequence ID of the last Beacon frame
0xE060 RX_STAT0 ro — Number of Beacon frames received on port 0
0xE064 RX_ERR_STAT0 ro — Number of Beacon frames received with crc error on port 0.
0xE068 TX_STAT0 ro — Number of Beacon frames forwarded through the HUB from port 1 to port0
0xE070 RX_STAT1 ro — Number of Beacon frames received on port 1.
0xE074 RX_ERR_STAT1 ro — Number of Beacon frames received with crc error on port 1.
0xE078 TX_STAT1 ro — Number of Beacon frames forwarded through the HUB from port 0 to port1

## Notices in the file
Copyright (C) 2012 ARM Limited. All rights reserved.
