# RZ_A1LU register map
Vendor: Renesas Electronics Corporation.; Series: RZ; File version: 3
ARM Cortex-A9 MPCore
CPU: other r3p0, little endian, MPU, no FPU, 3 interrupt priority bits
Registers are 32-bit, read-write, no defined reset value unless marked. A register's access mark holds for its fields unless they carry their own. Offsets are from the block's base; lines under a group give offsets from that group; [hi:lo] are bit positions; {n}, {i} and the like mark numbered series; 'fields as' and 'values as' point back to an identical list; <NAME> marks a mode.

## Memory map
0x3FEFA000 SPIBSC0 size 0x6C
0x3FFFC000 BSC size 0x88
0x3FFFF000 L2C size 0xF84
0xE8005800 ADC size 0x66
0xE8007000 SCIF0 size 0x2A
0xE8007800 SCIF1 size 0x2A
0xE8008000 SCIF2 size 0x2A
0xE8008800 SCIF3 size 0x2A
0xE8009000 SCIF4 size 0x2A
0xE800B000 SCIM0 size 0xE
0xE800B800 SCIM1 size 0xE
0xE800C800 RSPI0 size 0x24
0xE800D000 RSPI1 size 0x24
0xE800D800 RSPI2 size 0x24
0xE8010000 USB200 size 0x1A0
0xE8012000 SPDIF size 0x38
0xE8014000 IRDA size 0x1
0xE8017000 JCU size 0x321
0xE803A000 RSCAN0 size 0x180B
0xE804C800 MMC size 0x80
0xE8200000 DMAC size 0x14DE1020
0xE8201000 INTC size 0x14DEE80E
0xE8203000 ETHER size 0x1A00
0xE8207000 USB201 size 0x1A0
0xE8208000 SCUX size 0x1778
0xE820B000 SSIF0 size 0x30
0xE820B800 SSIF1 size 0x30
0xE820C000 SSIF2 size 0x30
0xE820C800 SSIF3 size 0x30
0xE8210000 CEU size 0x20A0
0xE8215000 ETHAVB size 0x77C
0xFCFE0000 WDT size 0x6
0xFCFE0010 CPG size 0x11801
0xFCFE1A00 INB size 0x5C
0xFCFE3004 GPIO size 0x4EFE
0xFCFEC000 OSTM0 size 0x21
0xFCFEC400 OSTM1 size 0x21
0xFCFEE000 RIIC0 size 0x47
0xFCFEE400 RIIC1 size 0x47
0xFCFEE800 RIIC2 size 0x47
0xFCFEEC00 RIIC3 size 0x47
0xFCFF0000 MTU2 size 0x391
0xFCFF1000 RTC size 0x2E
0xFCFF7400 VDC50 size 0xA24

## Further device data
vendorExtensionText: text=vendorExtensions1 vendorExtensions2 vendorExtensions3 vendorExtensions4

## SPIBSC0
Base 0x3FEFA000
0x00 CMNCR_0
0x04 SSLDR_0
0x08 SPBCR_0
0x0C DRCR_0
0x10 DRCMR_0
0x14 DREAR_0
0x18 DROPR_0
0x1C DRENR_0
0x20 SMCR_0
0x24 SMCMR_0
0x28 SMADR_0
0x2C SMOPR_0
0x30 SMENR_0
0x38 SMRDR0_0
0x3C SMRDR1_0
0x40 SMWDR0_0
0x44 SMWDR1_0
0x48 CMNSR_0
0x50 CKDLY_0
0x58 DRDMCR_0
0x5C DRDRENR_0
0x60 SMDMCR_0
0x64 SMDRENR_0
0x68 SPODLY_0

## BSC
Base 0x3FFFC000
0x00 CMNCR
{0x4+4i} CS{i}BCR (i=0..5)
{0x28+4i} CS{i}WCR (i=0..5)
0x4C SDCR
0x50 RTCSR
0x54 RTCNT
0x58 RTCOR
{0x60+4i} TOSCOR{i} (i=0..5)
0x80 TOSTR
0x84 TOENR

## L2C
Base 0x3FFFF000
0x00 REG0_CACHE_ID
0x04 REG0_CACHE_TYPE
0x100 REG1_CONTROL
0x104 REG1_AUX_CONTROL
0x108 REG1_TAG_RAM_CONTROL
0x10C REG1_DATA_RAM_CONTROL
0x200 REG2_EV_COUNTER_CTRL
0x204 REG2_EV_COUNTER1_CFG
0x208 REG2_EV_COUNTER0_CFG
0x20C REG2_EV_COUNTER1
0x210 REG2_EV_COUNTER0
0x214 REG2_INT_MASK
0x218 REG2_INT_MASK_STATUS
0x21C REG2_INT_RAW_STATUS
0x220 REG2_INT_CLEAR
0x730 REG7_CACHE_SYNC
0x770 REG7_INV_PA
0x77C REG7_INV_WAY
0x7B0 REG7_CLEAN_PA
0x7B8 REG7_CLEAN_INDEX
0x7BC REG7_CLEAN_WAY
0x7F0 REG7_CLEAN_INV_PA
0x7F8 REG7_CLEAN_INV_INDEX
0x7FC REG7_CLEAN_INV_WAY
{0x900+8i} REG9_D_LOCKDOWN{i} (i=0..7)
{0x904+8i} REG9_I_LOCKDOWN{i} (i=0..7)
0x950 REG9_LOCK_LINE_EN
0x954 REG9_UNLOCK_WAY
0xC00 REG12_ADDR_FILTERING_START
0xC04 REG12_ADDR_FILTERING_END
0xF40 REG15_DEBUG_CTRL
0xF60 REG15_PREFETCH_CTRL
0xF80 REG15_POWER_CTRL

## ADC
Base 0xE8005800
0x00 ADDRA 16-bit
0x02 ADDRB 16-bit
0x04 ADDRC 16-bit
0x06 ADDRD 16-bit
0x08 ADDRE 16-bit
0x0A ADDRF 16-bit
0x0C ADDRG 16-bit
0x0E ADDRH 16-bit
0x20 ADCMPHA 16-bit
0x22 ADCMPLA 16-bit
0x24 ADCMPHB 16-bit
0x26 ADCMPLB 16-bit
0x28 ADCMPHC 16-bit
0x2A ADCMPLC 16-bit
0x2C ADCMPHD 16-bit
0x2E ADCMPLD 16-bit
0x30 ADCMPHE 16-bit
0x32 ADCMPLE 16-bit
0x34 ADCMPHF 16-bit
0x36 ADCMPLF 16-bit
0x38 ADCMPHG 16-bit
0x3A ADCMPLG 16-bit
0x3C ADCMPHH 16-bit
0x3E ADCMPLH 16-bit
0x60 ADCSR 16-bit
0x62 ADCMPER 16-bit
0x64 ADCMPSR 16-bit

## SCIF0
Base 0xE8007000
0x00 SCSMR_0 16-bit
0x04 SCBRR_0 8-bit
0x08 SCSCR_0 16-bit
0x0C SCFTDR_0 8-bit
0x10 SCFSR_0 16-bit
0x14 SCFRDR_0 8-bit
0x18 SCFCR_0 16-bit
0x1C SCFDR_0 16-bit
0x20 SCSPTR_0 16-bit
0x24 SCLSR_0 16-bit
0x28 SCEMR_0 16-bit
