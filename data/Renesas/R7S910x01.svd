# R7S910x01 register map
Vendor: Renesas Electronics Corporation; Series: RZT; File version: 1.0
CPU: other r1p4, little endian, MPU, FPU, vendor SysTick, 1 interrupt priority bits
Registers are 32-bit, read-write, no defined reset value unless marked. A register's access mark holds for its fields unless they carry their own. Offsets are from the block's base; [hi:lo] are bit positions; {n}, {i} and the like mark numbered series.

## USBf — USB2.0 Function module
Base 0xA0060000; register names take the prefix USBf_
0x00 SYSCFG0 16-bit — System configuration control register 0
0x02 SYSCFG1 16-bit — System configuration control register 1
0x04 SYSSTS0 16-bit ro — System configuration status register
0x08 DVSTCTR0 16-bit — Device control register 0
0x0C TESTMODE 16-bit
0x10 D0FBCFG 16-bit — DMA0-FIFO bus configuration register
0x12 D1FBCFG 16-bit — DMA1-FIFO bus configuration register
0x14 CFIFO — CFIFO port register
0x18 D0FIFO — D0FIFO port register
0x1C D1FIFO — D1FIFO port register
0x20 CFIFOSEL 16-bit — CFIFO port select register
0x22 CFIFOCTR 16-bit — CFIFO port control register
0x28 D0FIFOSEL 16-bit — D0FIFO port select register
0x2A D0FIFOCTR 16-bit — D0FIFO port control register
0x2C D1FIFOSEL 16-bit — D1FIFO port select register
0x2E D1FIFOCTR 16-bit — D1FIFO port control register
0x30 INTENB0 16-bit — Interrupt enable register 0
0x36 BRDYENB 16-bit — BRDY interrupt enable register
0x38 NRDYENB 16-bit — NRDY interrupt enable register
0x3A BEMPENB 16-bit — BEMP interrupt enable register
0x3C SOFCFG 16-bit — SOF output configuration register
0x40 INTSTS0 16-bit — Interrupt status register 0
0x46 BRDYSTS 16-bit — BRDY interrupt status register
0x48 NRDYSTS 16-bit — NRDY interrupt status register
0x4A BEMPSTS 16-bit — BEMP interrupt status register
0x4C FRMNUM 16-bit — Frame number register
0x4E UFRMNUM 16-bit ro — Micro frame number register
0x50 USBADDR 16-bit ro — USB address register
0x54 USBREQ 16-bit — USB request type register
0x56 USBVAL 16-bit — USB request value register
0x58 USBINDX 16-bit — USB request index register
0x5A USBLENG 16-bit — USB request length register
0x5C DCPCFG 16-bit — DCP configuration register
0x5E DCPMAXP 16-bit — DCP max packet size register
0x60 DCPCTR 16-bit — DCP control register
0x64 PIPESEL 16-bit — Pipe window select register
0x68 PIPECFG 16-bit — Pipe configuration register
0x6A PIPEBUF 16-bit — Pipe buffer specification register
0x6C PIPEMAXP 16-bit — Pipe max packet size register
0x6E PIPEPERI 16-bit — Pipe cycle control register
{0x6E+2i} PIPE{i}CTR 16-bit (i=1..9) — PIPE{i} control register
{0x8C+4i} PIPE{i}TRE 16-bit (i=1..5) — PIPE{i} transaction counter enable register
{0x8E+4i} PIPE{i}TRN 16-bit (i=1..5) — PIPE{i} transaction counter register
0x100 LPCTRL 16-bit — Low-power control register
0x102 LPSTS 16-bit — Low-power status register
0x104 PHYFUNCTR 16-bit — PHY function control register
{0x160+4i} D0FIFOB{i} (i=0..7) — D0FIFO continuous transfer port register {i}
{0x180+4i} D1FIFOB{i} (i=0..7) — D1FIFO continuous transfer port register {i}
0x1A0 PHYSET1 16-bit — PHY configuration register 1

## SCIFA0 — FIFO embedded serial communications interface 0
Base 0xA0065000; register names take the prefix SCIFA0_
0x00 SMR 16-bit — Serial mode register
0x02 BRR 8-bit — Bit rate register
0x02 MDDR 8-bit (alternate view of BRR) — Modulation duty register
0x04 SCR 16-bit — Serial control register
0x06 FTDR 8-bit wo — Transmit FIFO data register
0x08 FSR 16-bit — Serial status register
0x0A FRDR 8-bit ro — Receive FIFO data register
0x0C FCR 16-bit — FIFO control register
0x0E FDR 16-bit ro — FIFO data count register
0x10 SPTR 16-bit — Serial port register
0x12 LSR 16-bit — Line status register
0x14 SEMR 8-bit — Serial extended mode register
0x16 FTCR 16-bit — FIFO trigger control register

## SCIFA1 — FIFO embedded serial communications interface 1
Base 0xA0065400; register names take the prefix SCIFA1_
Registers as SCIFA0.

## SCIFA2 — FIFO embedded serial communications interface 2
Base 0xA0065800; register names take the prefix SCIFA2_
Registers as SCIFA0.

## SCIFA3 — FIFO embedded serial communications interface 3
Base 0xA0065C00; register names take the prefix SCIFA3_
Registers as SCIFA0.

## SCIFA4 — FIFO embedded serial communications interface 4
Base 0xA0066000; register names take the prefix SCIFA4_
Registers as SCIFA0.
