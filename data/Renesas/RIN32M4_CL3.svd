# RIN32M4_CL3 register map
Vendor: Renesas Electronics Corporation; Series: RIN32M4_CL3; File version: 0.1
CPU: CM4F r0p1, little endian, MPU, FPU, 4 interrupt priority bits
Registers are 32-bit, read-write, reset 0x0 unless marked. A register's access mark holds for its fields unless they carry their own. Offsets are from the block's base; [hi:lo] are bit positions; {n}, {i} and the like mark numbered series.

## CAN0 — CAN
Base 0x40020000
Same registers: CAN1 0x40040000
0x08 FCNnGMCSPRE 8-bit reset 0xF — global clock selection register
0x20 FCNnGMADCTL 8-bit — global automatic block transmission delay setting register
0x248 FCNnCMLCSTR 8-bit — module last error information register
0x24C FCNnCMINSTR 8-bit ro — module information register
0x268 FCNnCMBRPRS 8-bit reset 0xFF — module bit-rate prescaler and clock selector register
0x278 FCNnCMLISTR 8-bit ro reset not defined — module last receive pointer register
0x288 FCNnCMLOSTR 8-bit ro reset not defined — module last transmit pointer register
{0x1000+4i} FCNnMmDAT{i}B (i=0..7) 8-bit — Message buffer register a (Byte data)
0x1020 FCNnMmDTLGB 8-bit — Message data length register
0x1024 FCNnMmSTRB 8-bit — Message configuration register
0x8000 FCNnGMCLCTL 16-bit reset not defined — global control register
0x8018 FCNnGMABCTL 16-bit — global automatic block transmission control register
0x8240 FCNnCMCLCTL 16-bit — module control register
0x8250 FCNnCMERCNT 16-bit ro — module error counter register
0x8258 FCNnCMIECTL 16-bit — module interrupt enable register
0x8260 FCNnCMISCTL 16-bit — module interrupt status register
0x8270 FCNnCMBTCTL 16-bit reset 0x370F — module bit-rate register
0x8280 FCNnCMRGRX 16-bit reset not defined — module receive history list register
0x8290 FCNnCMTGTX 16-bit reset not defined — module transmit history list register
0x8298 FCNnCMTSCTL 16-bit — module time stamp register
0x8300 FCNnCMMKCTL01H 16-bit — module mask 1 register [15 to 0]
0x8308 FCNnCMMKCTL02H 16-bit — module mask 1 register [28 to 16]
0x8310 FCNnCMMKCTL03H 16-bit — module mask 2 register [15 to 0]
0x8318 FCNnCMMKCTL04H 16-bit — module mask 2 register [28 to 16]
0x8320 FCNnCMMKCTL05H 16-bit — module mask 3 register [15 to 0]
0x8328 FCNnCMMKCTL06H 16-bit — module mask 3 register [28 to 16]
0x8330 FCNnCMMKCTL07H 16-bit — module mask 4 register [15 to 0]
0x8338 FCNnCMMKCTL08H 16-bit — module mask 4 register [28 to 16]
0x8340 FCNnCMMKCTL09H 16-bit — module mask 5 register [15 to 0]
0x8348 FCNnCMMKCTL10H 16-bit — module mask 5 register [28 to 16]
0x8350 FCNnCMMKCTL11H 16-bit — module mask 6 register [15 to 0]
0x8358 FCNnCMMKCTL12H 16-bit — module mask 6 register [28 to 16]
0x8360 FCNnCMMKCTL13H 16-bit — module mask 7 register [15 to 0]
0x8368 FCNnCMMKCTL14H 16-bit — module mask 7 register [28 to 16]
0x8370 FCNnCMMKCTL15H 16-bit — module mask 8 register [15 to 0]
0x8378 FCNnCMMKCTL16H 16-bit — module mask 8 register [28 to 16]
0x9000 FCNnMmDAT{x}H (x=0,2,4,6; step 0x8) 16-bit — Message buffer register a (Half word data)
{0x9028+8i} FCNnMmMID{i}H (i=0..1) 16-bit — Message ID register a (Half word data)
0x9038 FCNnMmCTL 16-bit — Message control register
0x100C0 FCNnDNBMRX0 ro — global data update bit monitor register 0
0x100D0 FCNnDNBMRX1 ro — global data update bit monitor register 1
0x10300 FCNnCMMKCTL01W — module mask 1 register [28 to 0]
0x10310 FCNnCMMKCTL03W — module mask 2 register [28 to 0]
0x10320 FCNnCMMKCTL05W — module mask 3 register [28 to 0]
0x10330 FCNnCMMKCTL07W — module mask 4 register [28 to 0]
0x10340 FCNnCMMKCTL09W — module mask 5 register [28 to 0]
0x10350 FCNnCMMKCTL11W — module mask 6 register [28 to 0]
0x10360 FCNnCMMKCTL13W — module mask 7 register [28 to 0]
0x10370 FCNnCMMKCTL15W — module mask 8 register [28 to 0]
0x11000 FCNnMmDAT{x}W (x=0,4; step 0x10) — Message buffer register a (Word data)
0x11028 FCNnMmMID0W — Message ID register 0 (Word data)

## ETH — Ethernet MAC
Base 0x40090000
0x0C GMAC_TXID ro — TXID
0x10 GMAC_TXRESULT ro — TX Result
0x20 GMAC_MODE — MODE
0x24 GMAC_RXMODE reset 0x20000000 — RX MODE
0x28 GMAC_TXMODE — TX MODE
0x30 GMAC_RESET wo — RESET
{0x7C+4i} GMAC_PAUSE{i} (i=1..5) — Pause Packet {i}
0x98 GMAC_FLWCTL — RX Flow Control
0x9C GMAC_PAUSPKT — Pause PKT
0xA0 GMAC_MIIM reset 0x4000000 — MIIM
{0xF8+8i} GMAC_ADR{i}A (i=1..16) — MAC Address {i}A
{0xFC+8i} GMAC_ADR{i}B reset 0xFF0000 (i=1..16) — MAC Address {i}B
0x200 GMAC_RXFIFO ro reset 0x40000000 — RX FIFO
0x204 GMAC_TXFIFO ro reset 0x60000000 — TX FIFO
0x208 GMAC_ACC reset 0x3 — TCPIP Acc
0x220 GMAC_RXMAC_ENA reset 0x1 — RXMAC Enable
0x224 GMAC_LPI_MODE — LPI Mode
0x228 GMAC_LPI_TIMING reset 0x80F — LPI Timing
