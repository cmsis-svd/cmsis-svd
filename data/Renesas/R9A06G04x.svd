# R9A06G04x register map
Vendor: Renesas Electronics Corporation; Series: EC1; File version: 1
CPU: other r1p4, little endian, MPU, FPU, vendor SysTick, 1 interrupt priority bits
Registers are 32-bit, read-write, no defined reset value unless marked. A register's access mark holds for its fields unless they carry their own. Offsets are from the block's base; [hi:lo] are bit positions; {n}, {i} and the like mark numbered series.

## RSCAN — CAN module
Base 0xA0078000; register names take the prefix RSCAN_
0x10 RSCAN0C1CFG — Channel 1 configuration register
0x14 RSCAN0C1CTR — Channel 1 control register
0x18 RSCAN0C1STS ro — Channel 1 status register
0x1C RSCAN0C1ERFL — Channel 1 error flag register
0x84 RSCAN0GCFG — Global configuration register
0x88 RSCAN0GCTR — Global control register
0x8C RSCAN0GSTS ro — Global status register
0x90 RSCAN0GERFL — Global error flag register
0x94 RSCAN0GTSC ro — Global time stamp counter register
0x98 RSCAN0GAFLECTR — Receive rule entry control register
0x9C RSCAN0GAFLCFG0 — Receive rule configuration register 0
0xA4 RSCAN0RMNB — Receive buffer number register
0xA8 RSCAN0RMND0 — Receive buffer new data register 0
{0xB8+4i} RSCAN0RFCC{i} (i=0..7) — Receive FIFO buffer configuration and control register {i}
{0xD8+4i} RSCAN0RFSTS{i} (i=0..7) — Receive FIFO buffer status register {i}
{0xF8+4i} RSCAN0RFPCTR{i} wo (i=0..7) — Receive FIFO buffer pointer control register {i}
{0x118+4i} RSCAN0CFCC{i} (i=3..5) — Transmit/receive FIFO buffer configuration and control register {i}
{0x178+4i} RSCAN0CFSTS{i} (i=3..5) — Transmit/receive FIFO buffer status register {i}
{0x1D8+4i} RSCAN0CFPCTR{i} wo (i=3..5) — Transmit/receive FIFO buffer pointer control register {i}
0x238 RSCAN0FESTS ro — FIFO empty status register
0x23C RSCAN0FFSTS ro — FIFO full status register
0x240 RSCAN0FMSTS ro — FIFO Msg lost status register
0x244 RSCAN0RFISTS ro — Receive FIFO buffer interrupt flag status register
0x248 RSCAN0CFRISTS ro — Transmit/receive FIFO buffer receive interrupt flag Status register
0x24C RSCAN0CFTISTS ro — Transmit/receive FIFO buffer transmit interrupt flag status register
{0x250+i} RSCAN0TMC{i} 8-bit (i=16..31) — Transmit buffer control register {i}
{0x2D0+i} RSCAN0TMSTS{i} 8-bit (i=16..31) — Transmit buffer status register {i}
0x350 RSCAN0TMTRSTS0 ro — Transmit buffer transmit request status register 0
0x360 RSCAN0TMTARSTS0 ro — Transmit buffer transmit abort request status register 0
0x370 RSCAN0TMTCSTS0 ro — Transmit buffer transmit complete status register 0
0x380 RSCAN0TMTASTS0 ro — Transmit buffer transmit abort status register 0
0x390 RSCAN0TMIEC0 — Transmit buffer interrupt enable configuration register 0
0x3A4 RSCAN0TXQCC1 — Transmit queue configuration and control register 1
0x3C4 RSCAN0TXQSTS1 — Transmit queue status register 1
0x3E4 RSCAN0TXQPCTR1 wo — Transmit queue pointer control register 1
0x404 RSCAN0THLCC1 — Transmission history configuration and control register 1
0x424 RSCAN0THLSTS1 — Transmission history status register 1
0x444 RSCAN0THLPCTR1 wo — Transmission history pointer control register 1
0x460 RSCAN0GTINTSTS0 ro — Global TX interrupt status register 0
0x468 RSCAN0GTSTCFG — Global test configuration register
0x46C RSCAN0GTSTCTR — Global test control register
0x47C RSCAN0GLOCKK wo — Global lock key register
{0x500+0x10*i} RSCAN0GAFLID{i} (i=0..15) — Receive rule ID register {i}
{0x504+0x10*i} RSCAN0GAFLM{i} (i=0..15) — Receive rule mask register {i}
{0x508+0x10*i} RSCAN0GAFLP{i:02} (i=0..9) — Receive rule pointer 0 register {i}
0x50C RSCAN0GAFLP10 — Receive rule pointer 1 register 0
0x51C RSCAN0GAFLP11 — Receive rule pointer 1 register 1
0x52C RSCAN0GAFLP12 — Receive rule pointer 1 register 2
0x53C RSCAN0GAFLP13 — Receive rule pointer 1 register 3
0x54C RSCAN0GAFLP14 — Receive rule pointer 1 register 4
0x55C RSCAN0GAFLP15 — Receive rule pointer 1 register 5
{0x46C+0x10*i} RSCAN0GAFLP{i} (i=16..19) — Receive rule pointer 1 register {i-10}
0x5A8 RSCAN0GAFLP010 — Receive rule pointer 0 register 10
0x5AC RSCAN0GAFLP110 — Receive rule pointer 1 register 10
0x5B8 RSCAN0GAFLP011 — Receive rule pointer 0 register 11
0x5BC RSCAN0GAFLP111 — Receive rule pointer 1 register 11
0x5C8 RSCAN0GAFLP012 — Receive rule pointer 0 register 12
0x5CC RSCAN0GAFLP112 — Receive rule pointer 1 register 12
0x5D8 RSCAN0GAFLP013 — Receive rule pointer 0 register 13
0x5DC RSCAN0GAFLP113 — Receive rule pointer 1 register 13
0x5E8 RSCAN0GAFLP014 — Receive rule pointer 0 register 14
0x5EC RSCAN0GAFLP114 — Receive rule pointer 1 register 14
0x5F8 RSCAN0GAFLP015 — Receive rule pointer 0 register 15
0x5FC RSCAN0GAFLP115 — Receive rule pointer 1 register 15
{0x600+0x10*i} RSCAN0RMID{i} ro (i=16..31) — Receive buffer ID register {i}
{0x604+0x10*i} RSCAN0RMPTR{i} ro (i=16..31) — Receive buffer pointer register {i}
{0x608+0x10*i} RSCAN0RMDF{i:03} ro (i=16..31) — Receive buffer data field 0 register {i}
0x70C RSCAN0RMDF116 ro — Receive buffer data field 1 register 16
0x71C RSCAN0RMDF117 ro — Receive buffer data field 1 register 17
0x72C RSCAN0RMDF118 ro — Receive buffer data field 1 register 18
0x73C RSCAN0RMDF119 ro — Receive buffer data field 1 register 19
0x74C RSCAN0RMDF120 ro — Receive buffer data field 1 register 20
0x75C RSCAN0RMDF121 ro — Receive buffer data field 1 register 21
0x76C RSCAN0RMDF122 ro — Receive buffer data field 1 register 22
0x77C RSCAN0RMDF123 ro — Receive buffer data field 1 register 23
0x78C RSCAN0RMDF124 ro — Receive buffer data field 1 register 24
0x79C RSCAN0RMDF125 ro — Receive buffer data field 1 register 25
0x7AC RSCAN0RMDF126 ro — Receive buffer data field 1 register 26
0x7BC RSCAN0RMDF127 ro — Receive buffer data field 1 register 27
0x7CC RSCAN0RMDF128 ro — Receive buffer data field 1 register 28
0x7DC RSCAN0RMDF129 ro — Receive buffer data field 1 register 29
0x7EC RSCAN0RMDF130 ro — Receive buffer data field 1 register 30
0x7FC RSCAN0RMDF131 ro — Receive buffer data field 1 register 31
{0xE00+0x10*i} RSCAN0RFID{i} ro (i=0..7) — Receive FIFO buffer access ID register {i}
{0xE04+0x10*i} RSCAN0RFPTR{i} ro (i=0..7) — Receive FIFO buffer access pointer register {i}
{0xE08+0x10*i} RSCAN0RFDF{i:02} ro (i=0..7) — Receive FIFO buffer access data field 0 register {i}
{0xD6C+0x10*i} RSCAN0RFDF{i} ro (i=10..17) — Receive FIFO buffer access data field 1 register {i-10}
{0xE80+0x10*i} RSCAN0CFID{i} (i=3..5) — Transmit/receive FIFO buffer access ID register {i}
{0xE84+0x10*i} RSCAN0CFPTR{i} (i=3..5) — Transmit/receive FIFO buffer access pointer register {i}
{0xE88+0x10*i} RSCAN0CFDF{i:02} (i=3..5) — Transmit/receive FIFO buffer access data field 0 register {i}
{0xDEC+0x10*i} RSCAN0CFDF{i} (i=13..15) — Transmit/receive FIFO buffer access data field 1 register {i-10}
{0x1000+0x10*i} RSCAN0TMID{i} (i=16..31) — Transmit buffer ID register {i}
{0x1004+0x10*i} RSCAN0TMPTR{i} (i=16..31) — Transmit buffer pointer register {i}
{0x1008+0x10*i} RSCAN0TMDF{i:03} (i=16..31) — Transmit buffer data field 0 register {i}
{0x9CC+0x10*i} RSCAN0TMDF{i} (i=116..131) — Transmit buffer data field 1 register {i-100}
0x1804 RSCAN0THLACC1 ro — Transmission history access register 1
{0x1900+4i} RSCAN0RPGACC{i} (i=0..63) — RAM test page access register {i}
0x3000 ECCRCANCTL — RSCAN ECC control register
{0x3010+4i} ECCRCANEAD{i} ro (i=0..7) — RSCAN ECC error address register {i}
