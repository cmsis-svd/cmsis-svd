# R7S910x28 register map
Vendor: Renesas Electronics Corporation; Series: RZT; File version: 1.0
CPU: other r1p4, little endian, MPU, FPU, vendor SysTick, 1 interrupt priority bits
Registers are 32-bit, read-write, no defined reset value unless marked. A register's access mark holds for its fields unless they carry their own. Offsets are from the block's base; [hi:lo] are bit positions; {n}, {i} and the like mark numbered series.

## PORT — I/O port
Base 0xA0000000; register names take the prefix PORT_
{0x0+2i} PORT{i}_PDR 16-bit (i=0..9) — Port direction register
0x14 PORTA_PDR 16-bit — Port direction register
0x16 PORTB_PDR 16-bit — Port direction register
0x18 PORTC_PDR 16-bit — Port direction register
0x1A PORTD_PDR 16-bit — Port direction register
0x1C PORTE_PDR 16-bit — Port direction register
0x1E PORTF_PDR 16-bit — Port direction register
0x20 PORTG_PDR 16-bit — Port direction register
0x22 PORTH_PDR 16-bit — Port direction register
0x24 PORTJ_PDR 16-bit — Port direction register
0x26 PORTK_PDR 16-bit — Port direction register
0x28 PORTL_PDR 16-bit — Port direction register
0x2A PORTM_PDR 16-bit — Port direction register
0x2C PORTN_PDR 16-bit — Port direction register
0x2E PORTP_PDR 16-bit — Port direction register
0x30 PORTR_PDR 16-bit — Port direction register
0x32 PORTS_PDR 16-bit — Port direction register
0x34 PORTT_PDR 16-bit — Port direction register
0x36 PORTU_PDR 16-bit — Port direction register
{0x40+i} PORT{i}_PODR 8-bit (i=0..9) — Port output data register
0x4A PORTA_PODR 8-bit — Port output data register
0x4B PORTB_PODR 8-bit — Port output data register
0x4C PORTC_PODR 8-bit — Port output data register
0x4D PORTD_PODR 8-bit — Port output data register
0x4E PORTE_PODR 8-bit — Port output data register
0x4F PORTF_PODR 8-bit — Port output data register
0x50 PORTG_PODR 8-bit — Port output data register
0x51 PORTH_PODR 8-bit — Port output data register
0x52 PORTJ_PODR 8-bit — Port output data register
0x53 PORTK_PODR 8-bit — Port output data register
0x54 PORTL_PODR 8-bit — Port output data register
0x55 PORTM_PODR 8-bit — Port output data register
0x56 PORTN_PODR 8-bit — Port output data register
0x57 PORTP_PODR 8-bit — Port output data register
0x58 PORTR_PODR 8-bit — Port output data register
0x59 PORTS_PODR 8-bit — Port output data register
0x5A PORTT_PODR 8-bit — Port output data register
0x5B PORTU_PODR 8-bit — Port output data register
{0x60+i} PORT{i}_PIDR 8-bit ro (i=0..9) — Port input data register
0x6A PORTA_PIDR 8-bit ro — Port input data register
0x6B PORTB_PIDR 8-bit ro — Port input data register
0x6C PORTC_PIDR 8-bit ro — Port input data register
0x6D PORTD_PIDR 8-bit ro — Port input data register
0x6E PORTE_PIDR 8-bit ro — Port input data register
0x6F PORTF_PIDR 8-bit ro — Port input data register
0x70 PORTG_PIDR 8-bit ro — Port input data register
0x71 PORTH_PIDR 8-bit ro — Port input data register
0x72 PORTJ_PIDR 8-bit ro — Port input data register
0x73 PORTK_PIDR 8-bit ro — Port input data register
0x74 PORTL_PIDR 8-bit ro — Port input data register
0x75 PORTM_PIDR 8-bit ro — Port input data register
0x76 PORTN_PIDR 8-bit ro — Port input data register
0x77 PORTP_PIDR 8-bit ro — Port input data register
0x78 PORTR_PIDR 8-bit ro — Port input data register
0x79 PORTS_PIDR 8-bit ro — Port input data register
0x7A PORTT_PIDR 8-bit ro — Port input data register
0x7B PORTU_PIDR 8-bit ro — Port input data register
{0x80+i} PORT{i}_PMR 8-bit (i=0..9) — Port mode register
0x8A PORTA_PMR 8-bit — Port mode register
0x8B PORTB_PMR 8-bit — Port mode register
0x8C PORTC_PMR 8-bit — Port mode register
0x8D PORTD_PMR 8-bit — Port mode register
0x8E PORTE_PMR 8-bit — Port mode register
0x8F PORTF_PMR 8-bit — Port mode register
0x90 PORTG_PMR 8-bit — Port mode register
0x91 PORTH_PMR 8-bit — Port mode register
0x92 PORTJ_PMR 8-bit — Port mode register
0x93 PORTK_PMR 8-bit — Port mode register
0x94 PORTL_PMR 8-bit — Port mode register
0x95 PORTM_PMR 8-bit — Port mode register
0x96 PORTN_PMR 8-bit — Port mode register
0x97 PORTP_PMR 8-bit — Port mode register
0x98 PORTR_PMR 8-bit — Port mode register
0x99 PORTS_PMR 8-bit — Port mode register
0x9A PORTT_PMR 8-bit — Port mode register
0x9B PORTU_PMR 8-bit — Port mode register
{0x100+2i} PORT{i}_PCR 16-bit (i=0..9) — Pull-up/pull-down control register
0x114 PORTA_PCR 16-bit — Pull-up/pull-down control register
0x116 PORTB_PCR 16-bit — Pull-up/pull-down control register
0x11A PORTD_PCR 16-bit — Pull-up/pull-down control register
0x11C PORTE_PCR 16-bit — Pull-up/pull-down control register
0x11E PORTF_PCR 16-bit — Pull-up/pull-down control register
0x120 PORTG_PCR 16-bit — Pull-up/pull-down control register
0x122 PORTH_PCR 16-bit — Pull-up/pull-down control register
0x124 PORTJ_PCR 16-bit — Pull-up/pull-down control register
0x126 PORTK_PCR 16-bit — Pull-up/pull-down control register
0x128 PORTL_PCR 16-bit — Pull-up/pull-down control register
0x12A PORTM_PCR 16-bit — Pull-up/pull-down control register
0x12C PORTN_PCR 16-bit — Pull-up/pull-down control register
0x12E PORTP_PCR 16-bit — Pull-up/pull-down control register
0x130 PORTR_PCR 16-bit — Pull-up/pull-down control register
0x132 PORTS_PCR 16-bit — Pull-up/pull-down control register
0x134 PORTT_PCR 16-bit — Pull-up/pull-down control register
0x136 PORTU_PCR 16-bit — Pull-up/pull-down control register
0x142 PORT1_DSCR 16-bit — Drive strength control register
