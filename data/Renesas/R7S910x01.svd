# R7S910x01 register map
Vendor: Renesas Electronics Corporation; Series: RZT; File version: 1.0
CPU: other r1p4, little endian, MPU, FPU, vendor SysTick, 1 interrupt priority bits
Registers are 32-bit, read-write, no defined reset value unless marked. A register's access mark holds for its fields unless they carry their own. Offsets are from the block's base; [hi:lo] are bit positions; {n}, {i} and the like mark numbered series.

## BSC — Bus state controller
Base 0xA0002000; register names take the prefix BSC_
0x00 CMNCR — Common control register
{0x4+4i} CS{i}BCR (i=0..5) — CS{i} space bus control register
0x28 CS0WCR_0 — CS0 space wait control register
0x28 CS0WCR_1 (alternate view of CS0WCR_0) — CS0 space wait control register
0x28 CS0WCR_2 (alternate view of CS0WCR_0) — CS0 space wait control register
0x2C CS1WCR — CS1 space wait control register
{0x28+4i} CS{i}WCR_0 (i=2..4) — CS{i} space wait control register
{0x28+4i} CS{i}WCR_1 (alternate view of CS{i}WCR_0) (i=2..4) — CS{i} space wait control register
0x3C CS5WCR — CS5 space wait control register
0x4C SDCR — SDRAM control register
0x50 RTCSR — Refresh timer control/status register
0x54 RTCNT — Refresh timer counter
0x58 RTCOR — Refresh time constant register
{0x60+4i} TOSCOR{i} (i=0..5) — Timeout cycle constant register {i}
0x80 TOSTR — Timeout status register
0x84 TOENR — Timeout enable register
0xC0C CKIOSET — CKIO Control register
0xCFC CKIOKEY 8-bit — KEY register of CKIOSET

## SPIBSC — SPI multi I/O bus controller
Base 0xA0005000; register names take the prefix SPIBSC_
0x00 CMNCR — Common control register
0x04 SSLDR — SSL delay register
0x08 SPBCR — Bit rate register
0x0C DRCR — Data read control register
0x10 DRCMR — Data read command setting register
0x14 DREAR — Data read extended address setting register
0x18 DROPR — Data read option setting register
0x1C DRENR — Data read enable setting register
0x20 SMCR — SPI mode control register
0x24 SMCMR — SPI mode command setting register
0x28 SMADR — SPI mode address setting register
0x2C SMOPR — SPI mode option setting register
0x30 SMENR — SPI mode enable setting register
0x38 SMRDR0 ro — SPI mode read data register 0
0x40 SMWDR0 — SPI mode write data register 0
0x48 CMNSR ro — Common status register
0x58 DRDMCR — Data read dummy cycle setting register
0x60 SMDMCR — SPI mode dummy cycle setting register

## VIC — Vectored interrupt controller
Base 0xA0010000; register names take the prefix VIC_
{0x0+4i} IRQS{i} ro (i=0..7) — IRQ status register {i}
{0x40+4i} RAIS{i} ro (i=0..7) — Interrupt input status register {i}
{0x80+4i} IEN{i} (i=0..7) — Interrupt enable register {i}
{0xA0+4i} IEC{i} wo (i=0..7) — Interrupt enable clear register {i}
{0x100+4i} PLS{i} (i=0..7) — Interrupt detection type select register {i}
{0x120+4i} PIC{i} wo (i=0..7) — Edge detection bit clear register {i}
0x1C0 PRLM0 — Interrupt priority level mask register 0
0x1C4 PRLC0 wo — Interrupt priority level mask clear register 0
0x1C8 UEN0 — User mode enable register 0
0x200 HVA0 wo — Interrupt address register 0
{0x210+4i} ISS{i} ro (i=0..7) — Interrupt service status register {i}
{0x230+4i} ISC{i} ro (i=0..7) — Interrupt service current register {i}
{0x400+4i} VAD{i} (i=1..255) — Interrupt address storage register {i}
{0x800+4i} PRL{i} (i=1..255) — Interrupt priority level storage register {i}
0x1000 IRQS8 ro — IRQ status register 8
0x1004 IRQS9 ro — IRQ status register 9
0x1040 RAIS8 ro — Interrupt input status register 8
0x1044 RAIS9 ro — Interrupt input status register 9
0x1080 IEN8 — Interrupt enable register 8
0x1084 IEN9 — Interrupt enable register 9
0x10A0 IEC8 wo — Interrupt enable clear register 8
0x10A4 IEC9 wo — Interrupt enable clear register 9
0x1100 PLS8 — Interrupt detection type select register 8
0x1104 PLS9 — Interrupt detection type select register 9
0x1120 PIC8 wo — Edge detection bit clear register 8
0x1124 PIC9 wo — Edge detection bit clear register 9
0x11C0 PRLM1 — Interrupt priority level mask register 1
0x11C4 PRLC1 wo — Interrupt priority level mask clear register 1
0x11C8 UEN1 — User mode enable register 1
0x1210 ISS8 ro — Interrupt service status register 8
0x1214 ISS9 ro — Interrupt service status register 9
0x1230 ISC8 ro — Interrupt service current register 8
0x1234 ISC9 ro — Interrupt service current register 9
{0x1000+4i} VAD{i} (i=256..300) — Interrupt address storage register {i}
{0x1400+4i} PRL{i} (i=256..300) — Interrupt priority level storage register {i}
