# R7F5A009 register map
Vendor: Renesas Electronics Corporation; Series: Tahoe; File version: 1
CPU: CM4 r0p4, little endian, MPU, FPU, 4 interrupt priority bits
Registers are 32-bit, read-write, no defined reset value unless marked. A register's access mark holds for its fields unless they carry their own. Offsets are from the block's base; [hi:lo] are bit positions; {n}, {i} and the like mark numbered series.

## SYSTEM_1 — System controller
Base 0x4008C280; register names take the prefix SYSTEM_1_
0x00 DPSBYCR 8-bit — Deep Standby Control Register
{0x2+i} DPSIER{i} 8-bit (i=0..2) — Deep Standby Interrupt Enable Register {i}
{0x6+i} DPSIFR{i} 8-bit (i=0..2) — Deep Standby Interrupt Flag Register {i}
{0xA+i} DPSIEGR{i} 8-bit (i=0..2) — Deep Standby Interrupt Edge Register {i}
0x10 RSTSR0 8-bit — Reset Status Register 0
0x11 RSTSR1 8-bit — Reset Status Register 1
0x13 MOFCR 8-bit — Main Clock Oscillator Forced Oscillation Control Register
0x14 hOCOPCR 8-bit — high-Speed Clock Oscillator Power Supply Control Register
0x16 FWEPROR 8-bit — Flash P/E Protect Register
0x17 LVCMPCR 8-bit — Voltage Monitoring Circuit Control Register
0x18 LVDLVLR 8-bit — Voltage Detection Level Select Register
0x1A LVD1CR0 8-bit — Voltage Monitoring 1 Circuit Control Register 0
0x1B LVD2CR0 8-bit — Voltage Monitoring 2 Circuit Control Register 0
0x1D VBATTMNSELR 8-bit — Battery Backup Voltage Monitor Function Select Register
0x1E VBATTMONR 8-bit — Battery Backup Voltage Monitor Register
{0x20+i} DPSBKR{i} 8-bit (i=0..31) — Deep Standby Backup Register {i}

## RTC — Real Time Clock
Base 0x4008C400; register names take the prefix RTC_
0x00 R64CNT 8-bit ro — 64-hz Counter
0x02 RSECCNT 8-bit — Second Counter
0x02 BCNT0 8-bit (alternate view of RSECCNT) — Binary Counter 0
0x04 RMINCNT 8-bit — Minute Counter
0x04 BCNT1 8-bit (alternate view of RMINCNT) — Binary Counter 1
0x06 RHRCNT 8-bit — hour Counter
0x06 BCNT2 8-bit (alternate view of RHRCNT) — Binary Counter 2
0x08 RWKCNT 8-bit — Day-of-Week Counter
0x08 BCNT3 8-bit (alternate view of RWKCNT) — Binary Counter 3
0x0A RDAYCNT 8-bit — Date Counter
0x0C RMONCNT 8-bit — Month Counter
0x0E RYRCNT 16-bit — Year Counter
0x10 RSECAR 8-bit — Second Alarm Register
0x10 BCNT0AR 8-bit (alternate view of RSECAR) — Binary Counter 0 Alarm Register
0x12 RMINAR 8-bit — Minute Alarm Register
0x12 BCNT1AR 8-bit (alternate view of RMINAR) — Binary Counter 1 Alarm Register
0x14 RHRAR 8-bit — hour Alarm Register
0x14 BCNT2AR 8-bit (alternate view of RHRAR) — Binary Counter 2 Alarm Register
0x16 RWKAR 8-bit — Day-of-Week Alarm Register
0x16 BCNT3AR 8-bit (alternate view of RWKAR) — Binary Counter 3 Alarm Register
0x18 RDAYAR 8-bit — Date Alarm Register
0x18 BCNT0AER 8-bit (alternate view of RDAYAR) — Binary Counter 0 Alarm Enable Register
0x1A RMONAR 8-bit — Month Alarm Register
0x1A BCNT1AER 8-bit (alternate view of RMONAR) — Binary Counter 1 Alarm Enable Register
0x1C RYRAR 16-bit — Year Alarm Register
0x1C BCNT2AER 16-bit (alternate view of RYRAR) — Binary Counter 2 Alarm Enable Register
0x1E RYRAREN 8-bit — Year Alarm Enable Register
0x1E BCNT3AER 8-bit (alternate view of RYRAREN) — Binary Counter 3 Alarm Enable Register
{0x20+2i} RCR{i} 8-bit (i=1..4) — RTC Control Register {i}
0x2E RADJ 8-bit — Time Error Adjustment Register
{0x40+2i} RTCCR{i} 8-bit (i=0..2) — Time Capture Control Register {i}
{0x52+0x10*i} RSECCP{i} 8-bit ro (i=0..2) — Second Capture Register {i}
{0x52+0x10*i} BCNT0CP{i} 8-bit ro (alternate view of RSECCP{i}) (i=0..2) — BCNT0 Capture Register {i}
{0x54+0x10*i} RMINCP{i} 8-bit ro (i=0..2) — Minute Capture Register {i}
{0x54+0x10*i} BCNT1CP{i} 8-bit ro (alternate view of RMINCP{i}) (i=0..2) — BCNT1 Capture Register {i}
{0x56+0x10*i} RHRCP{i} 8-bit ro (i=0..2) — hour Capture Register {i}
{0x56+0x10*i} BCNT2CP{i} 8-bit ro (alternate view of RHRCP{i}) (i=0..2) — BCNT2 Capture Register {i}
{0x5A+0x10*i} RDAYCP{i} 8-bit ro (i=0..2) — Date Capture Register {i}
{0x5A+0x10*i} BCNT3CP{i} 8-bit ro (alternate view of RDAYCP{i}) (i=0..2) — BCNT3 Capture Register {i}
{0x5C+0x10*i} RMONCP{i} 8-bit ro (i=0..2) — Month Capture Register {i}
