# ECM3532 register map
Vendor: EtaCompute; Series: ECM35xx; File version: 1.0.0
ARM Cortex-M3 and Dual MAC DSP, DIAL Technology Subthreshold
CPU: CM3 r1p1, little endian, MPU, no FPU, 3 interrupt priority bits
Registers are 32-bit, read-write, reset 0x0 unless marked. A register's access mark holds for its fields unless they carry their own. Offsets are from the block's base; lines under a group give offsets from that group; [hi:lo] are bit positions; {n}, {i} and the like mark numbered series; 'fields as' and 'values as' point back to an identical list; <NAME> marks a mode.

## Memory map
0x40010000 GPIO size 0x400 — The General Purpose I/O (GPIO) Device provides programmable access to the pins of the chip from within the M3 complex.
0x40800000 DSPCTRL_M3 size 0x20 — These registers control the DSP complex.
0x50000000 PWM size 0x80 — The PWM module contains four PWM generators. The PWM generators are configured with a command FIFO which sets their config, period, pulse start, and pulse end internal registers. A channel multiplexer steers PWM signals to any of the 16 output pins. The PWM supports synchronous channel changes to avoid glitches on the output.
0x50010000 RTC size 0x400 — The real time clock (RTC) is part of the Always On block. In addition to maintaining the real time epoch for the SOC, it also contains all of the control registers of AO block, e.g. registers for the power controller.
0x50020000 SPI0 size 0x100 — SPI System Control Block Registers.
0x50020100 SPI1 size 0x100 — SPI System Control Block Registers.
0x50020200 UART0 size 0x80 — The UART Device provides a UART serial port communication peripheral for the chip. It also provides for on-chip loop back with a second uart on the same chip.
0x50020300 UART1 size 0x80 — The UART Device provides a UART serial port communication peripheral for the chip. It also provides for on-chip loop back with a second uart on the same chip.
0x50020400 TIMER size 0x200 — The TIMER Device provides programmable timing support for an RTOS or RTOS surrogate, i.e. embedded firmware designs that don't use an RTOS. NOTE Some portions of the timer are only cleared by the initial power on reset to the SOC.
0x50030000 GPIO8 size 0x80 — The General Purpose I/O (GPIO) Device provides programmable access to the pins of the chip.
0x50030080 SOCCTRL size 0x100 — The system control module provides memory mapped I/O control and status for various and miscellaneous portions of the SOC.
0x50040000 I2C0 size 0x200 — I2C System Control Block Registers.
0x50040080 I2C1 size 0x200 — I2C System Control Block Registers.
0x50050000 ADC size 0x100 — The ADC AHB interface provides programming control of the analog to digital converter.
0x50050100 I2S size 0x20 — The I2S Regs provide access to send and receive audio samples from I2S interface.
0x50050200 PDM0 size 0x100 — The Pulse Density Module (PDM) filter engine provides for 2 DMEMs microphones to be attached. The digital microphone PDM streams comes in at 1.024MHz or 2.048MHz yielding either 8Ksps or 16Ksps stereo PCM sample streams.
0x50050300 PDM1 size 0x100 — The Pulse Density Module (PDM) filter engine provides for 2 DMEMs microphones to be attached. The digital microphone PDM streams comes in at 1.024MHz or 2.048MHz yielding either 8Ksps or 16Ksps stereo PCM sample streams.
0xE000E000 NVIC size 0x4000 — The Nested Vectored interrupt Controller
0xE0080000 FLASH_CTLR size 0x400 — The flash controller module provides capabilities to erase and program the embedded flash memory storage.

## Interrupts
0 GPIO0 (GPIO8) — GPIO0 Interrupt Number
1 GPIO1 (GPIO8) — GPIO1 Interrupt Number
2 TIMER0 (TIMER) — TIMER0 Interrupt Number
3 TIMER1 (TIMER) — TIMER1 Interrupt Number
4 UART0 — UART0 Interrupt Number
5 UART1 — UART1 Interrupt Number
6 SPI0 — SPI0 Interrupt Number
7 SPI1 — SPI1 Interrupt Number
8 I2C0 — I2C0 Interrupt Number
9 I2C1 — I2C1 Interrupt Number
10 RTC0 (RTC) — RTC0 Interrupt Number
11 RTC1 (RTC) — RTC1 Interrupt Number
12 DSP_M3 (DSPCTRL_M3) — DSP_M3 Interrupt Number
13 ADC — ADC Interrupt Number
14 PWM — PWM Interrupt Number
15 RTC_WDT (RTC) — RTC_WDT Interrupt Number
16 RTC_TMR (RTC) — RTC_TMR Interrupt Number

## Licence text in the file
Copyright (C) 2018 Eta Compute, Inc. All rights reserverd. Licensed under the Apache License, Version 2.0 (the "License"); you may not use this file except in compliance with the License. You may obtain a copy of the License at http://www.apache.org/licenses/LICENSE-2.0 Unless required by applicable law or agreed to in writing, software distributed under the License is distributed on an "AS IS" BASIS, WITHOUT WARRANTIES OR CONDITIONS OF ANY KIND, either express or implied. See the License for the specific language governing permissions and limitations under the License.
