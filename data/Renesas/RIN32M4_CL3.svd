# RIN32M4_CL3 register map
Vendor: Renesas Electronics Corporation; Series: RIN32M4_CL3; File version: 0.1
CPU: CM4F r0p1, little endian, MPU, FPU, 4 interrupt priority bits
Registers are 32-bit, read-write, reset 0x0 unless marked. A register's access mark holds for its fields unless they carry their own. Offsets are from the block's base; [hi:lo] are bit positions; {n}, {i} and the like mark numbered series.

## QINT_BUFID — Receive Buffer Information
Base 0x40091000
0x100 BUFID

## MEMC — Memory controller (ROM/SRAM)
Base 0x400A2000
0x04 BSC reset 0x5555 — Bus Size Control register
{0x8+4i} SMC{i} reset 0xFFFF (i=0..3) — Static Memory Control register {i}
0x18 PRC reset 0xF0000000 — Page Rom Control register

## SROM — Serial flash ROM memory controller
Base 0x400A2400
0x00 SFMSMD reset 0x110 — Transfer mode control register
0x04 SFMSSC reset 0x37 — Chip select control register
0x08 SFMSKC reset 0x8 — Clock control register
0x0C SFMSST ro reset 0x80 — Status register
0x10 SFMCOM reset not defined — Communication port register
0x14 SFMCMD — Communication mode control register
0x18 SFMCST — Communication status register
0x20 SFMSIC — Command code register
0x24 SFMSAC reset 0x2 — Address mode control register
0x28 SFMSDC reset 0xFF00 — Dummy Cycle control register
0x30 SFMSPC reset 0x10 — SPI Protocol control register
0x34 SFMPMD — Port mode control register
0x38 SFMDTC — Data Input Timing register
0x4C SFMVER reset 0x300 — Version register

## DMAC0 — DMA controller
Base 0x400A2800
Same registers: DMAC1 0x400A2840, DMAC2 0x400A2880, DMAC3 0x400A28C0, RTDMAC 0x400A2C00
0x00 N0SAn — Source address register [Next0]
0x04 N0DAn — Destination address register [Next0]
0x08 N0TBn — Transaction byte register [Next0]
0x0C N1SAn — Source address register [Next1]
0x10 N1DAn — Destination address register [Next1]
0x14 N1TBn — Transaction byte register [Next1]
0x18 CRSAn ro — Source address register [Current]
0x1C CRDAn ro — Destination address register [Current]
0x20 CRTBn ro — Transaction byte register [Current]
0x24 CHSTATn ro — Channel status register
0x28 CHCTRLn wo — Channel control register
0x2C CHCFGn — Channel configulation register
0x30 CHITVLn — Channel intereval register
0x38 NXLAn — Link address register [Next]
0x3C CRLAn ro — Link address register [Current]

## DSS0 — DMAC space source size
Base 0x400A2A00
Same registers: DSS1 0x400A2A20, DSS2 0x400A2A40, DSS3 0x400A2A60, RTDSS 0x400A2E00
0x00 SCNTn — Continuous space source size register
0x04 SSKPn — Skip space source size register
0x08 DCNTn — Continuous space destination size register
0x0C DSKPn — Skip space destination size register

## DCTL — DMA control
Base 0x400A2B00
Same registers: RTDCTL 0x400A2F00
0x00 DCTRL — DMAC control register
0x04 DSCITVL — DMAC descriptor interval register
0x10 DSTEN ro — DMAC enable status register
0x14 DSTER ro — DMAC error status register
0x18 DSTEND ro — DMAC end status register
0x1C DSTTC ro — DMAC terminal count status register
0x20 DSTSUS ro — DMAC suspend status register

## GPIO — Port (GPIO)
Base 0x400A3000
{0x0+i} P{i}B 8-bit (i=0..7) — Port register {i} ( 8 bit)
{0x10+i} PM{i}B 8-bit reset 0xFF (i=0..7) — Port mode register {i} ( 8 bit)
{0x20+i} PMC{i}B 8-bit (i=0..7) — Port mode control register {i} ( 8 bit)
{0x30+i} PFC{i}B 8-bit (i=0..7) — Port function control register {i} ( 8 bit)
{0x40+i} PFCE{i}B 8-bit (i=0..7) — Port function control ext.register {i} ( 8 bit)
{0x50+i} PIN{i}B 8-bit ro reset not defined (i=0..7) — Port input level register {i} ( 8 bit)

## RTPORT — Port (RTPORT)
Base 0x400A3400
{0x0+i} RP{i}B 8-bit (i=0..3) — RT Port register {i} ( 8 bit)
{0x10+i} RPM{i}B 8-bit reset 0xFF (i=0..3) — RT Port mode register {i} ( 8 bit)
{0x20+i} RPMC{i}B 8-bit (i=0..3) — RT Port mode control register {i} ( 8 bit)
{0x30+i} RPFC{i}B 8-bit (i=0..3) — RT Port function control register {i} ( 8 bit)
{0x40+i} RPFCE{i}B 8-bit (i=0..3) — RT Port function control ext.register {i} ( 8 bit)
{0x50+i} RPIN{i}B 8-bit ro reset not defined (i=0..3) — RT Port input level register {i} ( 8 bit)

## EXTPORT — Port (EXTPORT)
Base 0x400A3800
0x00 EXTP0B 8-bit — EXT Port register 0 ( 8 bit)
0x01 EXTP1B 8-bit — EXT Port register 1 ( 8 bit)
0x10 EXTPM0B 8-bit reset 0xFF — EXT Port Mode register 0 ( 8 bit)
0x11 EXTPM1B 8-bit reset 0x7F — EXT Port Mode register 1 ( 8 bit)
0x20 EXTPMC0B 8-bit — EXT Port mode control register 0 ( 8 bit)
0x21 EXTPMC1B 8-bit — EXT Port mode control register 1 ( 8 bit)
0x30 EXTPFC0B 8-bit — EXT function control register 0 ( 8 bit)
0x31 EXTPFC1B 8-bit — EXT function control register 1 ( 8 bit)
0x40 EXTPFCE0B 8-bit — EXT function control expregister 0 ( 8 bit)
0x41 EXTPFCE1B 8-bit — EXT function control expregister 1 ( 8 bit)
0x50 EXTPIN0B 8-bit ro reset not defined — EXT Port input register 0 ( 8 bit)
0x51 EXTPIN1B 8-bit ro reset not defined — EXT Port input register 0 ( 8 bit)

## CC-LinkIEF — CC-Link IE Field
Base 0x400A4000
0x04 CIEBSC reset 0xFFFF — CC-Link IE Bus Size Control register
0x08 CIESMC reset 0xFFFF — CC-Link IE BUS Bridge Control register

## SMC — Burst memory controller
Base 0x400A8000
0x10 DIRECTCMD wo reset not defined — Direct Command Register
0x14 SETCYCLES wo reset not defined
0x18 SETOPMODE wo reset not defined — Set Operating Mode Register
0x20 REFRESH0 — Refresh Period 0 Register
{0x100+0x20*i} SRAM_CYCLES0_{i} ro reset 0x2B3CC (i=0..3) — CS{i} cycle setting register
{0x104+0x20*i} OPMODE0_{i} ro reset not defined (i=0..3) — CS{i} mode register

## System_CTL — System Control
Base 0x400F1800
0x0C mc_micon_set_reg — Memory map change register
