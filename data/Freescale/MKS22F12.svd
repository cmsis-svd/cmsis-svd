# MKS22F12 register map
Vendor: Freescale Semiconductor, Inc.; Series: Kinetis_K; File version: 1.6
MKS22F12 Freescale Microcontroller
CPU: CM4 r0p1, little endian, no MPU, FPU, VTOR, 4 interrupt priority bits
Registers are 32-bit, read-write, reset 0x0 unless marked. A register's access mark holds for its fields unless they carry their own. Offsets are from the block's base; lines under a group give offsets from that group; [hi:lo] are bit positions; {n}, {i} and the like mark numbered series; 'fields as' and 'values as' point back to an identical list; <NAME> marks a mode.

## Memory map
0x00000400 FTFA_FlashConfig size 0xE — Flash configuration field
0x40008000 DMA size 0x1200 — Enhanced direct memory access controller
0x4001F000 FMC size 0x300 — Flash Memory Controller
0x40020000 FTFA size 0x2C — Flash Memory Interface
0x40021000 DMAMUX size 0x10 — DMA channel multiplexor
0x40024000 CAN0 size 0x8C0 — Flex Controller Area Network module
0x40025000 CAN1 size 0x8C0 — Flex Controller Area Network module
0x40029000 RNG size 0x10 — Random Number Generator Accelerator
0x4002A000 LPUART0 size 0x18 — Universal Asynchronous Receiver/Transmitter
0x4002C000 SPI0 size 0x8C — Serial Peripheral Interface
0x4002D000 SPI1 size 0x8C — Serial Peripheral Interface
0x4002F000 I2S0 size 0x108 — Inter-IC Sound / Synchronous Audio Interface
0x40030000 I2S1 size 0x108 — Inter-IC Sound / Synchronous Audio Interface
0x40032000 CRC size 0xC — Cyclic Redundancy Check
0x40036000 PDB0 size 0x198 — Programmable Delay Block
0x40037000 PIT size 0x140 — Periodic Interrupt Timer
0x40038000 TPM0 size 0x88 — Timer/PWM Module
0x40039000 TPM1 size 0x88 — Timer/PWM Module
0x4003A000 TPM2 size 0x88 — Timer/PWM Module
0x4003B000 ADC0 size 0x70 — Analog-to-Digital Converter
0x4003D000 RTC size 0x808 — Secure Real Time Clock
0x4003E000 RFVBAT size 0x20 — VBAT register file
0x4003F000 DAC0 size 0x24 — 12-Bit Digital-to-Analog Converter
0x40040000 LPTMR0 size 0x10 — Low Power Timer
0x40041000 RFSYS size 0x20 — System register file
0x40047000 SIM size 0x1070 — System Integration Module
0x40049000 PORTA size 0xA4 — Pin Control and Interrupts
0x4004A000 PORTB size 0xA4 — Pin Control and Interrupts
0x4004B000 PORTC size 0xA4 — Pin Control and Interrupts
0x4004C000 PORTD size 0xCC — Pin Control and Interrupts
0x4004D000 PORTE size 0xA4 — Pin Control and Interrupts
0x40052000 WDOG size 0x18 — Generation 2008 Watchdog Timer
0x4005F000 FLEXIO size 0x510 — The FLEXIO Memory Map/Register Definition can be found here.
0x40061000 EWM size 0x6 — External Watchdog Monitor
0x40064000 MCG size 0xE — Multipurpose Clock Generator module
0x40065000 OSC size 0x3 — Oscillator
0x40066000 LPI2C0 size 0x174 — The LPI2C Memory Map/Register Definition can be found here.
0x40067000 LPI2C1 size 0x174 — The LPI2C Memory Map/Register Definition can be found here.
0x4006A000 UART0 size 0x40 — Serial Communication Interface
0x4006B000 UART1 size 0x17 — Serial Communication Interface
0x4006C000 UART2 size 0x17 — Serial Communication Interface
0x40072000 USB0 size 0x15D — Universal Serial Bus, OTG Capable Controller
0x40073000 CMP0 size 0x6 — High-Speed Comparator (CMP), Voltage Reference (VREF) Digital-to-Analog Converter (DAC), and Analog Mux (ANMUX)
0x4007C000 LLWU size 0x10 — Low leakage wakeup unit
0x4007D000 PMC size 0xC — Power Management Controller
0x4007E000 SMC size 0x4 — System Mode Controller
0x4007F000 RCM size 0xA — Reset Control Module
0x400FF000 PTA size 0x18 — General Purpose Input/Output
0x400FF040 PTB size 0x18 — General Purpose Input/Output
0x400FF080 PTC size 0x18 — General Purpose Input/Output
0x400FF0C0 PTD size 0x18 — General Purpose Input/Output
0x400FF100 PTE size 0x18 — General Purpose Input/Output
0xE0080000 MCM blocks up to offset 0x44 — Core Platform Miscellaneous Control Module

## Interrupts
{n} DMA{n} (DMA) (n=0..15)
16 DMA_Error (DMA)
17 MCM
18 FTF (FTFA)
19 Read_Collision (FTFA)
20 LVD_LVW (PMC)
21 LLWU
22 WDOG_EWM (WDOG, EWM)
23 RNG
24 LPI2C0
25 LPI2C1
26 SPI0
27 SPI1
28 I2S0_Tx (I2S0)
29 I2S0_Rx (I2S0)
30 LPUART0
31 UART0_RX_TX (UART0)
32 UART0_ERR (UART0)
33 UART1_RX_TX (UART1)
34 UART1_ERR (UART1)
35 UART2_RX_TX (UART2)
36 UART2_ERR (UART2)
39 ADC0
40 CMP0
46 RTC
47 RTC_Seconds (RTC)
48 PIT0 (PIT)
49 PIT1 (PIT)
50 PIT2 (PIT)
51 PIT3 (PIT)
52 PDB0
53 USB0
56 DAC0
58 LPTMR0
59 PORTA (PORTA, PTA)
60 PORTB (PORTB, PTB)
61 PORTC (PORTC, PTC)
62 PORTD (PORTD, PTD)
63 PORTE (PORTE, PTE)
75 CAN0_ORed_Message_buffer (CAN0)
76 CAN0_Bus_Off (CAN0)
77 CAN0_Error (CAN0)
78 CAN0_Tx_Warning (CAN0)
79 CAN0_Rx_Warning (CAN0)
80 CAN0_Wake_Up (CAN0)
88 I2S1_Tx (I2S1)
89 I2S1_Rx (I2S1)
94 CAN1_ORed_Message_buffer (CAN1)
95 CAN1_Bus_Off (CAN1)
96 CAN1_Error (CAN1)
97 CAN1_Tx_Warning (CAN1)
98 CAN1_Rx_Warning (CAN1)
99 CAN1_Wake_Up (CAN1)

## Licence text in the file
Redistribution and use in source and binary forms, with or without modification, are permitted provided that the following conditions are met: o Redistributions of source code must retain the above copyright notice, this list of conditions and the following disclaimer. o Redistributions in binary form must reproduce the above copyright notice, this list of conditions and the following disclaimer in the documentation and/or other materials provided with the distribution. o Neither the name of Freescale Semiconductor, Inc. nor the names of its contributors may be used to endorse or promote products derived from this software without specific prior written permission. THIS SOFTWARE IS PROVIDED BY THE COPYRIGHT HOLDERS AND CONTRIBUTORS "AS IS" AND. ANY EXPRESS OR IMPLIED WARRANTIES, INCLUDING, BUT NOT LIMITED TO, THE IMPLIED. WARRANTIES OF MERCHANTABILITY AND FITNESS FOR A PARTICULAR PURPOSE ARE. DISCLAIMED. IN NO EVENT SHALL THE COPYRIGHT HOLDER OR CONTRIBUTORS BE LIABLE FOR. ANY DIRECT, INDIRECT, INCIDENTAL, SPECIAL, EXEMPLARY, OR CONSEQUENTIAL DAMAGES (INCLUDING, BUT NOT LIMITED TO, PROCUREMENT OF SUBSTITUTE GOODS OR SERVICES; LOSS OF USE, DATA, OR PROFITS; OR BUSINESS INTERRUPTION) HOWEVER CAUSED AND ON. ANY THEORY OF LIABILITY, WHETHER IN CONTRACT, STRICT LIABILITY, OR TORT (INCLUDING NEGLIGENCE OR OTHERWISE) ARISING IN ANY WAY OUT OF THE USE OF THIS. SOFTWARE, EVEN IF ADVISED OF THE POSSIBILITY OF SUCH DAMAGE.
