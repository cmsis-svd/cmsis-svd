# S6E2HGxG register map
Vendor: Spansion; File version: 2.0
S6E2HG Series package G
CPU: CM4 r0p1, little endian, MPU, FPU, 4 interrupt priority bits
Registers are 32-bit, read-write, reset 0x0 unless marked. A register's access mark holds for its fields unless they carry their own. Offsets are from the block's base; lines under a group give offsets from that group; [hi:lo] are bit positions; {n}, {i} and the like mark numbered series; 'fields as' and 'values as' point back to an identical list; <NAME> marks a mode.

## Memory map
0x200E0000 WORKFLASH_IF size 0xC — WorkFlash Memory
0x40000000 FLASH_IF blocks up to offset 0x120 — Flash Memory
0x40000200 UNIQUE_ID blocks up to offset 0x8
0x40000300 ECC_CAPTURE size 0x4 — ECC Capture Address
0x40010000 CRG blocks up to offset 0x78 — Clock Unit Registers
0x40011000 HWWDT blocks up to offset 0xC04 — Hardware Watchdog Timer
0x40012000 SWWDT blocks up to offset 0xC04 — Software Watchdog Timer
0x40015000 DT blocks up to offset 0x3C — Dual Timer
0x40020000 MFT0 blocks up to offset 0x1ED — Multifunction Timer 0
0x40021000 MFT1 blocks up to offset 0x1ED — Multifunction Timer 1
0x40022000 MFT2 blocks up to offset 0x1ED — Multifunction Timer 2
0x40024000 MFT_PPG blocks up to offset 0x359 — PPG Configuration
0x40025000 BT0 blocks up to offset 0x12 — Base Timer 0
0x40025040 BT1 blocks up to offset 0x12 — Base Timer 1
0x40025080 BT2 blocks up to offset 0x12 — Base Timer 2
0x400250C0 BT3 blocks up to offset 0x12 — Base Timer 3
0x40025100 BTIOSEL03 blocks up to offset 0x2 — Base Timer I/O Select
0x40025200 BT4 blocks up to offset 0x12 — Base Timer 4
0x40025240 BT5 blocks up to offset 0x12 — Base Timer 5
0x40025280 BT6 blocks up to offset 0x12 — Base Timer 6
0x400252C0 BT7 blocks up to offset 0x12 — Base Timer 7
0x40025300 BTIOSEL47 blocks up to offset 0x2 — Base Timer I/O Select
0x40025F00 SBSSR blocks up to offset 0xFE — Software-based Simultaneous Startup Register
0x40026000 QPRC0 blocks up to offset 0x40 — Quadrature Position/Revolution Counter 0
0x40026040 QPRC1 blocks up to offset 0x40 — Quadrature Position/Revolution Counter 1
0x40026080 QPRC2 blocks up to offset 0x40 — Quadrature Position/Revolution Counter 2
0x40026100 QPRC0_NF blocks up to offset 0x9 — Quadrature Position/Revolution Counter 0 Noise Filter
0x40026110 QPRC1_NF blocks up to offset 0x9 — Quadrature Position/Revolution Counter 1 Noise Filter
0x40026120 QPRC2_NF blocks up to offset 0x9 — Quadrature Position/Revolution Counter 2 Noise Filter
0x40027000 ADC0 blocks up to offset 0x54 — ADC0 Registers
0x40027100 ADC1 blocks up to offset 0x54 — ADC1 Registers
0x40027200 ADC2 blocks up to offset 0x54 — ADC2 Registers
0x4002E000 CRTRIM blocks up to offset 0x10 — CR Trimming Registers
0x40030000 EXTI blocks up to offset 0x20 — External Interrupt and NMI Control
0x40031000 INTREQ blocks up to offset 0x404 — Interrupts
0x40033000 DAC0 blocks up to offset 0x6 — D/A Converter 0
0x40033008 DAC1 blocks up to offset 0x6 — D/A Converter 1
0x40035000 LVD blocks up to offset 0x11 — Low-voltage Detection
0x40035100 DS blocks up to offset 0x810 — Low Power Consumption Mode
0x40037000 CANPRES size 0x1 — CAN Prescaler Register
{0x40038000+0x100*n} MFS{n} blocks up to offset 0x3D (n=0..7) — Multi-function Serial Interface {n}
0x40039000 CRC blocks up to offset 0x10 — CRC Registers
0x4003A000 WC blocks up to offset 0x15 — Watch Counter
0x4003B100 RTC blocks up to offset 0x180 — REAL-TIME CLOCK
0x4003C000 LSCRP size 0x1 — Low-speed CR Prescaler
0x4003C100 CLK_GATING blocks up to offset 0x28 — Peripheral Clock Gating
0x4003F000 EXBUS blocks up to offset 0x314 — External Bus Interface
0x40060000 DMAC blocks up to offset 0x90 — DMAC Registers
0x40061000 DSTC size 0xB0 — DSTC registers
0x40062000 CAN0 blocks up to offset 0xB4 — CAN0 Registers
0x40063000 CAN1 blocks up to offset 0xB4 — CAN1 Registers
0x4006E000 SDIF blocks up to offset 0x146 — SD Card Interface
0x4006F000 GPIO blocks up to offset 0x740

## Interrupts
0 CSV (CRG)
1 SWDT (SWWDT)
2 LVD
{n} IRQ{n:03}SEL (INTREQ) (n=3..10)
{n+11} EXINT{n} (EXTI) (n=0..7)
19 QPRC0
20 QPRC1
21 MFT0_WFG_DTIF (MFT0)
22 MFT1_WFG_DTIF (MFT1)
23 MFT2_WFG_DTIF (MFT2)
24 MFT0_FRT_PEAK (MFT0)
25 MFT0_FRT_ZERO (MFT0)
26 MFT0_ICU (MFT0)
27 MFT0_OCU (MFT0)
28 MFT1_FRT_PEAK (MFT1)
29 MFT1_FRT_ZERO (MFT1)
30 MFT1_ICU (MFT1)
31 MFT1_OCU (MFT1)
32 MFT2_FRT_PEAK (MFT2)
33 MFT2_FRT_ZERO (MFT2)
34 MFT2_ICU (MFT2)
35 MFT2_OCU (MFT2)
36 PPG00_02_04 (MFT_PPG)
37 PPG08_10_12 (MFT_PPG)
38 PPG16_18_20 (MFT_PPG)
{n+39} BT{n} (n=0..7)
47 DT
48 WC
49 EXTBUS_ERR (EXBUS)
50 RTC
{n+43} EXINT{n} (EXTI) (n=8..15)
59 TIM (CRG)
{2n+60} MFS{n}_RX (MFS{n}) (n=0..7)
{2n+61} MFS{n}_TX (MFS{n}) (n=0..7)
76 ADC0
77 ADC1
80 CAN0
81 CAN1
{n+83} DMAC{n} (DMAC) (n=0..7)
91 DSTC
92 EXINT16_19 (EXTI)
93 EXINT20_23 (EXTI)
94 EXINT24_27 (EXTI)
95 EXINT28_31 (EXTI)
96 QPRC2
111 ADC2
112 DSTC_HW (DSTC)
118 SD (SDIF)
119 FLASHIF (FLASH_IF)

## Further device data
mcutype=6

## Notices in the file
Copyright (C) 2015 Spansion LLC. All Rights Reserved.
This software is owned and published by:
Spansion LLC, 915 DeGuigne Dr. Sunnyvale, CA  94088-3453 ("Spansion").
BY DOWNLOADING, INSTALLING OR USING THIS SOFTWARE, YOU AGREE TO BE BOUND
BY ALL THE TERMS AND CONDITIONS OF THIS AGREEMENT.
This software contains source code for use with Spansion
components. This software is licensed by Spansion to be adapted only
for use in systems utilizing Spansion components. Spansion shall not be
responsible for misuse or illegal use of this software for devices not
supported herein.  Spansion is providing this software "AS IS" and will
not be responsible for issues arising from incorrect user implementation
of the software.
SPANSION MAKES NO WARRANTY, EXPRESS OR IMPLIED, ARISING BY LAW OR OTHERWISE,
REGARDING THE SOFTWARE (INCLUDING ANY ACOOMPANYING WRITTEN MATERIALS),
ITS PERFORMANCE OR SUITABILITY FOR YOUR INTENDED USE, INCLUDING,
WITHOUT LIMITATION, THE IMPLIED WARRANTY OF MERCHANTABILITY, THE IMPLIED
WARRANTY OF FITNESS FOR A PARTICULAR PURPOSE OR USE, AND THE IMPLIED
WARRANTY OF NONINFRINGEMENT.
SPANSION SHALL HAVE NO LIABILITY (WHETHER IN CONTRACT, WARRANTY, TORT,
NEGLIGENCE OR OTHERWISE) FOR ANY DAMAGES WHATSOEVER (INCLUDING, WITHOUT
LIMITATION, DAMAGES FOR LOSS OF BUSINESS PROFITS, BUSINESS INTERRUPTION,
LOSS OF BUSINESS INFORMATION, OR OTHER PECUNIARY LOSS) ARISING FROM USE OR
INABILITY TO USE THE SOFTWARE, INCLUDING, WITHOUT LIMITATION, ANY DIRECT,
INDIRECT, INCIDENTAL, SPECIAL OR CONSEQUENTIAL DAMAGES OR LOSS OF DATA,
SAVINGS OR PROFITS,
EVEN IF SPANSION HAS BEEN ADVISED OF THE POSSIBILITY OF SUCH DAMAGES.
YOU ASSUME ALL RESPONSIBILITIES FOR SELECTION OF THE SOFTWARE TO ACHIEVE YOUR
INTENDED RESULTS, AND FOR THE INSTALLATION OF, USE OF, AND RESULTS OBTAINED
FROM, THE SOFTWARE.
This software may be replicated in part or whole for the licensed use,
with the restriction that this Disclaimer and Copyright notice must be
included with each copy of this software, whether used in part or whole,
at all times.
