# R7S910x23 register map
Vendor: Renesas Electronics Corporation; Series: RZT; File version: 1.5
CPU: other r1p4, little endian, MPU, FPU, vendor SysTick, 1 interrupt priority bits
Registers are 32-bit, read-write, no defined reset value unless marked. A register's access mark holds for its fields unless they carry their own. Offsets are from the block's base; [hi:lo] are bit positions; lines under a group give offsets from that group; {n}, {i} and the like mark numbered series.

## WDT0 — Watchdog timer 0
Base 0xA0080600; register names take the prefix WDT0_
0x00 WDTRR 8-bit — WDT refresh register
0x02 WDTCR 16-bit — WDT control register
0x04 WDTSR 16-bit — WDT status register
0x06 WDTRCR 8-bit — WDT reset control register

## IWDT — Independent watchdog timer
Base 0xA0080700; register names take the prefix IWDT_
0x00 IWDTRR 8-bit — IWDT refresh register
0x02 IWDTCR 16-bit — IWDT control register
0x04 IWDTSR 16-bit — IWDT status register
0x06 IWDTRCR 8-bit — IWDT reset control register

## RIIC0 — I2C Bus Interface
Base 0xA0080900; register names take the prefix RIIC0_
0x00 ICCR1 8-bit — I2C bus control register 1
0x01 ICCR2 8-bit — I2C bus control register 2
{0x1+i} ICMR{i} 8-bit (i=1..3) — I2C bus mode register {i}
0x05 ICFER 8-bit — I2C bus function enable register
0x06 ICSER 8-bit — I2C bus status enable register
0x07 ICIER 8-bit — I2C bus interrupt enable register
0x08 ICSR1 8-bit — I2C bus status register 1
0x09 ICSR2 8-bit — I2C bus status register 2
{0xA+2i} ICSARL{i} 8-bit (i=0..2) — slave address register L{i}
{0xB+2i} ICSARU{i} 8-bit (i=0..2) — slave address register U{i}
0x10 ICBRL 8-bit — I2C bus bitrate low register
0x11 ICBRH 8-bit — I2C bus bitrate high register
0x12 ICDRT 8-bit — I2C bus transmit data register
0x13 ICDRR 8-bit ro — I2C bus receive data register

## RIIC1 — I2C Bus Interface
Base 0xA0080940; register names take the prefix RIIC1_
Registers as RIIC0.

## TSN — Temperature sensor
Base 0xA0080A00; register names take the prefix TSN_
0x00 TSCR 8-bit — Temperature sensor control register

## ELC — Event link controller
Base 0xA0080B00; register names take the prefix ELC_
0x00 ELCR 8-bit — Event link control register
0x01 ELSR0 8-bit — Event link setting register 0
0x04 ELSR3 8-bit — Event link setting register 3
0x05 ELSR4 8-bit — Event link setting register 4
0x08 ELSR7 8-bit — Event link setting register 7
{0x1+i} ELSR{i} 8-bit (i=10..13) — Event link setting register {i}
0x10 ELSR15 8-bit — Event link setting register 15
{0x1+i} ELSR{i} 8-bit (i=18..27) — Event link setting register {i}
0x1F ELOPA 8-bit — Event link option setting register A
0x20 ELOPB 8-bit — Event link option setting register B
0x21 ELOPC 8-bit — Event link option setting register C
0x22 ELOPD 8-bit — Event link option setting register D
0x23 PGR1 8-bit — Port group setting register 1
0x24 PGR2 8-bit — Port group setting register 2
0x25 PGC1 8-bit — Port group control register 1
0x26 PGC2 8-bit — Port group control register 2
0x27 PDBF1 8-bit — Port buffer register 1
0x28 PDBF2 8-bit — Port buffer register 2
{0x29+i} PEL{i} 8-bit (i=0..3) — Event link port setting register {i}
0x2D ELSEGR 8-bit — Event link software event generation register
0x31 ELSR33 8-bit — Event link setting register 33
{0x10+i} ELSR{i} 8-bit (i=35..38) — Event link setting register {i}
{0x10+i} ELSR{i} 8-bit (i=41..45) — Event link setting register {i}
0x3F ELOPF 8-bit — Event link option setting register F
0x41 ELOPH 8-bit — Event link option setting register H
0x42 ELOPI 8-bit — Event link option setting register I
0x43 ELOPJ 8-bit — Event link option setting register J

## DOC — Data operation circuit
Base 0xA0081200; register names take the prefix DOC_
0x00 DOCR 8-bit — DOC control register
0x02 DODIR 16-bit — DOC data input register
0x04 DODSR 16-bit — DOC data setting register

## S12ADC0 — 12-Bit A/D Converter 0
Base 0xA008C000; register names take the prefix S12ADC0_
0x00 ADCSR 16-bit — A/D control register
0x04 ADANSA 16-bit — A/D channel select register A
0x08 ADADS 16-bit — A/D conversion value addition/average mode select register
0x0C ADADC 8-bit — A/D conversion value addition/average number select register
0x0E ADCER 16-bit — A/D control extended register
0x10 ADSTRGR 16-bit — A/D start trigger select register
0x12 ADEXICR 16-bit — A/D conversion extended input control register
0x14 ADANSB 16-bit — A/D channel select register B
0x18 ADDBLDR 16-bit ro — A/D data duplicate register
0x1A ADTSDR 16-bit ro — A/D temperature sensor data register
0x1E ADRD 16-bit ro — A/D self-diagnostic data register
{0x20+2i} ADDR{i} 16-bit ro (i=0..7) — A/D data register {i}
0x60 ADSSTR0 8-bit — A/D sampling state register 0
0x66 ADSHCR 16-bit — A/D sampling state register control register
0x70 ADSSTRT 8-bit — A/D sampling state register T
{0x72+i} ADSSTR{i} 8-bit (i=1..7) — A/D sampling state register {i}
0x7A ADDISCR 8-bit — A/D disconnection detect control register
0x80 ADGSPCR 16-bit — A/D group scan priority control register
0x84 ADDBLDRA 16-bit ro — A/D data duplicate register A
0x86 ADDBLDRB 16-bit ro — A/D data duplicate register B
0x90 ADCMPCR 8-bit — A/D compare control register
0x92 ADCMPANSER 8-bit — A/D compare channel select extended register
0x93 ADCMPLER 8-bit — A/D compare level extended register
0x94 ADCMPANSR 16-bit — A/D compare channel select register
0x98 ADCMPLR 16-bit — A/D compare level register
0x9C ADCMPDR0 16-bit — A/D compare data register 0
0x9E ADCMPDR1 16-bit — A/D compare data register 1
0xA0 ADCMPSR 16-bit — A/D compare status register
0xA4 ADCMPSER 8-bit — A/D compare status extended register
0xC8 ADTDCR 8-bit — A/D pin level self-diagnosis control register
0xCA ADERCR 8-bit — A/D error control register
0xCB ADERCLR 8-bit wo — A/D error clear register
0xD2 ADOWER 16-bit ro — A/D overwrite error register
0xD6 ADOWEER 16-bit ro — A/D overwrite error extended register

## S12ADC1 — 12-Bit A/D Converter 1
Base 0xA008C400; register names take the prefix S12ADC1_
Registers as S12ADC0, without ADTSDR, ADSHCR, ADSSTRT, ADCMPANSER, ADCMPLER, ADCMPSER; these are added or differ:
{0x20+2i} ADDR{i} 16-bit ro (i=8..15) — A/D data register {i}
0x61 ADSSTRL 8-bit — A/D sampling state register L

## CLMA0 — Clock monitor circuit 0
Base 0xA0090000; register names take the prefix CLMA0_
0x00 CLMA0CTL0 8-bit — CLMA0 control register 0
0x08 CLMA0CMPL 16-bit — CLMA0 compare register L
0x0C CLMA0CMPH 16-bit — CLMA0 compare register H
0x10 CLMA0PCMD 8-bit wo — CLMA0 command register
0x14 CLMA0PS 8-bit ro — CLMA0 protection status register

## CLMA1 — Clock monitor circuit 1
Base 0xA0090020; register names take the prefix CLMA1_
Registers as CLMA0 (with CLMA0 read as CLMA1).

## CLMA2 — Clock monitor circuit 2
Base 0xA0090040; register names take the prefix CLMA2_
Registers as CLMA0 (with CLMA0 read as CLMA2).

## ICU — Interrupt controller
Base 0xA0094000; register names take the prefix ICU_
{0x0+4i} DMA0SEL{i} (i=0..15) — DMAC unit 0 source select register {i}
{0x40+4i} DMA1SEL{i} (i=0..15) — DMAC unit 1 source select register {i}
0x80 DMASTG — DMAC software start register
{0x200+4i} IRQCR{i} (i=0..15) — IRQ control register {i}
0x240 IRQFLTE — IRQ pin digital noise filter enable register
0x244 IRQFLTC — IRQ pin digital noise filter setting register
0x248 NMISR — Non-maskable interrupt status register
0x24C NMICLR — Non-maskable interrupt status clear register
0x250 NMICR — NMI pin interrupt control register
0x254 NMIFLTE — NMI pin digital noise filter enable register
0x258 NMIFLTC — NMI pin digital noise filter setting register
{0x25C+4i} EPHYCR{i} (i=0..2) — EtherPHY control register {i}
0x268 EPHYFLTE — EtherPHY interrupt request pin digital noise filter enable register
0x26C EPHYFLTC — EtherPHY interrupt request pin digital noise filter setting register
0x270 DREQFLTE — External DMA request pin digital noise filter enable register
0x274 DREQFLTC — External DMA request pin digital noise filter setting register

## SYSTEM — System controller
Base 0xA00B0000; register names take the prefix SYSTEM_
0x20 SCKCR — System clock control register
0x24 SCKCR2 — System clock control register 2
0x28 DSCR — DS I/F clock control register
0x34 PLL1CR — PLL1 control register
0x38 PLL1CR2 — PLL1 control register 2
0x40 LOCOCR — Low-speed on-chip oscillator control register
0x4C OSTDCR — Oscillation stop detect control register
0x200 RSTSR0 — Reset status register 0
0x210 SWRR1 — Software reset register
0x248 MRCTLC — Module reset control register C
0x300 MSTPCRA — Module stop control register A
0x304 MSTPCRB — Module stop control register B
0x308 MSTPCRC — Module stop control register C
0x30C MSTPCRD — Module stop control register D
0x310 MSTPCRE — Module stop control register E
0x314 MSTPCRF — Module stop control register F
0x800 SYTATCMWAIT — ATCM wait control register
0xA00 DBGIFCNT — Debug interface control register
0xA60 MDMONR ro — Mode monitor register
0xA80 ECMMCNT — ECM mask control register
0xB00 PRCR — Protect register

## ECCRAM — ECC controller for RAM
Base 0xA00F3000; register names take the prefix ECCRAM_
0x00 RAMPCMD — Protection command register
0x100 RAMEDC — ECC decoder configuration register
0x104 RAMEEC — ECC encoder configuration register
0x108 RAMDBEST ro — 2-bit ECC error status register
0x10C RAMDBEAD ro — 2-bit ECC error address register
0x110 RAMDBECNT ro — 2-bit ECC error counter register
