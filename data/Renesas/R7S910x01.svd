# R7S910x01 register map
Vendor: Renesas Electronics Corporation; Series: RZT; File version: 1.0
CPU: other r1p4, little endian, MPU, FPU, vendor SysTick, 1 interrupt priority bits
Registers are 32-bit, read-write, no defined reset value unless marked. A register's access mark holds for its fields unless they carry their own. Offsets are from the block's base; [hi:lo] are bit positions; {n}, {i} and the like mark numbered series.

## GPT — General PWM timer
Base 0xA006C000; register names take the prefix GPT_
0x00 GPT_GTSTR 16-bit — General PWM timer software start register
0x02 GPT_NFCR 16-bit — Noise filter control register
0x04 GPT_GTHSCR 16-bit — General PWM timer hardware source start/stop control register
0x06 GPT_GTHCCR 16-bit — General PWM timer hardware source clear control register
0x08 GPT_GTHSSR 16-bit — General PWM timer hardware start source select register
0x0A GPT_GTHPSR 16-bit — General PWM timer hardware stop/clear source select register
0x0C GPT_GTWP 16-bit — General PWM timer write-protection register
0x0E GPT_GTSYNC 16-bit — General PWM timer sync register
0x10 GPT_GTETINT 16-bit — General PWM timer external trigger input interrupt register
0x14 GPT_GTBDR 16-bit — General PWM timer buffer operation disable register
0x18 GPT_GTSWP 16-bit — General PWM timer start write-protection register
{0x100+0x80*i} GPT{i}_GTIOR 16-bit (i=0..3) — General PWM timer I/O control register
{0x102+0x80*i} GPT{i}_GTINTAD 16-bit (i=0..3) — General PWM timer interrupt output setting register
{0x104+0x80*i} GPT{i}_GTCR 16-bit (i=0..3) — General PWM timer control register
{0x106+0x80*i} GPT{i}_GTBER 16-bit (i=0..3) — General PWM timer buffer enable register
{0x108+0x80*i} GPT{i}_GTUDC 16-bit (i=0..3) — General PWM timer count direction register
{0x10A+0x80*i} GPT{i}_GTITC 16-bit (i=0..3) — General PWM timer interrupt and A/D converter start request skipping setting register
{0x10C+0x80*i} GPT{i}_GTST 16-bit (i=0..3) — General PWM timer status register
{0x10E+0x80*i} GPT{i}_GTCNT 16-bit (i=0..3) — General PWM timer counter
{0x110+0x80*i} GPT{i}_GTCCRA 16-bit (i=0..3) — General PWM timer compare capture register A
{0x112+0x80*i} GPT{i}_GTCCRB 16-bit (i=0..3) — General PWM timer compare capture register B
{0x114+0x80*i} GPT{i}_GTCCRC 16-bit (i=0..3) — General PWM timer compare capture register C
{0x116+0x80*i} GPT{i}_GTCCRD 16-bit (i=0..3) — General PWM timer compare capture register D
{0x118+0x80*i} GPT{i}_GTCCRE 16-bit (i=0..3) — General PWM timer compare capture register E
{0x11A+0x80*i} GPT{i}_GTCCRF 16-bit (i=0..3) — General PWM timer compare capture register F
{0x11C+0x80*i} GPT{i}_GTPR 16-bit (i=0..3) — General PWM timer cycle setting register
{0x11E+0x80*i} GPT{i}_GTPBR 16-bit (i=0..3) — General PWM timer cycle setting buffer register
{0x120+0x80*i} GPT{i}_GTPDBR 16-bit (i=0..3) — General PWM timer cycle setting double-buffer register
{0x124+0x80*i} GPT{i}_GTADTRA 16-bit (i=0..2) — A/D converter start request timing register A
{0x126+0x80*i} GPT{i}_GTADTBRA 16-bit (i=0..3) — A/D converter start request timing buffer register A
0x128 GPT0_GTADTDBRA 16-bit — A/D Converter start request timing double-buffer register A
0x12C GPT0_GTADTRB 16-bit — A/D Converter start request timing register B
0x12E GPT0_GTADTBRB 16-bit — A/D Converter start request timing buffer register B
0x130 GPT0_GTADTDBRB 16-bit — A/D Converter start request timing double-buffer register B
{0x134+0x80*i} GPT{i}_GTONCR 16-bit (i=0..3) — General PWM timer output negate control register
{0x136+0x80*i} GPT{i}_GTDTCR 16-bit (i=0..3) — General PWM timer dead time control register
{0x138+0x80*i} GPT{i}_GTDVU 16-bit (i=0..3) — General PWM timer dead time value register U
{0x13A+0x80*i} GPT{i}_GTDVD 16-bit (i=0..3) — General PWM timer dead time value register D
{0x13C+0x80*i} GPT{i}_GTDBU 16-bit (i=0..3) — General PWM timer dead time buffer register U
{0x13E+0x80*i} GPT{i}_GTDBD 16-bit (i=0..3) — General PWM timer dead time buffer register D
{0x140+0x80*i} GPT{i}_GTSOS 16-bit (i=0..3) — General PWM timer output protection function status register
{0x142+0x80*i} GPT{i}_GTSOTR 16-bit (i=0..3) — General PWM timer output protection function temporary release register
{0x128+0x80*i} GPT{i}_GTADTDBRA 16-bit (i=1..3) — A/D converter start request timing double-buffer register A
{0x12C+0x80*i} GPT{i}_GTADTRB 16-bit (i=1..3) — A/D converter start request timing register B
{0x12E+0x80*i} GPT{i}_GTADTBRB 16-bit (i=1..3) — A/D converter start request timing buffer register B
{0x130+0x80*i} GPT{i}_GTADTDBRB 16-bit (i=1..3) — A/D converter start request timing double-buffer register B
0x2A4 GPT3_GTADTRA 16-bit — A/D converter start request timing Register A
