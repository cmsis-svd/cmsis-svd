# RIN32M4_CL3 register map
Vendor: Renesas Electronics Corporation; Series: RIN32M4_CL3; File version: 0.1
CPU: CM4F r0p1, little endian, MPU, FPU, 4 interrupt priority bits
Registers are 32-bit, read-write, reset 0x0 unless marked. A register's access mark holds for its fields unless they carry their own. Offsets are from the block's base; [hi:lo] are bit positions; {n}, {i} and the like mark numbered series.

## ETHSW — Ethernet Switch
Base 0x40070000
0x08 PORT_ENA — Port Enable Bits
0x0C UCAST_DEFAULT_MASK reset 0x7 — Default unicast flooding resolution
0x14 BCAST_DEFAULT_MASK — Default broadcast resolution
0x18 MCAST_DEFAULT_MASK — Default multicast resolution
0x1C INPUT_LEARN_BLOCK — Define port in blocking state and enable or disable learning
0x20 MGMT_CONFIG — Bridge Management Port Config
0x24 MODE_CONFIG — Define global config settings
0x34 VLAN_TAG_ID reset 0x8100 — VLAN type field value
0x80 OQMGR_STATUS reset 0x20004A — OQMGR status info
0x84 QMGR_MINCELLS reset 0x9 — OQMGR Low memory threshold
0x88 QMGR_ST_MINCELLS — OQMGR Statistic lowest free cells
0x8C QMGR_CGS_STAT ro — OQMGR Congestion Status
0x90 QMGR_IFACE_STAT ro reset 0x7 — OQMGR Internal I/F handshaking
0x94 QMGR_WEIGHTS — OQMGR weights
{0x100+4i} VLAN_PRIORITY{i} (i=0..2) — VLAN priority resolution map
{0x140+4i} IP_PRIORITY{i} (i=0..2) — IPv4 priority resolution
{0x180+4i} PRIORITY_CFG{i} (i=0..2) — priority resolution config
0x1C0 HUB_CONTROL reset 0xA0
0x1C4 HUB_STATS ro — HUB status
{0x1C8+8i} HUB_FLT_MAC{i}lo (i=0..5) — first 4 octets of MAC address n
{0x1CC+8i} HUB_FLT_MAC{i}hi (i=0..5) — last 2 octets of MAC address n
0x1F8 HUB_FLT_MAC6lo reset 0x6C2101 — first 4 octets of MAC address 6
0x1FC HUB_FLT_MAC6hi reset 0x1FF0100 — last 2 octets of MAC address 6
0x300 TOTAL_BYT_FRM ro — Sum of bytes of frames in TOTAL_FRM
0x304 TOTAL_BYT_DISC ro — Sum of bytes of frames in TOTAL_DISC
0x308 TOTAL_FRM ro — Total number of incoming frames
0x30C TOTAL_DISC ro — Total number of incoming frames discarded in SW
{0x310+8i} ODISC{i} (i=0..2) ro — Port n outgoing frames discarded
{0x314+8i} IDISC_BLOCKED{i} (i=0..2) ro — Port n incoming frames discarded
0x500 LRN_REC_A ro — Learning Records A
0x504 LRN_REC_B ro — Learning Records B
0x508 LRN_STATUS ro — Learning data available status
{0x8008+0x2000*i} COMMAND_CONFIG{i} (i=0..1) reset 0x10 — Command Register
{0x8014+0x2000*i} FRM_LENGTH{i} (i=0..1) reset 0x5F2 — Max frame length
{0x801C+0x2000*i} RX_SECTION_EMPTY{i} (i=0..1) ro — receive FIFO section empty threshold
{0x8020+0x2000*i} RX_SECTION_FULL{i} (i=0..1) — receive FIFO section full threshold
{0x8024+0x2000*i} TX_SECTION_EMPTY{i} (i=0..1) reset 0x48 — transmit FIFO section empty threshold
{0x8028+0x2000*i} TX_SECTION_FULL{i} (i=0..1) reset 0x14 — transmit FIFO section full threshold
{0x802C+0x2000*i} RX_ALMOST_EMPTY{i} (i=0..1) ro reset 0x8 — receive FIFO almost empty threshold
{0x8030+0x2000*i} RX_ALMOST_FULL{i} (i=0..1) ro reset 0x5 — receive FIFO almost full threshold
{0x8034+0x2000*i} TX_ALMOST_EMPTY{i} (i=0..1) ro reset 0x4 — transmit FIFO almost empty threshold
{0x8038+0x2000*i} TX_ALMOST_FULL{i} (i=0..1) ro reset 0x10 — transmit FIFO almost full threshold
{0x8058+0x2000*i} MAC_STATUS{i} (i=0..1) ro — informal status info for both MACs
{0x805C+0x2000*i} TX_IPG_LENGTH{i} (i=0..1) reset 0xC — Programmable Inter-Packet Gap
{0x8100+0x2000*i} etherStatsOctets_{i} (i=0..1) ro — Total number of octets in frames
{0x8104+0x2000*i} OctetsOK_{i} (i=0..1) ro — Total number of octets in normal frames
{0x8108+0x2000*i} aAlignmentErrors_{i} (i=0..1) ro — Number of frames received in which a SFD was not detected
{0x810C+0x2000*i} aPAUSEMACCtrlFrames_{i} (i=0..1) ro — Number of normal pause frames received
{0x8110+0x2000*i} FramesOK_{i} (i=0..1) ro — Number of normal frames received
{0x8114+0x2000*i} CRCErrors_{i} (i=0..1) ro — Number of frames received have an abnormal CRC but are of normal length
{0x8118+0x2000*i} VLANOK_{i} (i=0..1) ro — Number of frames received through port n which have a normal VLAN tag
{0x811C+0x2000*i} ifInErrors_{i} (i=0..1) ro — Number of frames which had any of the errors in reception
{0x8120+0x2000*i} ifInUcastPkts_{i} (i=0..1) ro — Number of normal unicast frames received
{0x8124+0x2000*i} ifInMulticastPkts_{i} (i=0..1) ro — Number of normal multicast frames received
{0x8128+0x2000*i} ifInBroadcastPkts_{i} (i=0..1) ro — Number of normal broadcast frames received
{0x812C+0x2000*i} etherStatsDropEvents_{i} (i=0..1) ro — Number of frames for which reception was impossible due to insufficient FIFO capacity
{0x8130+0x2000*i} etherStatsPkts_{i} (i=0..1) ro — All frames received (including normal and abnormal frames)
{0x8134+0x2000*i} etherStatsUndersizePkts_{i} (i=0..1) ro — Frames with length less 64 bytes and good CRC
{0x8138+0x2000*i} etherStatsPkts64Octets_{i} (i=0..1) ro — Frames with length of 64 bytes
{0x813C+0x2000*i} etherStatsPkts65to127Octets_{i} (i=0..1) ro — Frames with length from 65 .. 127 bytes
{0x8140+0x2000*i} etherStatsPkts128to255Octets_{i} (i=0..1) ro — Frames with length from 128 .. 255 bytes
{0x8144+0x2000*i} etherStatsPkts256to511Octets_{i} (i=0..1) ro — Frames with length from 256 .. 511 bytes
{0x8148+0x2000*i} etherStatsPkts512to1023Octets_{i} (i=0..1) ro — Frames with length from 512 .. 1023 bytes
{0x814C+0x2000*i} etherStatsPkts1024to1518Octets_{i} (i=0..1) ro — Frames with length from 1024 .. 1518 bytes
{0x8150+0x2000*i} etherStatsPkts1519toMax_{i} (i=0..1) ro — Frames with length from 1519 .. value in FRM_LENGTH register
{0x8154+0x2000*i} etherStatsOversizePkts_{i} (i=0..1) ro — Frames with length exceeding FRM_LENGTH, normal CRC
{0x8158+0x2000*i} etherStatsJabbers_{i} (i=0..1) ro — Frames with length exceeding FRM_LENGTH, bad CRC
{0x815C+0x2000*i} etherStatsFragments_{i} (i=0..1) ro — Frames with length less 64 and abnormal CRC
{0x8160+0x2000*i} aMACControlFramesReceived_{i} (i=0..1) ro — Number of normal frames received which have 0x8808 as type
{0x8164+0x2000*i} aFrameTooLong_{i} (i=0..1) ro — Total frames exceeding FRAME_LENGTH, noarmal and abnormal frames
{0x816C+0x2000*i} StackedVLANOK_{i} (i=0..1) ro — Number of normal frames received which have a stacked VLAN tag
{0x8180+0x2000*i} TXetherStatsOctets_{i} (i=0..1) ro — Total number of octets in frames which have been received (normal and abnormal frames)
{0x8184+0x2000*i} TxOctetsOK_{i} (i=0..1) ro — Total number of octets in normal frames only transmitted
{0x818C+0x2000*i} TXaPAUSEMACCtrlFrames_{i} (i=0..1) ro — Number of normal pause frames transmitted
{0x8190+0x2000*i} TxFramesOK_{i} (i=0..1) ro — Number of normal frames transmitted
{0x8194+0x2000*i} TxCRCErrors_{i} (i=0..1) ro — Number of frames transmitted which have an abnormal CRC but are of normal length
{0x8198+0x2000*i} TxVLANOK_{i} (i=0..1) ro — Number of frames transmitted which have a normal VLAN tag
{0x819C+0x2000*i} ifOutErrors_{i} (i=0..1) ro — Number of frames which had any of the errors in transmission
{0x81A0+0x2000*i} ifUcastPkts_{i} (i=0..1) ro — Number of normal unicast frames transmitted
{0x81A4+0x2000*i} ifMulticastPkts_{i} (i=0..1) ro — Number of normal multicast frames transmitted
{0x81A8+0x2000*i} ifBroadcastPkts_{i} (i=0..1) ro — Number of normal broadcast frames transmitted
{0x81AC+0x2000*i} TXetherStatsDropEvents_{i} (i=0..1) ro — Number of frames of insufficient size transmitted
{0x81B0+0x2000*i} TXetherStatsPkts_{i} (i=0..1) ro — Number of all frames transmitted
{0x81B4+0x2000*i} TXetherStatsUndersizePkts_{i} (i=0..1) ro — Frames with length less 64 bytes and normal CRC
{0x81B8+0x2000*i} TXetherStatsPkts64Octets_{i} (i=0..1) ro — Frames with length of 64 bytes
{0x81BC+0x2000*i} TXetherStatsPkts65to127Octets_{i} (i=0..1) ro — Frames with length from 65 .. 127 bytes
{0x81C0+0x2000*i} TXetherStatsPkts128to255Octets_{i} (i=0..1) ro — Frames with length from 128 .. 255 byte
{0x81C4+0x2000*i} TXetherStatsPkts256to511Octets_{i} (i=0..1) ro — Frames with length from 256 .. 511 byte
{0x81C8+0x2000*i} TXetherStatsPkts512to1023Octets_{i} (i=0..1) ro — Frames with length from 512 .. 1023 byte
{0x81CC+0x2000*i} TXetherStatsPkts1024to1518Octets_{i} (i=0..1) ro — Frames with length from 1024 .. 1518 byte
{0x81D0+0x2000*i} TXetherStatsPkts1519toMax_{i} (i=0..1) ro — Frames with length from 1519 .. value in FRM_LENGTH register
{0x81D4+0x2000*i} TXetherStatsOversizePkts_{i} (i=0..1) ro — Frames with length exceeding FRM_LENGTH, normal CRC
{0x81D8+0x2000*i} TXetherStatsJabbers_{i} (i=0..1) ro — Frames with length exceeding FRM_LENGTH, abnormal CRC
{0x81DC+0x2000*i} TXetherStatsFragments_{i} (i=0..1) ro — Frames with length less 64 bytes and error signal was asserted
{0x81E0+0x2000*i} aMACControlFrames_{i} (i=0..1) ro — Number of normal frames transmitted which have 0x8808 as type
{0x81E4+0x2000*i} TXaFrameTooLong_{i} (i=0..1) ro — Total frames exceeding FRAME_LENGTH, normal and abnormal frames
{0x81EC+0x2000*i} aMultipleCollisions_{i} (i=0..1) ro — Number of frames which have been successfully transmitted after several collisions
{0x81F0+0x2000*i} aSingleCollisions_{i} (i=0..1) ro — Number of frames which have been successfully transmitted after a single collision
{0x81F4+0x2000*i} aLateCollisions_{i} (i=0..1) ro — Number of frames transmitted in error due to a late collision
{0x81F8+0x2000*i} aExcessCollisions_{i} (i=0..1) ro — Number of frames which were discarded due to excessive collisions.
0xC004 TSM_CONFIG — TSM Module config
0xC008 TSM_IRQ_STAT_ACK — TSM Interrupt Status/Ack
{0xC020+8i} PORT{i}_CTRL (i=0..1) — TSM Port n timestamp control/status
{0xC024+8i} PORT{i}_TIME (i=0..1) ro — TSM Port n memorized timestamp
0xC120 ATIME_CTRL — TSM Time control
0xC124 ATIME — TSM Time value
0xC128 ATIME_OFFSET — TSM offset corrections
0xC12C ATIME_EVT_PERIOD reset 0x3B9ACA00 — TSM periodic events
0xC130 ATIME_CORR — TSM correction value
0xC134 ATIME_INC — TSM correction increment value
0xC138 ATIME_SEC — TSM second time value
0xC13C ATIME_OFFS_CORR — TSM offset correction counter
0xE000 DLR_CONTROL reset 0x3200
0xE004 DLR_STATUS ro reset 0x30000
0xE008 DLR_ETH_TYP reset 0x80E1 — Ethernet Type to compare for DLR frame
0xE00C DLR_IRQ_CTRL — Interrupt Control
0xE010 DLR_IRQ_STAT_ACK reset 0x180 — Interrupt Status Acknowledgement
0xE014 LOC_MAClo — Local MAC address
0xE018 LOC_MAChi — Local MAC address
0xE020 SUPR_MAClo ro — Active ring supervisor's MAC address
0xE024 SUPR_MAChi ro — Active ring supervisor's MAC address
0xE028 STATE_VLAN ro — DLR Ring state
0xE02C BEC_TMOUT ro — Beacon timeout timer value
0xE030 BEC_INTRVL ro — Beacon interval
0xE034 SUPR_IPADR ro — Ring supervisor's IP address
0xE038 ETH_STYP_VER ro — DLR Ring Ether sub Type and Protocol Version
0xE03C INV_TMOUT ro — Last out of range Beacon timeout timer value
0xE040 SEQ_ID ro — Sequence ID of the last Beacon frame
{0xE060+0x10*i} RX_STAT{i} (i=0..1) ro — Number of Beacon frames received on port n
{0xE064+0x10*i} RX_ERR_STAT{i} (i=0..1) ro — Number of Beacon frames received with crc error on port n
{0xE068+0x10*i} TX_STAT{i} (i=0..1) ro — Number of Beacon frames forwarded through the HUB from port n to port m

## Notices in the file
Copyright (C) 2012 ARM Limited. All rights reserved.
