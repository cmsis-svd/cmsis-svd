# R7F5A009 register map
Vendor: Renesas Electronics Corporation; Series: Tahoe; File version: 1
Tahoe
CPU: CM4 r0p4, little endian, MPU, FPU, 4 interrupt priority bits
Registers are 32-bit, read-write, no defined reset value unless marked. A register's access mark holds for its fields unless they carry their own. Offsets are from the block's base; lines under a group give offsets from that group; [hi:lo] are bit positions; {n}, {i} and the like mark numbered series; 'fields as' and 'values as' point back to an identical list; <NAME> marks a mode.

## Memory map
0x40000000 SYSTEM_0 size 0x400 — System controller
0x40001100 CAChE size 0x200 — Cache Controller
0x40004000 DMAC0 size 0x400 — Direct memory access controller 0
0x40004400 DMAC1 size 0x400 — Direct memory access controller 1
0x40004C00 ICU size 0xB0 — Interrupt Controller
0x40060000 TSIP size 0x200 — Trusted Secure IP
0x40088020 WDT size 0x20 — Watchdog timer
0x40088030 IWDT size 0x20 — Independent watchdog timer
0x40088040 DAC size 0x20 — D/A Converter
0x40088280 CRC size 0x10 — CRC Calculator
0x40088300 RIIC size 0x20 — I2C Bus Interface
0x40088400 SCI3_0 size 0x20 — Serial communications interface 0
0x40088440 SCI3_1 size 0x20 — Serial communications interface 1
0x40088480 SCI3_2 size 0x20 — Serial communications interface 2
0x40089000 ADC size 0x100 — A/D Converter
0x4008B000 CAC size 0x10 — Clock Frequency Accuracy Measurement Circuit
0x4008B080 DOC size 0x10 — Data operation circuit
0x4008C000 PORT size 0x100 — I/O port
0x4008C100 MPC size 0x100 — Multi-function pin controller
0x4008C280 SYSTEM_1 size 0x100 — System controller
0x4008C400 RTC size 0x100 — Real Time Clock
0x4008C500 TSN size 0x4 — Temperature sensor
0x40094200 CMT2_0 size 0x30 — Compare match timer
0x40094280 CMT2_1 size 0x30 — Compare match timer
0x40094300 CMT2_2 size 0x30 — Compare match timer
0x40094380 CMT2_3 size 0x30 — Compare match timer
0x400C1200 MTU size 0x1000 — Multi-function timer pulse unit
0x400D0100 RSPI0 size 0x20 — Serial peripheral interface 0
0x400D0120 RSPI1 size 0x20 — Serial peripheral interface 1
0x400D0400 USBhS size 0x200 — USB2.0 Host/Function module
0x40120040 OFS size 0x30 — Option Function Select Read
0xE0000000 ITM size 0x1000 — Instrumentation Trace Macrocell
0xE0001000 DWT size 0x1000 — Data Watchpoint and Trace
0xE000E000 NVIC_ICTR size 0x10 — Nested Vectored interrupt controller
0xE000E008 SYSTEM_2 size 0x20 — System controller
0xE000E100 NVIC size 0x500 — Nested Vectored interrupt controller
0xE0040000 TPIU size 0x1000 — Trace Port Interface Unit

## SYSTEM_0 — System controller
Base 0x40000000; register names take the prefix SYSTEM_0_
0x00 MDMONR 16-bit ro — Mode Monitor Register
0x02 MDSR 16-bit — Mode Status Register
0x0C SBYCR 16-bit — Standby Control Register
0x10 MSTPCRA — Module Stop Control Register A
0x14 MSTPCRB — Module Stop Control Register B
0x18 MSTPCRC — Module Stop Control Register C
0x20 SCKCR — System Clock Control Register
0x26 SCKCR3 16-bit — System Clock Control Register3
0x28 PLLCR 16-bit — PLL Control Register
0x2A PLLCR2 8-bit — PLL Control Register 2
0x32 MOSCCR 8-bit — Main Clock Oscillator Control Register
0x33 SOSCCR 8-bit — Sub-Clock Oscillator Control Register
0x34 LOCOCR 8-bit — Low-Speed Clock Oscillator Control Register
0x35 ILOCOCR 8-bit — IWDT-Dedicated Low-Speed Clock Oscillator Control Register
0x36 hOCOCR 8-bit — high-Speed Clock Oscillator Control Register
0x3C OSCOVFSR 8-bit ro — Oscillator Stabilization Flag Register
0x40 OSTDCR 8-bit — Oscillation Stop Detection Control Register
0x41 OSTDSR 8-bit — Oscillation Stop Detection Status Register
0xA0 OPCCR 8-bit — Operating Power Control Register
0xA1 RSTCLKCR 8-bit — Sleep Mode Return Clock Source Switching Register
0xA2 MOSCWTCR 8-bit — Main Oscillator Wait Control Register
0xA3 SOSCWTCR 8-bit — Sub-Oscillator Wait Control Register
0xC0 RSTSR2 8-bit — Reset Status Register 2
0xE0 LVD1CR1 8-bit — Voltage Monitoring 1 Circuit Control Register 1
0xE1 LVD1SR 8-bit — Voltage Monitoring 1 Circuit Status Register
0xE2 LVD2CR1 8-bit — Voltage Monitoring 2 Circuit Control Register 1
0xE3 LVD2SR 8-bit — Voltage Monitoring 2 Circuit Status Register
0x160 DSPCKCR — DSP Clock Control Register
0x168 DSPPLLCR 16-bit — PLL Control Register for DSP
0x16A DSPPLLCR2 8-bit — PLL Control Register 2 for DSP
0x16B DSPPLOVFSR 8-bit ro — PLL Oscillator Stabilization Flag Register for DSP
0x170 MSTPCRE — Module Stop Control Register for DSP Domain
0x3FE PRCR 16-bit — Protect Register
