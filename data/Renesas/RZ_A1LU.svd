# RZ_A1LU register map
Vendor: Renesas Electronics Corporation.; Series: RZ; File version: 3
CPU: other r3p0, little endian, MPU, no FPU, 3 interrupt priority bits
Registers are 32-bit, read-write, no defined reset value unless marked. A register's access mark holds for its fields unless they carry their own. Offsets are from the block's base; [hi:lo] are bit positions; {n}, {i} and the like mark numbered series.

## RSCAN0
Base 0xE803A000
0x00 RSCAN0C0CFG
0x04 RSCAN0C0CTR
0x08 RSCAN0C0STS
0x0C RSCAN0C0ERFL
0x10 RSCAN0C1CFG
0x14 RSCAN0C1CTR
0x18 RSCAN0C1STS
0x1C RSCAN0C1ERFL
0x84 RSCAN0GCFG
0x88 RSCAN0GCTR
0x8C RSCAN0GSTS
0x90 RSCAN0GERFL
0x94 RSCAN0GTSC
0x98 RSCAN0GAFLECTR
0x9C RSCAN0GAFLCFG0
0xA4 RSCAN0RMNB
0xA8 RSCAN0RMND0
{0xB8+4i} RSCAN0RFCC{i} (i=0..7)
{0xD8+4i} RSCAN0RFSTS{i} (i=0..7)
{0xF8+4i} RSCAN0RFPCTR{i} (i=0..7)
{0x118+4i} RSCAN0CFCC{i} (i=0..5)
{0x178+4i} RSCAN0CFSTS{i} (i=0..5)
{0x1D8+4i} RSCAN0CFPCTR{i} (i=0..5)
0x238 RSCAN0FESTS
0x23C RSCAN0FFSTS
0x240 RSCAN0FMSTS
0x244 RSCAN0RFISTS
0x248 RSCAN0CFRISTS
0x24C RSCAN0CFTISTS
{0x250+i} RSCAN0TMC{i} 8-bit (i=0..31)
{0x2D0+i} RSCAN0TMSTS{i} 8-bit (i=0..31)
0x350 RSCAN0TMTRSTS0
0x360 RSCAN0TMTARSTS0
0x370 RSCAN0TMTCSTS0
0x380 RSCAN0TMTASTS0
0x390 RSCAN0TMIEC0
0x3A0 RSCAN0TXQCC0
0x3A4 RSCAN0TXQCC1
0x3C0 RSCAN0TXQSTS0
0x3C4 RSCAN0TXQSTS1
0x3E0 RSCAN0TXQPCTR0
0x3E4 RSCAN0TXQPCTR1
0x400 RSCAN0THLCC0
0x404 RSCAN0THLCC1
0x420 RSCAN0THLSTS0
0x424 RSCAN0THLSTS1
0x440 RSCAN0THLPCTR0
0x444 RSCAN0THLPCTR1
0x460 RSCAN0GTINTSTS0
0x468 RSCAN0GTSTCFG
0x46C RSCAN0GTSTCTR
0x47C RSCAN0GLOCKK
{0x500+0x10*i} RSCAN0GAFLID{i} (i=0..15)
{0x504+0x10*i} RSCAN0GAFLM{i} (i=0..15)
{0x508+0x10*i} RSCAN0GAFLP{i:02} (i=0..9)
0x50C RSCAN0GAFLP10
0x51C RSCAN0GAFLP11
0x52C RSCAN0GAFLP12
0x53C RSCAN0GAFLP13
0x54C RSCAN0GAFLP14
0x55C RSCAN0GAFLP15
{0x46C+0x10*i} RSCAN0GAFLP{i} (i=16..19)
0x5A8 RSCAN0GAFLP010
0x5AC RSCAN0GAFLP110
0x5B8 RSCAN0GAFLP011
0x5BC RSCAN0GAFLP111
0x5C8 RSCAN0GAFLP012
0x5CC RSCAN0GAFLP112
0x5D8 RSCAN0GAFLP013
0x5DC RSCAN0GAFLP113
0x5E8 RSCAN0GAFLP014
0x5EC RSCAN0GAFLP114
0x5F8 RSCAN0GAFLP015
0x5FC RSCAN0GAFLP115
{0x600+0x10*i} RSCAN0RMID{i} (i=0..31)
{0x604+0x10*i} RSCAN0RMPTR{i} (i=0..31)
{0x608+0x10*i} RSCAN0RMDF{i:02} (i=0..9)
0x60C RSCAN0RMDF10
0x61C RSCAN0RMDF11
0x62C RSCAN0RMDF12
0x63C RSCAN0RMDF13
0x64C RSCAN0RMDF14
0x65C RSCAN0RMDF15
0x66C RSCAN0RMDF16
0x67C RSCAN0RMDF17
0x68C RSCAN0RMDF18
0x69C RSCAN0RMDF19
0x6A8 RSCAN0RMDF010
0x6AC RSCAN0RMDF110
0x6B8 RSCAN0RMDF011
0x6BC RSCAN0RMDF111
0x6C8 RSCAN0RMDF012
0x6CC RSCAN0RMDF112
0x6D8 RSCAN0RMDF013
0x6DC RSCAN0RMDF113
0x6E8 RSCAN0RMDF014
0x6EC RSCAN0RMDF114
0x6F8 RSCAN0RMDF015
0x6FC RSCAN0RMDF115
0x708 RSCAN0RMDF016
0x70C RSCAN0RMDF116
0x718 RSCAN0RMDF017
0x71C RSCAN0RMDF117
0x728 RSCAN0RMDF018
0x72C RSCAN0RMDF118
{0x608+0x10*i} RSCAN0RMDF{i:03} (i=19..31)
0x73C RSCAN0RMDF119
0x74C RSCAN0RMDF120
0x75C RSCAN0RMDF121
0x76C RSCAN0RMDF122
0x77C RSCAN0RMDF123
0x78C RSCAN0RMDF124
0x79C RSCAN0RMDF125
0x7AC RSCAN0RMDF126
0x7BC RSCAN0RMDF127
0x7CC RSCAN0RMDF128
0x7DC RSCAN0RMDF129
0x7EC RSCAN0RMDF130
0x7FC RSCAN0RMDF131
{0xE00+0x10*i} RSCAN0RFID{i} (i=0..7)
{0xE04+0x10*i} RSCAN0RFPTR{i} (i=0..7)
{0xE08+0x10*i} RSCAN0RFDF{i:02} (i=0..7)
{0xD6C+0x10*i} RSCAN0RFDF{i} (i=10..17)
{0xE80+0x10*i} RSCAN0CFID{i} (i=0..5)
{0xE84+0x10*i} RSCAN0CFPTR{i} (i=0..5)
{0xE88+0x10*i} RSCAN0CFDF{i:02} (i=0..5)
{0xDEC+0x10*i} RSCAN0CFDF{i} (i=10..15)
{0x1000+0x10*i} RSCAN0TMID{i} (i=0..31)
{0x1004+0x10*i} RSCAN0TMPTR{i} (i=0..31)
{0x1008+0x10*i} RSCAN0TMDF{i:02} (i=0..9)
0x100C RSCAN0TMDF10
0x101C RSCAN0TMDF11
0x102C RSCAN0TMDF12
0x103C RSCAN0TMDF13
0x104C RSCAN0TMDF14
0x105C RSCAN0TMDF15
0x106C RSCAN0TMDF16
0x107C RSCAN0TMDF17
0x108C RSCAN0TMDF18
0x109C RSCAN0TMDF19
0x10A8 RSCAN0TMDF010
{0x9CC+0x10*i} RSCAN0TMDF{i} (i=110..131)
0x10B8 RSCAN0TMDF011
0x10C8 RSCAN0TMDF012
0x10D8 RSCAN0TMDF013
0x10E8 RSCAN0TMDF014
0x10F8 RSCAN0TMDF015
0x1108 RSCAN0TMDF016
0x1118 RSCAN0TMDF017
0x1128 RSCAN0TMDF018
{0x1008+0x10*i} RSCAN0TMDF{i:03} (i=19..31)
0x1800 RSCAN0THLACC0
0x1804 RSCAN0THLACC1
