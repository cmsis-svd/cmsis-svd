# RZA1H register map
File version: 1.00
Registers are 32-bit, read-write, no defined reset value unless marked. A register's access mark holds for its fields unless they carry their own. Offsets are from the block's base; [hi:lo] are bit positions; {n}, {i} and the like mark numbered series.

## DISC0
Base 0xFCFFA800
Same registers: DISC1 0xFCFFB000
0x00 DOCMCR
0x04 DOCMSTR
0x08 DOCMCLSTR
0x0C DOCMIENR
0x14 DOCMPMR
0x18 DOCMECRCR
0x1C DOCMCCRCR
0x20 DOCMSPXR
0x24 DOCMSPYR
0x28 DOCMSZXR
0x2C DOCMSZYR
0x30 DOCMCRCIR

## DMAC
Base 0xE8200000
{0x0+0x40*i} N0SA_{i} (i=0..7)
{0x4+0x40*i} N0DA_{i} (i=0..7)
{0x8+0x40*i} N0TB_{i} (i=0..7)
{0xC+0x40*i} N1SA_{i} (i=0..7)
{0x10+0x40*i} N1DA_{i} (i=0..7)
{0x14+0x40*i} N1TB_{i} (i=0..7)
{0x18+0x40*i} CRSA_{i} (i=0..7)
{0x1C+0x40*i} CRDA_{i} (i=0..7)
{0x20+0x40*i} CRTB_{i} (i=0..7)
{0x24+0x40*i} CHSTAT_{i} (i=0..7)
{0x28+0x40*i} CHCTRL_{i} (i=0..7)
{0x2C+0x40*i} CHCFG_{i} (i=0..7)
{0x30+0x40*i} CHITVL_{i} (i=0..7)
{0x34+0x40*i} CHEXT_{i} (i=0..7)
{0x38+0x40*i} NXLA_{i} (i=0..7)
{0x3C+0x40*i} CRLA_{i} (i=0..7)
0x300 DCTRL_0_7
0x310 DSTAT_EN_0_7
0x314 DSTAT_ER_0_7
0x318 DSTAT_END_0_7
0x31C DSTAT_TC_0_7
0x320 DSTAT_SUS_0_7
{0x200+0x40*i} N0SA_{i} (i=8..15)
{0x204+0x40*i} N0DA_{i} (i=8..15)
{0x208+0x40*i} N0TB_{i} (i=8..15)
{0x20C+0x40*i} N1SA_{i} (i=8..15)
{0x210+0x40*i} N1DA_{i} (i=8..15)
{0x214+0x40*i} N1TB_{i} (i=8..15)
{0x218+0x40*i} CRSA_{i} (i=8..15)
{0x21C+0x40*i} CRDA_{i} (i=8..15)
{0x220+0x40*i} CRTB_{i} (i=8..15)
{0x224+0x40*i} CHSTAT_{i} (i=8..15)
{0x228+0x40*i} CHCTRL_{i} (i=8..15)
{0x22C+0x40*i} CHCFG_{i} (i=8..15)
{0x230+0x40*i} CHITVL_{i} (i=8..15)
{0x234+0x40*i} CHEXT_{i} (i=8..15)
{0x238+0x40*i} NXLA_{i} (i=8..15)
{0x23C+0x40*i} CRLA_{i} (i=8..15)
0x700 DCTRL_8_15
0x710 DSTAT_EN_8_15
0x714 DSTAT_ER_8_15
0x718 DSTAT_END_8_15
0x71C DSTAT_TC_8_15
0x720 DSTAT_SUS_8_15
{0x14DE1000+4i} DMARS{i} (i=0..7)

## DVDEC0
Base 0xFCFFB808
Same registers: DVDEC1 0xFCFFA008
0x00 ADCCR1 16-bit
{0x4+2i} TGCR{i} 16-bit (i=1..3)
{0x10+2i} SYNSCR{i} 16-bit (i=1..5)
{0x1A+2i} HAFCCR{i} 16-bit (i=1..3)
0x22 VCDWCR1 16-bit
{0x26+2i} DCPCR{i} 16-bit (i=1..8)
0x38 NSDCR 16-bit
0x3A BTLCR 16-bit
0x3C BTGPCR 16-bit
{0x3C+2i} ACCCR{i} 16-bit (i=1..3)
0x44 TINTCR 16-bit
0x46 YCDCR 16-bit
0x48 AGCCR1 16-bit
0x4A AGCCR2 16-bit
0x4C PKLIMITCR 16-bit
{0x4C+2i} RGORCR{i} 16-bit (i=1..7)
0x74 AFCPFCR 16-bit
0x76 RUPDCR 16-bit
0x78 VSYNCSR 16-bit
0x7A HSYNCSR 16-bit
0x7C DCPSR1 16-bit
0x7E DCPSR2 16-bit
0x84 NSDSR 16-bit
0x86 CROMASR1 16-bit
0x88 CROMASR2 16-bit
0x8A SYNCSSR 16-bit
0x8C AGCCSR1 16-bit
0x8E AGCCSR2 16-bit
{0xF6+2i} YCSCR{i} 16-bit (i=3..9)
0x10C YCSCR11 16-bit
0x10E YCSCR12 16-bit
0x178 DCPCR9 16-bit
{0x18A+2i} YCTWA_F{i} 16-bit (i=0..8)
{0x19C+2i} YCTWB_F{i} 16-bit (i=0..8)
{0x1AE+2i} YCTNA_F{i} 16-bit (i=0..8)
{0x1C0+2i} YCTNB_F{i} 16-bit (i=0..8)
0x1F8 YGAINCR 16-bit
0x1FA CBGAINCR 16-bit
0x1FC CRGAINCR 16-bit
0x278 PGA_UPDATE 16-bit
0x27A PGACR 16-bit
0x27C ADCCR2 16-bit

## ETHER
Base 0xE8203000
0x00 EDSR0
0x10 TDLAR0
0x14 TDFAR0
0x18 TDFXR0
0x1C TDFFR0
0x30 RDLAR0
0x34 RDFAR0
0x38 RDFXR0
0x3C RDFFR0
0x400 EDMR0
0x408 EDTRR0
0x410 EDRRR0
0x428 EESR0
0x430 EESIPR0
0x438 TRSCER0
0x440 RMFCR0
0x448 TFTR0
0x450 FDR0
0x458 RMCR0
0x460 RPADIR0
0x468 FCFTR0
0x4E4 CSMR
0x4E8 CSSBM
0x4EC CSSMR
0x500 ECMR0
0x508 RFLR0
0x510 ECSR0
0x518 ECSIPR0
0x520 PIR0
0x554 APR0
0x558 MPR0
0x55C PFTCR0
0x560 PFRCR0
0x564 TPAUSER0
0x5C0 MAHR0
0x5C8 MALR0
0x740 CEFCR0
0x748 FRECR0
0x750 TSFRCR0
0x758 TLFRCR0
0x760 RFCR0
0x778 MAFCR0
0x1800 ARSTR
0x1804 TSU_CTRST
0x1858 TSU_VTAG0
0x1860 TSU_ADSBSY
0x1864 TSU_TEN
0x1880 TXNLCR0
0x1884 TXALCR0
0x1888 RXNLCR0
0x188C RXALCR0
{0x1900+8i} TSU_ADRH{i} (i=0..31)
{0x1904+8i} TSU_ADRL{i} (i=0..31)

## FLCTL
Base 0xFCFF4000
0x00 FLCMNCR
0x04 FLCMDCR
0x08 FLCMCDR
0x0C FLADR
0x10 FLDATAR
0x14 FLDTCNTR
0x18 FLINTDMACR
0x1C FLBSYTMR
0x20 FLBSYCNT
0x2C FLTRCR
0x38 FLHOLDCR
0x3C FLADR2
0x50 FLDTFIFO
0x60 FLECFIFO
