# RZ_A1LC register map
Vendor: Renesas Electronics Corporation.; Series: RZ; File version: 3
CPU: other r3p0, little endian, MPU, no FPU, 3 interrupt priority bits
Registers are 32-bit, read-write, no defined reset value unless marked. A register's access mark holds for its fields unless they carry their own. Offsets are from the block's base; [hi:lo] are bit positions; {n}, {i} and the like mark numbered series.

## CEU
Base 0xE8210000
0x00 CAPSR
0x04 CAPCR
0x08 CAMCR
0x0C CMCYR
0x10 CAMOR_A
0x14 CAPWR_A
0x18 CAIFR
0x28 CRCNTR
0x2C CRCMPR
0x30 CFLCR_A
0x34 CFSZR_A
0x38 CDWDR_A
0x3C CDAYR_A
0x40 CDACR_A
0x44 CDBYR_A
0x48 CDBCR_A
0x4C CBDSR_A
0x5C CFWCR
0x60 CLFCR_A
0x64 CDOCR_A
0x70 CEIER
0x74 CETCR
0x7C CSTSR
0x84 CDSSR
0x90 CDAYR2_A
0x94 CDACR2_A
0x98 CDBYR2_A
0x9C CDBCR2_A
0x1010 CAMOR_B
0x1014 CAPWR_B
0x1030 CFLCR_B
0x1034 CFSZR_B
0x1038 CDWDR_B
0x103C CDAYR_B
0x1040 CDACR_B
0x1044 CDBYR_B
0x1048 CDBCR_B
0x104C CBDSR_B
0x1060 CLFCR_B
0x1064 CDOCR_B
0x1090 CDAYR2_B
0x1094 CDACR2_B
0x1098 CDBYR2_B
0x109C CDBCR2_B
0x2010 CAMOR_M
0x2014 CAPWR_M
0x2030 CFLCR_M
0x2034 CFSZR_M
0x2038 CDWDR_M
0x203C CDAYR_M
0x2040 CDACR_M
0x2044 CDBYR_M
0x2048 CDBCR_M
0x204C CBDSR_M
0x2060 CLFCR_M
0x2064 CDOCR_M
0x2090 CDAYR2_M
0x2094 CDACR2_M
0x2098 CDBYR2_M
0x209C CDBCR2_M

## WDT
Base 0xFCFE0000
0x00 WTCSR 16-bit
0x02 WTCNT 16-bit
0x04 WRCSR 16-bit

## CPG
Base 0xFCFE0010
0x00 FRQCR 16-bit
0x08 CPUSTS 8-bit
0x10 STBCR1 8-bit
0x14 STBCR2 8-bit
0x20 STBREQ1 8-bit
0x24 STBREQ2 8-bit
0x30 STBACK1 8-bit
0x34 STBACK2 8-bit
{0x3EC+4i} SYSCR{i} 8-bit (i=1..3)
{0x404+4i} STBCR{i} 8-bit (i=3..12)
0x450 SWRSTCR1 8-bit
0x117F0 RRAMKP 8-bit
0x117F2 DSCTR 8-bit
0x117F4 DSSSR 16-bit
0x117F6 DSESR 16-bit
0x117F8 DSFR 16-bit
0x11800 XTALCTR 8-bit

## INB
Base 0xFCFE1A00
0x00 RMPR
0x04 AXIBUSCTL0
0x0C AXIBUSCTL2
{0x4+4i} AXIBUSCTL{i} (i=5..7)
0x30 AXIRERRCTL0
0x38 AXIRERRCTL2
0x40 AXIRERRST0
0x48 AXIRERRST2
0x50 AXIRERRCLR0
0x58 AXIRERRCLR2

## GPIO
Base 0xFCFE3004
0x00 P1 16-bit
0x04 P2 16-bit
0x08 P3 16-bit
0x0C P4 16-bit
0x10 P5 16-bit
0x14 P6 16-bit
0x18 P7 16-bit
0x1C P8 16-bit
0x20 P9 16-bit
{0xFC+4i} PSR{i} (i=1..9)
{0x1FC+4i} PPR{i} 16-bit (i=0..9)
{0x2FC+4i} PM{i} 16-bit (i=1..9)
{0x3FC+4i} PMC{i} 16-bit (i=0..9)
{0x4FC+4i} PFC{i} 16-bit (i=0..9)
{0x5FC+4i} PFCE{i} 16-bit (i=0..9)
{0x6FC+4i} PNOT{i} 16-bit (i=1..9)
{0x7FC+4i} PMSR{i} (i=1..9)
{0x8FC+4i} PMCSR{i} (i=0..9)
{0x9FC+4i} PFCAE{i} 16-bit (i=0..9)
0xBFC SNCR
{0x3FFC+4i} PIBC{i} 16-bit (i=0..9)
{0x40FC+4i} PBDC{i} 16-bit (i=1..9)
{0x41FC+4i} PIPC{i} 16-bit (i=1..9)
0x4B1C JPPR0 16-bit
0x4B3C JPMC0 16-bit
0x4B8C JPMCSR0
0x4EFC JPIBC0 16-bit

## OSTM0
Base 0xFCFEC000
0x00 OSTM0CMP
0x04 OSTM0CNT
0x10 OSTM0TE 8-bit
0x14 OSTM0TS 8-bit
0x18 OSTM0TT 8-bit
0x20 OSTM0CTL 8-bit

## OSTM1
Base 0xFCFEC400
Registers as OSTM0 (with OSTM0 read as OSTM1).

## RIIC0
Base 0xFCFEE000
0x00 RIIC0CR1
0x04 RIIC0CR2
{0x4+4i} RIIC0MR{i} (i=1..3)
0x14 RIIC0FER
0x18 RIIC0SER
0x1C RIIC0IER
0x20 RIIC0SR1
0x24 RIIC0SR2
{0x28+4i} RIIC0SAR{i} (i=0..2)
0x34 RIIC0BRL
0x38 RIIC0BRH
0x3C RIIC0DRT
0x40 RIIC0DRR

## RIIC1
Base 0xFCFEE400
Registers as RIIC0 (with RIIC0 read as RIIC1).

## RIIC2
Base 0xFCFEE800
Registers as RIIC0 (with RIIC0 read as RIIC2).

## RIIC3
Base 0xFCFEEC00
Registers as RIIC0 (with RIIC0 read as RIIC3).

## MTU2
Base 0xFCFF0000
0x00 TCR_2 8-bit
0x01 TMDR_2 8-bit
0x02 TIOR_2 8-bit
0x04 TIER_2 8-bit
0x05 TSR_2 8-bit
0x06 TCNT_2 16-bit
0x08 TGRA_2 16-bit
0x0A TGRB_2 16-bit
0x200 TCR_3 8-bit
0x201 TCR_4 8-bit
0x202 TMDR_3 8-bit
0x203 TMDR_4 8-bit
0x204 TIORH_3 8-bit
0x205 TIORL_3 8-bit
0x206 TIORH_4 8-bit
0x207 TIORL_4 8-bit
0x208 TIER_3 8-bit
0x209 TIER_4 8-bit
0x20A TOER 8-bit
0x20D TGCR 8-bit
0x20E TOCR1 8-bit
0x20F TOCR2 8-bit
0x210 TCNT_3 16-bit
0x212 TCNT_4 16-bit
0x214 TCDR 16-bit
0x216 TDDR 16-bit
0x218 TGRA_3 16-bit
0x21A TGRB_3 16-bit
0x21C TGRA_4 16-bit
0x21E TGRB_4 16-bit
0x220 TCNTS 16-bit
0x222 TCBR 16-bit
0x224 TGRC_3 16-bit
0x226 TGRD_3 16-bit
0x228 TGRC_4 16-bit
0x22A TGRD_4 16-bit
0x22C TSR_3 8-bit
0x22D TSR_4 8-bit
0x230 TITCR 8-bit
0x231 TITCNT 8-bit
0x232 TBTER 8-bit
0x234 TDER 8-bit
0x236 TOLBR 8-bit
0x238 TBTM_3 8-bit
0x239 TBTM_4 8-bit
0x240 TADCR 16-bit
0x244 TADCORA_4 16-bit
0x246 TADCORB_4 16-bit
0x248 TADCOBRA_4 16-bit
0x24A TADCOBRB_4 16-bit
0x260 TWCR 8-bit
0x280 TSTR 8-bit
0x281 TSYR 8-bit
0x284 TRWER 8-bit
0x300 TCR_0 8-bit
0x301 TMDR_0 8-bit
0x302 TIORH_0 8-bit
0x303 TIORL_0 8-bit
0x304 TIER_0 8-bit
0x305 TSR_0 8-bit
0x306 TCNT_0 16-bit
0x308 TGRA_0 16-bit
0x30A TGRB_0 16-bit
0x30C TGRC_0 16-bit
0x30E TGRD_0 16-bit
0x320 TGRE_0 16-bit
0x322 TGRF_0 16-bit
0x324 TIER2_0 8-bit
0x325 TSR2_0 8-bit
0x326 TBTM_0 8-bit
0x380 TCR_1 8-bit
0x381 TMDR_1 8-bit
0x382 TIOR_1 8-bit
0x384 TIER_1 8-bit
0x385 TSR_1 8-bit
0x386 TCNT_1 16-bit
0x388 TGRA_1 16-bit
0x38A TGRB_1 16-bit
0x390 TICCR 8-bit

## RTC
Base 0xFCFF1000
0x00 R64CNT 8-bit
0x02 RSECCNT 8-bit
0x04 RMINCNT 8-bit
0x06 RHRCNT 8-bit
0x08 RWKCNT 8-bit
0x0A RDAYCNT 8-bit
0x0C RMONCNT 8-bit
0x0E RYRCNT 16-bit
0x10 RSECAR 8-bit
0x12 RMINAR 8-bit
0x14 RHRAR 8-bit
0x16 RWKAR 8-bit
0x18 RDAYAR 8-bit
0x1A RMONAR 8-bit
0x1C RCR1 8-bit
0x1E RCR2 8-bit
0x20 RYRAR 16-bit
0x24 RCR3 8-bit
0x26 RCR5 8-bit
0x2A RFRH 16-bit
0x2C RFRL 16-bit

## VDC50
Base 0xFCFF7400
0x00 INP_UPDATE
0x04 INP_SEL_CNT
0x08 INP_EXT_SYNC_CNT
0x0C INP_VSYNC_PH_ADJ
0x10 INP_DLY_ADJ
0x80 IMGCNT_UPDATE
0x84 IMGCNT_NR_CNT0
0x88 IMGCNT_NR_CNT1
0xA0 IMGCNT_MTX_MODE
0xA4 IMGCNT_MTX_YG_ADJ0
0xA8 IMGCNT_MTX_YG_ADJ1
0xAC IMGCNT_MTX_CBB_ADJ0
0xB0 IMGCNT_MTX_CBB_ADJ1
0xB4 IMGCNT_MTX_CRR_ADJ0
0xB8 IMGCNT_MTX_CRR_ADJ1
0x100 SC0_SCL0_UPDATE
{0x100+4i} SC0_SCL0_FRC{i} (i=1..7)
0x124 SC0_SCL0_FRC9
0x128 SC0_SCL0_MON0 16-bit
0x12A SC0_SCL0_INT 16-bit
{0x128+4i} SC0_SCL0_DS{i} (i=1..7)
{0x144+4i} SC0_SCL0_US{i} (i=1..8)
0x16C SC0_SCL0_OVR1
0x180 SC0_SCL1_UPDATE
{0x184+4i} SC0_SCL1_WR{i} (i=1..4)
{0x188+4i} SC0_SCL1_WR{i} (i=5..11)
0x1B8 SC0_SCL1_MON1
{0x1BC+4i} SC0_SCL1_PBUF{i} (i=0..3)
0x1CC SC0_SCL1_PBUF_FLD
0x1D0 SC0_SCL1_PBUF_CNT
0x200 GR0_UPDATE
0x204 GR0_FLM_RD
{0x204+4i} GR0_FLM{i} (i=1..6)
{0x21C+4i} GR0_AB{i} (i=1..3)
{0x21C+4i} GR0_AB{i} (i=7..11)
0x24C GR0_BASE
0x250 GR0_CLUT
0x280 ADJ0_UPDATE
0x284 ADJ0_BKSTR_SET
{0x284+4i} ADJ0_ENH_TIM{i} (i=1..3)
{0x290+4i} ADJ0_ENH_SHP{i} (i=1..6)
0x2AC ADJ0_ENH_LTI1
0x2B0 ADJ0_ENH_LTI2
0x2B4 ADJ0_MTX_MODE
0x2B8 ADJ0_MTX_YG_ADJ0
0x2BC ADJ0_MTX_YG_ADJ1
0x2C0 ADJ0_MTX_CBB_ADJ0
0x2C4 ADJ0_MTX_CBB_ADJ1
0x2C8 ADJ0_MTX_CRR_ADJ0
0x2CC ADJ0_MTX_CRR_ADJ1
0x300 GR2_UPDATE
0x304 GR2_FLM_RD
{0x304+4i} GR2_FLM{i} (i=1..6)
{0x31C+4i} GR2_AB{i} (i=1..11)
0x34C GR2_BASE
0x350 GR2_CLUT
0x354 GR2_MON
0x380 GR3_UPDATE
0x384 GR3_FLM_RD
{0x384+4i} GR3_FLM{i} (i=1..6)
{0x39C+4i} GR3_AB{i} (i=1..11)
0x3CC GR3_BASE
0x3D0 GR3_CLUT_INT
0x3D4 GR3_MON
0x400 GAM_G_UPDATE
0x404 GAM_SW
{0x404+4i} GAM_G_LUT{i} (i=1..16)
{0x444+4i} GAM_G_AREA{i} (i=1..8)
0x480 GAM_B_UPDATE
{0x484+4i} GAM_B_LUT{i} (i=1..16)
{0x4C4+4i} GAM_B_AREA{i} (i=1..8)
0x500 GAM_R_UPDATE
{0x504+4i} GAM_R_LUT{i} (i=1..16)
{0x544+4i} GAM_R_AREA{i} (i=1..8)
0x580 TCON_UPDATE
0x584 TCON_TIM
0x588 TCON_TIM_STVA1
0x58C TCON_TIM_STVA2
0x590 TCON_TIM_STVB1
0x594 TCON_TIM_STVB2
0x598 TCON_TIM_STH1
0x59C TCON_TIM_STH2
0x5A0 TCON_TIM_STB1
0x5A4 TCON_TIM_STB2
0x5A8 TCON_TIM_CPV1
0x5AC TCON_TIM_CPV2
0x5B0 TCON_TIM_POLA1
0x5B4 TCON_TIM_POLA2
0x5B8 TCON_TIM_POLB1
0x5BC TCON_TIM_POLB2
0x5C0 TCON_TIM_DE
0x600 OUT_UPDATE
0x604 OUT_SET
0x608 OUT_BRIGHT1
0x60C OUT_BRIGHT2
0x610 OUT_CONTRAST
0x614 OUT_PDTHA
0x624 OUT_CLK_PHASE
0x680 SYSCNT_INT1
0x684 SYSCNT_INT2
0x68C SYSCNT_INT4
0x690 SYSCNT_INT5
0x698 SYSCNT_PANEL_CLK 16-bit
0x69A SYSCNT_CLUT 16-bit
0xA00 GR_VIN_UPDATE
0xA20 GR_VIN_AB1
