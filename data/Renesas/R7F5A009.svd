# R7F5A009 register map
Vendor: Renesas Electronics Corporation; Series: Tahoe; File version: 1
CPU: CM4 r0p4, little endian, MPU, FPU, 4 interrupt priority bits
Registers are 32-bit, read-write, no defined reset value unless marked. A register's access mark holds for its fields unless they carry their own. Offsets are from the block's base; [hi:lo] are bit positions; {n}, {i} and the like mark numbered series.

## CAChE — Cache Controller
Base 0x40001100; register names take the prefix CAChE_
0x00 ROMCE 16-bit — ROM Cache Enable Register
0x04 ROMCIV 16-bit — ROM Cache Invalidate Register
0x1C ROMWT 8-bit — ROM Wait Cycle Setting Register

## DMAC0 — Direct memory access controller 0
Base 0x40004000; register names take the prefix DMAC0_
{0x0+0x40*i} DMAC0_N0SA_{i} (i=0..7) — Next0 Source Address Register {i}
{0x4+0x40*i} DMAC0_N0DA_{i} (i=0..7) — Next0 Destination Address Register {i}
{0x8+0x40*i} DMAC0_N0TB_{i} (i=0..7) — Next0 Transaction Byte Register {i}
{0x18+0x40*i} DMAC0_CRSA_{i} ro (i=0..7) — Current Source Address Register {i}
{0x1C+0x40*i} DMAC0_CRDA_{i} ro (i=0..7) — Current Destination Address Register {i}
{0x20+0x40*i} DMAC0_CRTB_{i} ro (i=0..7) — Current Transaction Byte Register {i}
{0x24+0x40*i} DMAC0_ChSTAT_{i} ro (i=0..7) — Channel Status Register {i}
{0x28+0x40*i} DMAC0_ChCTRL_{i} (i=0..7) — Channel Control Register {i}
{0x2C+0x40*i} DMAC0_ChCFG_{i} (i=0..7) — Channel Configuration Register {i}
0x300 DMAC0_DCTRL — DMA control register
0x310 DMAC0_DST_EN ro — DMA status EN register
0x314 DMAC0_DST_ER ro — DMA status ER register
0x318 DMAC0_DST_END ro — DMA status END register

## DMAC1 — Direct memory access controller 1
Base 0x40004400; register names take the prefix DMAC1_
Registers as DMAC0 (with DMAC0 read as DMAC1).

## ICU — Interrupt Controller
Base 0x40004C00; register names take the prefix ICU_
{0x0+4i} DMAC_EN{i} (i=1..5) — DMAC Interrupt Request Enable Register{i}
{0x40+4i} DMAC_SR{i:02} (i=0..7) — DMAC Activation Request Select Register {i:02}
0x60 DMAC_SR10 — DMAC Activation Request Select Register 00
{0x38+4i} DMAC_SR{i} (i=11..17) — DMAC Activation Request Select Register {i}
0x80 SWSTBYEN — Software Standby Mode Return Enable Register
0x84 IRQCR — IRQ Control Register
0x88 IRQFLTE — IRQ Pin Digital Filter Enable Register
0x8C IRQFLTC — IRQ Pin Digital Filter Setting Register
0x90 NMIER — Non-Maskable Interrupt Enable Register
0x94 NMICR — NMI Pin Interrupt Control Register
0x98 NMISR ro — Non-Maskable Interrupt Status Register
0x9C NMICLR — Non-Maskable Interrupt Status Clear Register
0xA0 NMIFLTC — NMI Pin Digital Filter Setting Register
0xA4 NMIFLTE — NMI Pin Digital Filter Enable Register

## TSIP — Trusted Secure IP
Base 0x40060000; register names take the prefix TSIP_
0x00 REG_00h
0x04 REG_04h
0x08 REG_08h
{0xC+0x10*i} REG_{i}Ch (i=0..9)
0x10 REG_10h
0x14 REG_14h
0x18 REG_18h
0x20 REG_20h
0x24 REG_24h
0x28 REG_28h
0x30 REG_30h
0x34 REG_34h
0x38 REG_38h
0x40 REG_40h
0x44 REG_44h
0x48 REG_48h
0x50 REG_50h
0x54 REG_54h
0x58 REG_58h
0x60 REG_60h
0x64 REG_64h
0x68 REG_68h
0x70 REG_70h
0x74 REG_74h
0x78 REG_78h
0x80 REG_80h
0x84 REG_84h
0x88 REG_88h
0x90 REG_90h
0x94 REG_94h
0x98 REG_98h
0xA0 REG_A0h
0xA4 REG_A4h
0xA8 REG_A8h
0xAC REG_ACh
0xB0 REG_B0h
0xB4 REG_B4h
0xB8 REG_B8h
0xBC REG_BCh
0xC0 REG_C0h
0xC4 REG_C4h
0xC8 REG_C8h
0xCC REG_CCh
0xD0 REG_D0h
0xD4 REG_D4h
0xD8 REG_D8h
0xDC REG_DCh
0xE0 REG_E0h
0xE4 REG_E4h
0xE8 REG_E8h
0xEC REG_ECh
0xF0 REG_F0h
0xF4 REG_F4h
0xF8 REG_F8h
0xFC REG_FCh
0x100 REG_100
0x104 REG_104
0x108 REG_108
{0x6C+0x10*i} REG_{i}C (i=10..19)
0x110 REG_110
0x114 REG_114
0x118 REG_118
0x120 REG_120
0x124 REG_124
0x128 REG_128
0x130 REG_130
0x134 REG_134
0x138 REG_138
0x140 REG_140
0x144 REG_144
0x148 REG_148
0x150 REG_150
0x154 REG_154
0x158 REG_158
0x160 REG_160
0x164 REG_164
0x168 REG_168
0x170 REG_170
0x174 REG_174
0x178 REG_178
0x180 REG_180
0x184 REG_184
0x188 REG_188
0x190 REG_190
0x194 REG_194
0x198 REG_198
0x1A0 REG_1A0
0x1A4 REG_1A4
0x1A8 REG_1A8
0x1AC REG_1AC
0x1B0 REG_1B0
0x1B4 REG_1B4
0x1B8 REG_1B8
0x1BC REG_1BC
0x1C0 REG_1C0
0x1C4 REG_1C4
0x1C8 REG_1C8
0x1CC REG_1CC
0x1D0 REG_1D0
0x1D4 REG_1D4
0x1D8 REG_1D8
0x1DC REG_1DC
0x1E0 REG_1E0
0x1E4 REG_1E4
0x1E8 REG_1E8
0x1EC REG_1EC
0x1F0 REG_1F0
0x1F4 REG_1F4
0x1F8 REG_1F8
0x1FC REG_1FC
