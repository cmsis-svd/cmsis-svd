# LPC5411x register map
Vendor: nxp.com; File version: 1.2
LPC5411x, ARM Cortex-M4, ARM Cortex-M0+ coprocessor
CPU: CM4 r0p1, little endian, MPU, FPU, VTOR, vendor SysTick, 3 interrupt priority bits
Registers are 32-bit, read-write, reset 0x0 unless marked. A register's access mark holds for its fields unless they carry their own. Offsets are from the block's base; lines under a group give offsets from that group; [hi:lo] are bit positions; {n}, {i} and the like mark numbered series; 'fields as' and 'values as' point back to an identical list; <NAME> marks a mode.

## Memory map
0x40000000 SYSCON size 0x40024 — LPC5411x System configuration (SYSCON)
0x40001000 IOCON size 0xC8 — LPC5411x I/O pin configuration (IOCON)
0x40002000 GINT0 size 0x48 — LPC5411x Group GPIO input interrupt (GINT0/1)
0x40003000 GINT1 size 0x48 — LPC5411x Group GPIO input interrupt (GINT0/1)
0x40004000 PINT size 0x34 — LPC5411x Pin interrupt and pattern match (PINT)
0x40005000 INPUT_MUX size 0x188 — LPC5411x Input multiplexing (INPUT MUX)
0x40008000 CT32B0 size 0x78 — LPC5411x Standard counter/timers (CT32B0 to 4)
0x40009000 CT32B1 size 0x78 — LPC5411x Standard counter/timers (CT32B0 to 4)
0x4000C000 WWDT size 0x1C — LPC5411x Windowed Watchdog Timer (WWDT)
0x4000D000 MRT size 0xFC — LPC5411x Multi-Rate Timer (MRT)
0x4000E000 UTICK size 0x20 — LPC5411x Micro-tick Timer (UTICK)
0x40028000 CT32B2 size 0x78 — LPC5411x Standard counter/timers (CT32B0 to 4)
0x4002C000 RTC size 0x10 — LPC5411x Real-Time Clock (RTC)
0x40048000 CT32B3 size 0x78 — LPC5411x Standard counter/timers (CT32B0 to 4)
0x40049000 CT32B4 size 0x78 — LPC5411x Standard counter/timers (CT32B0 to 4)
0x40082000 DMA size 0x540 — LPC5411x DMA controller
0x40084000 USB size 0x38 — LPC5411x USB 2.0 Device Controller
0x40085000 SCT size 0x540 — LPC5411x SCTimer/PWM (SCT)
0x40086000 I2C0 size 0x1000 — LPC5411x I2C-bus interfaces
0x40086000 USART0 size 0x1000 — LPC5411x USARTs
0x40086000 FLEXCOMM0 size 0x1000 — LPC5411x Flexcomm serial communication
0x40086000 SPI0 size 0x1000 — LPC5411x Serial Peripheral Interfaces (SPI)
0x40087000 I2C1 size 0x1000 — LPC5411x I2C-bus interfaces
0x40087000 FLEXCOMM1 size 0x1000 — LPC5411x Flexcomm serial communication
0x40087000 USART1 size 0x1000 — LPC5411x USARTs
0x40087000 SPI1 size 0x1000 — LPC5411x Serial Peripheral Interfaces (SPI)
0x40088000 USART2 size 0x1000 — LPC5411x USARTs
0x40088000 FLEXCOMM2 size 0x1000 — LPC5411x Flexcomm serial communication
0x40088000 I2C2 size 0x1000 — LPC5411x I2C-bus interfaces
0x40088000 SPI2 size 0x1000 — LPC5411x Serial Peripheral Interfaces (SPI)
0x40089000 USART3 size 0x1000 — LPC5411x USARTs
0x40089000 SPI3 size 0x1000 — LPC5411x Serial Peripheral Interfaces (SPI)
0x40089000 I2C3 size 0x1000 — LPC5411x I2C-bus interfaces
0x40089000 FLEXCOMM3 size 0x1000 — LPC5411x Flexcomm serial communication
0x4008A000 I2C4 size 0x1000 — LPC5411x I2C-bus interfaces
0x4008A000 SPI4 size 0x1000 — LPC5411x Serial Peripheral Interfaces (SPI)
0x4008A000 USART4 size 0x1000 — LPC5411x USARTs
0x4008A000 FLEXCOMM4 size 0x1000 — LPC5411x Flexcomm serial communication
0x4008B000 MAILBOX size 0xFC — LPC5411x Mailbox
0x4008C000 GPIO size 0x2488 — LPC5411x General Purpose I/O (GPIO)
0x40090000 DMIC size 0x1000 — LPC5411x Windowed Watchdog Timer (WWDT)
0x40095000 CRC_ENGINE size 0xC — LPC5411x CRC engine
0x40096000 I2C7 size 0x1000 — LPC5411x I2C-bus interfaces
0x40096000 USART7 size 0x1000 — LPC5411x USARTs
0x40096000 USART5 size 0x1000 — LPC5411x USARTs
0x40096000 SPI7 size 0x1000 — LPC5411x Serial Peripheral Interfaces (SPI)
0x40096000 I2C6 size 0x1000 — LPC5411x I2C-bus interfaces
0x40096000 USART6 size 0x1000 — LPC5411x USARTs
0x40096000 FLEXCOMM5 size 0x1000 — LPC5411x Flexcomm serial communication
0x40096000 SPI6 size 0x1000 — LPC5411x Serial Peripheral Interfaces (SPI)
0x40096000 SPI5 size 0x1000 — LPC5411x Serial Peripheral Interfaces (SPI)
0x40096000 I2C5 size 0x1000 — LPC5411x I2C-bus interfaces
0x40097000 FLEXCOMM6 size 0x1000 — LPC5411x Flexcomm serial communication
0x40097000 I2S0 size 0x1000 — LPC5411x I2S interface
0x40098000 FLEXCOMM7 size 0x1000 — LPC5411x Flexcomm serial communication
0x40098000 I2S1 size 0x1000 — LPC5411x I2S interface
0x400A0000 ADC size 0x74 — LPC5411x 12-bit ADC controller (ADC)

## Licence text in the file
Software that is described herein is for illustrative purposes only which provides customers with programming information regarding the products. This software is supplied "AS IS" without any warranties. NXP Semiconductors assumes no responsibility or liability for the use of the software, conveys no license or title under any patent, copyright, or mask work right to the product. NXP Semiconductors reserves the right to make changes in the software without notification. NXP Semiconductors also make no representation or warranty that such application will be suitable for the specified use without further testing or modification.
