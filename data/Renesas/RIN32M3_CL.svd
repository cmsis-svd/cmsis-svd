# RIN32M3_CL register map
Vendor: Renesas Electronics Corporation; Series: RIN32M3; File version: 0.1
CPU: CM3 r2p1, little endian, MPU, no FPU, 4 interrupt priority bits
Registers are 32-bit, read-write, reset 0x0 unless marked. A register's access mark holds for its fields unless they carry their own. Offsets are from the block's base; [hi:lo] are bit positions; {n}, {i} and the like mark numbered series.

## GPIO — Port (GPIO)
Base 0x400A3000
{0x0+i} P{i}B 8-bit (i=0..7) — Port register {i} ( 8 bit)
{0x10+i} PM{i}B 8-bit reset 0xFF (i=0..7) — Port mode register {i} ( 8 bit)
{0x20+i} PMC{i}B 8-bit (i=0..7) — Port mode control register {i} ( 8 bit)
{0x30+i} PFC{i}B 8-bit (i=0..7) — Port function control register {i} ( 8 bit)
{0x40+i} PFCE{i}B 8-bit (i=0..7) — Port function control ext.register {i} ( 8 bit)
{0x50+i} PIN{i}B 8-bit ro reset not defined (i=0..7) — Port input level register {i} ( 8 bit)

## RTPORT — Port (RTPORT)
Base 0x400A3400
{0x0+i} RP{i}B 8-bit (i=0..3) — RT Port register {i} ( 8 bit)
{0x10+i} RPM{i}B 8-bit reset 0xFF (i=0..3) — RT Port mode register {i} ( 8 bit)
{0x20+i} RPMC{i}B 8-bit (i=0..3) — RT Port mode control register {i} ( 8 bit)
{0x30+i} RPFC{i}B 8-bit (i=0..3) — RT Port function control register {i} ( 8 bit)
{0x40+i} RPFCE{i}B 8-bit (i=0..3) — RT Port function control ext.register {i} ( 8 bit)
{0x50+i} RPIN{i}B 8-bit ro reset not defined (i=0..3) — RT Port input level register {i} ( 8 bit)

## CC_Link_IE_BR — CC-Link IE Bus Bridge Control
Base 0x400A4000
0x04 CCIBSC reset 0x5555 — Bus Size Control register
0x08 CCISMC reset 0x11B1 — CC-Link BUS Control register 0
0x0C CCSMC1 reset 0x1131 — CC-Link BUS Control register 1

## SMC — Burst memory controler
Base 0x400A8000
0x10 DIRECTCMD wo reset not defined — Direct Command Register
0x14 SETCYCLES wo reset not defined
0x18 SETOPMODE wo reset not defined — Set Operating Mode Register
0x20 REFRESH0 — Refresh Period 0 Register
{0x100+0x20*i} SRAM_CYCLES0_{i} ro reset 0x2B3CC (i=0..3) — CS{i} cycle setting register
{0x104+0x20*i} OPMODE0_{i} ro reset not defined (i=0..3) — CS{i} mode register

## CCS — CC-Link Remote Device Station
Base 0x400F8000
0x00 CCS_MWRENL 8-bit ro — transmission data write enable info
0x01 CCS_M3RCEX 8-bit ro — receive data update check info
0x02 CCS_M3STNO 8-bit ro reset not defined — node number setting switch info
0x03 CCS_M3KYOKU_BSW 8-bit ro reset not defined — numbers of stations occupied info/baud rate switch info
0x04 CCS_M3ERR1SW 8-bit ro — error info1(switch state)
0x05 CCS_M3ERR2TR 8-bit ro — error info2(transmission state)
0x08 CCS_M3MRST1 8-bit ro reset not defined — M to R ST1
0x09 CCS_M3MRST2 8-bit ro reset not defined — M to R ST2
0x0A CCS_M3MRRY00_07 8-bit ro reset not defined — M to R RY00-07
0x0B CCS_M3MRRY08_0F 8-bit ro reset not defined — M to R RY08-0F
0x0C CCS_M3MRRY10_17 8-bit ro reset not defined — M to R RY10-17
0x0D CCS_M3MRRY18_1F 8-bit ro reset not defined — M to R RY18-1F
0x14 CCRES — CC-Link reset register
0x18 CCSMD — CC-Link remote device mode set register
{0x1A+2i} CCS_M3MRRWW{i}_L 8-bit ro reset not defined (i=0..3) — M to R RWw{i}(L)
{0x1B+2i} CCS_M3MRRWW{i}_H 8-bit ro reset not defined (i=0..3) — M to R RWw{i}(H)
0x40 CCS_M3SDOK 8-bit — transmission data write completion flag
0x41 CCS_M3RDRQ 8-bit — receive data read request flag
0x42 CCS_M3VENDORCODE 16-bit — Maker code
0x44 CCS_M3MODELCODE 8-bit — Model code
0x45 CCS_M3PROTOCOLVERSION 8-bit — Protocol version
0x46 CCS_M3SLED03 8-bit — SDLED blinking period setting
0x47 CCS_M3TIM03 8-bit reset not defined — time over setting
0x48 CCS_M3RMST1 8-bit — R to M ST1
0x49 CCS_M3RMST2 8-bit — R to M ST2
0x4A CCS_M3RMRX00_07 8-bit wo reset not defined — R to M RX00-07
0x4B CCS_M3RMRX08_0F 8-bit wo reset not defined — R to M RX08-0F
0x4C CCS_M3RMRX10_17 8-bit wo reset not defined — R to M RX10-17
0x4D CCS_M3RMRX18_1F 8-bit wo reset not defined — R to M RX18-1F
{0x5A+2i} CCS_M3RMRWR{i}_L 8-bit wo reset not defined (i=0..3) — M to R RWw{i}(L)
{0x5B+2i} CCS_M3RMRWR{i}_H 8-bit wo reset not defined (i=0..3) — M to R RWw{i}(H)
0x7A CCS_M3HOLDCLR 8-bit — HOLD/CLR info setting

## CC_Link_BR — CC-Link Bus Bridge Control
Base 0x400A4400
0x04 CCBSC reset 0x5555 — Bus Size Control register
0x08 CCSMC0 reset 0x11B1 — CC-Link BUS Control register 0
0x0C CCSMC1 reset 0x1131 — CC-Link BUS Control register 1
