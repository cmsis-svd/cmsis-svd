# LPC15xx register map
File version: 0.7
CPU: CM3 r2p1, little endian, no MPU, no FPU, 3 interrupt priority bits
Registers are 32-bit, read-write, reset 0x0 unless marked. A register's access mark holds for its fields unless they carry their own. Offsets are from the block's base; [hi:lo] are bit positions; {n}, {i} and the like mark numbered series.

## INMUX — Input multiplexing (INMUX)
Base 0x40014000
{0x0+4i} SCT0_INMUX[{i}] (i=0..6) reset 0x1F — Pinmux register for SCT0 input 0
  [4:0] INP_N — Input number (decimal value) to SCT0 inputs 0 to 6. 0 = PIO0_2 (external pin) 1 = PIO0_3 (external pin) 2 = PIO0_17 (external pin) 3 = PIO0_30 (external pin) 4 = PIO1_6 (external pin) 5 = PIO1_7 (external pin) 6 = PIO1_12 (external pin) 7 = PIO1_13 (external pin) 8 = SCT1_OUT4 (large SCT1 output 4) 9 = SCT2_OUT4 (companion small SCT2 output 4) 10 = SCT2_OUT5 (companion small SCT2 output 5) 11 = ADC0_THCMP_IRQ () 12 = ADC1_THCMP_IRQ () 13 = COMP0_OUT (One output from each analog comparator) 14 = COMP1_OUT 15 = COMP2_OUT 16 = COMP3_OUT 17 = SCTIPU_ABORT 18 = SCTIPU_SAMPLE0 19 = SCTIPU_SAMPLE1 20 = SCTIPU_SAMPLE2 21 = SCTIPU_SAMPLE3 22 = DEBUG_HALTED (from ARM Cortex CoreSight Debugger)
    0=PIO0_2 (PIO0_2 (external pin)); 1=PIO0_3 (PIO0_3 (external pin)); 2=PIO0_17 (PIO0_17 (external pin)); 3=PIO0_30 (PIO0_30 (external pin)); 4=PIO1_6 (PIO1_6 (external pin)); 5=PIO1_7 (PIO1_7 (external pin)); 6=PIO1_12 (PIO1_12 (external pin)); 7=PIO1_13 (PIO1_13 (external pin)); 8=SCT1_OUT4 (SCT1_OUT4 (large SCT1 output 4)); 9=SCT2_OUT4 (SCT2_OUT4 (small SCT2 output 4)); 10=SCT2_OUT5 (SCT2_OUT5 (small SCT2 output 5)); 11=ADC0_THCMP_IRQ (ADC0_THCMP_IRQ (ADC0 threshold compare interrupt)); 12=ADC1_THCMP_IRQ (ADC1_THCMP_IRQ (ADC1 threshold compare interrupt)); {v}=ACMP{v-13}_OUT (ACMP{v-13}_OUT (One output from each analog comparator)) (v=13..16); 17=SCTIPU_ABORT; {v}=SCTIPU_SAMPLE{v-18} (v=18..21); 22=DEBUG_HALTED (ARM DEBUG HALTED)
{0x20+4i} SCT1_INMUX[{i}] (i=0..6) reset 0x1F — Pinmux register for SCT1 input 0
  [4:0] INP_N — Input number (decimal value) to SCT1 inputs 0 to 6. 0 = PIO0_15 (external pin) 1 = PIO0_16 (external pin) 2 = PIO0_21 (external pin) 3 = PIO0_31 (external pin) 4 = PIO1_4 (external pin) 5 = PIO1_5 (external pin) 6 = PIO1_15 (external pin) 7 = PIO1_16 (external pin) 8 = SCT0_OUT4 (large SCT0 output 4) 9 = SCT3_OUT4 (small companion SCT3 output 4) 10 = SCT3_OUT5 (small companion SCT3 output 5) 11 = ADC0_THCMP_IRQ 12 = ADC1_THCMP_IRQ 13 = COMP0_OUT (One output from each analog comparator) 14 = COMP1_OUT 15 = COMP2_OUT 16 = A COMP3_OUT 17 = SCTIPU_ABORT 18 = SCTIPU_SAMPLE0 19 = SCTIPU_SAMPLE1 20 = SCTIPU_SAMPLE2 21 = SCTIPU_SAMPLE3 22 = DEBUG_HALTED DEBUG_HALTED (from ARM Cortex CoreSight Debugger)
{0x40+4i} SCT2_INMUX[{i}] (i=0..2) reset 0x1F — Pinmux register for SCT2 input 0
  [4:0] INP_N — Input number (decimal value) to SCT2 inputs 0 to 2. 0 = P0_4 (external pin) 1 = P0_27 (external pin) 2 = P1_18 (external pin) 3 = P1_19 (external pin) 4 = SCT0_OUT4 5 = SCT0_OUT5 6 = SCT0_OUT7 7 = SCT0_OUT8 8 = ADC0_THCMP_IRQ 9 = ADC1_THCMP_IRQ 10 = COMP0_OUT (One output from each analog comparator) 11 = COMP1_OUT 12 = COMP2_OUT 13 = COMP3_OUT 14 = SCTIPU_ABORT 15 = SCTIPU_SAMPLE0 16 = SCTIPU_SAMPLE1 17 = SCTIPU_SAMPLE2 18 = SCTIPU_SAMPLE3 19 = USB_FRAME_TOGGLE 20 = DEBUG_HALTED
{0x60+4i} SCT3_INMUX[{i}] (i=0..2) reset 0x1F — Pinmux register for SCT3 input 0
  [4:0] INP_N — Input number (decimal value) to SCT3 inputs 0 to 2. 0 = PIO0_7 1 = PIO1_11 2 = PIO1_21 3 = PIO1_22 4 = SCT1_OUT4 5 = SCT1_OUT5 6 = SCT1_OUT7 7 = SCT1_OUT8 8 = ADC0_THCMP_IRQ 9 = ADC1_THCMP_IRQ 10 = COMP0_OUT 11 = COMP1_OUT 12 = COMP2_OUT 13 = COMP3_OUT 14 = SCTIPU_ABORT3 15 = SCTIPU_SAMPLE0 16 = SCTIPU_SAMPLE1 17 = SCTIPU_SAMPLE2 18 = SCTIPU_SAMPLE3 19 = USB_FRAME_TOGGLE 20 = DEBUG_HALTED
{0xC0+4i} PINTSEL[{i}] (i=0..7) (reset mask 0x7F) — Pin interrupt select register 0
  [7:0] INTPIN — Pin number select for pin interrupt or pattern match engine input. (PIO0_0 to PIO1_31 correspond to numbers 0 to 63).
{0xE0+4i} DMA_ITRIG_INMUX[{i}] (i=0..17) reset 0x1F — Trigger input for DMA channel 0 select register.
  [4:0] INP_N — Trigger input number (decimal value) to DMA channel n. 0 = ADC0_SEQA_IRQ 1 = ADC0_SEQB_IRQ 2 = ADC1_SEQA_IRQ 3 = ADC1_SEQB_IRQ 4 = SCT0_DMA0 5 = SCT0_DMA1 6 = SCT1_DMA0 7 = SCT1_DMA1 8 = SCT2_DMA0 9 = SCT2_DMA1 10 = SCT3_DMA0 11 = SCT3_DMA1 12 = COMP0_OUT (One output from each analog comparator) 13 = COMP1_OUT 14 = COMP2_OUT 15 = COMP3_OUT 16 = SDMA_TRIGOUT_A 17 = SDMA_TRIGOUT_B 18 = SDMA_TRIGOUT_C 19 = SDMA_TRIGOUT_D
{0x140+4i} DMA_INMUX_INMUX[{i}] (i=0..3) reset 0x1F — DMA trigger input select register.
  [4:0] INP — DMA trigger output number
0x160 FREQMEAS_REF reset 0xF — Clock selection for frequency measurement function reference clock
  [3:0] CLKIN — Clock source number (decimal value) for frequency measure function target clock: 0 = System oscilator (MAIN_OSC) 1 = IRC 2 = WDOSC 3 = 32KHZOSC 4 = USB_FTOGGLE 5 = PIO0_5 6 = PIO0_19 7 = PIO0_30 8 = PIO1_27
0x164 FREQMEAS_TARGET reset 0xF — Clock selection for frequency measurement function target clock
  [3:0] CLKIN — Clock source number (decimal value) for frequency measure function target clock: 0 = System oscillator (MAIN_OSC) 1 = IRC 2 = WDOSC 3 = 32KHZOSC 4 = USB_FTOGGLE 5 = PIO0_5 6 = PIO0_19 7 = PIO0_30 8 = PIO1_27
