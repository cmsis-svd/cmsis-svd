# R7S910x01 register map
Vendor: Renesas Electronics Corporation; Series: RZT; File version: 1.0
CPU: other r1p4, little endian, MPU, FPU, vendor SysTick, 1 interrupt priority bits
Registers are 32-bit, read-write, no defined reset value unless marked. A register's access mark holds for its fields unless they carry their own. Offsets are from the block's base; [hi:lo] are bit positions; {n}, {i} and the like mark numbered series.

## DMA0 — Direct memory access controller 0
Base 0xA0062000; register names take the prefix DMA0_
{0x0+0x40*i} DMAC0_N0SA_{i}_N (i=0..7) — Next 0 source address register {i}
{0x0+0x40*i} DMAC0_N0SA_{i}_W (alternate view of DMAC0_N0SA_{i}_N) (i=0..7) — Next 0 source address register {i}
{0x4+0x40*i} DMAC0_N0DA_{i} (i=0..7) — Next 0 destination address register {i}
{0x8+0x40*i} DMAC0_N0TB_{i} (i=0..7) — Next 0 transaction byte register {i}
{0xC+0x40*i} DMAC0_N1SA_{i}_N (i=0..7) — Next 1 source address register {i}
{0xC+0x40*i} DMAC0_N1SA_{i}_W (alternate view of DMAC0_N1SA_{i}_N) (i=0..7) — Next 1 source address register {i}
{0x10+0x40*i} DMAC0_N1DA_{i} (i=0..7) — Next 1 destination address register {i}
{0x14+0x40*i} DMAC0_N1TB_{i} (i=0..7) — Next 1 transaction byte register {i}
{0x18+0x40*i} DMAC0_CRSA_{i} ro (i=0..7) — Current source address register {i}
{0x1C+0x40*i} DMAC0_CRDA_{i} ro (i=0..7) — Current destination address register {i}
{0x20+0x40*i} DMAC0_CRTB_{i} ro (i=0..7) — Current transaction byte register {i}
{0x24+0x40*i} DMAC0_CHSTAT_{i} ro (i=0..7) — Channel status register {i}
{0x28+0x40*i} DMAC0_CHCTRL_{i} (i=0..7) — Channel control register {i}
{0x2C+0x40*i} DMAC0_CHCFG_{i} (i=0..7) — Channel configuration register {i}
{0x30+0x40*i} DMAC0_CHITVL_{i} (i=0..7) — Channel interval register {i}
0x38 DMAC0_NXLA_0 — Next link address register 0
0x3C DMAC0_CRLA_0 ro — Current link address register 0
0x78 DMAC0_NXLA_1 — Current link address register 1
0x7C DMAC0_CRLA_1 ro — Next link address register 1
{0x38+0x40*i} DMAC0_NXLA_{i} (i=2..7) — Next link address register {i}
{0x3C+0x40*i} DMAC0_CRLA_{i} ro (i=2..7) — Current link address register {i}
{0x200+0x20*i} DMAC0_SCNT_{i} (i=0..7) — Source continuous register {i}
{0x204+0x20*i} DMAC0_SSKP_{i} (i=0..7) — Source skip register {i}
{0x208+0x20*i} DMAC0_DCNT_{i} (i=0..7) — Destination continuous register {i}
{0x20C+0x20*i} DMAC0_DSKP_{i} (i=0..7) — Destination skip register {i}
0x300 DMAC0_DCTRL_A — DMA control register A
0x304 DMAC0_DSCITVL_A — Descriptor interval register A
0x310 DMAC0_DST_EN_A ro — DMA status EN register A
0x314 DMAC0_DST_ER_A ro — DMA status ER register A
0x318 DMAC0_DST_END_A ro — DMA status END register A
0x320 DMAC0_DST_SUS_A ro — DMA status SUS register A
{0x200+0x40*i} DMAC0_N0SA_{i}_N (i=8..15) — Next 0 source address register {i}
{0x200+0x40*i} DMAC0_N0SA_{i}_W (alternate view of DMAC0_N0SA_{i}_N) (i=8..15) — Next 0 source address register {i}
{0x204+0x40*i} DMAC0_N0DA_{i} (i=8..15) — Next 0 destination address register {i}
{0x208+0x40*i} DMAC0_N0TB_{i} (i=8..15) — Next 0 transaction byte register {i}
{0x20C+0x40*i} DMAC0_N1SA_{i}_N (i=8..15) — Next 1 source address register {i}
{0x20C+0x40*i} DMAC0_N1SA_{i}_W (alternate view of DMAC0_N1SA_{i}_N) (i=8..15) — Next 1 source address register {i}
{0x210+0x40*i} DMAC0_N1DA_{i} (i=8..15) — Next 1 destination address register {i}
{0x214+0x40*i} DMAC0_N1TB_{i} (i=8..15) — Next 1 transaction byte register {i}
{0x218+0x40*i} DMAC0_CRSA_{i} ro (i=8..15) — Current source address register {i}
{0x21C+0x40*i} DMAC0_CRDA_{i} ro (i=8..15) — Current destination address register {i}
{0x220+0x40*i} DMAC0_CRTB_{i} ro (i=8..15) — Current transaction byte register {i}
{0x224+0x40*i} DMAC0_CHSTAT_{i} ro (i=8..15) — Channel status register {i}
{0x228+0x40*i} DMAC0_CHCTRL_{i} (i=8..15) — Channel control register {i}
{0x22C+0x40*i} DMAC0_CHCFG_{i} (i=8..15) — Channel configuration register {i}
{0x230+0x40*i} DMAC0_CHITVL_{i} (i=8..15) — Channel interval register {i}
{0x238+0x40*i} DMAC0_NXLA_{i} (i=8..15) — Next link address register {i}
{0x23C+0x40*i} DMAC0_CRLA_{i} ro (i=8..15) — Current link address register {i}
{0x500+0x20*i} DMAC0_SCNT_{i} (i=8..15) — Source continuous register {i}
{0x504+0x20*i} DMAC0_SSKP_{i} (i=8..15) — Source skip register {i}
{0x508+0x20*i} DMAC0_DCNT_{i} (i=8..15) — Destination continuous register {i}
{0x50C+0x20*i} DMAC0_DSKP_{i} (i=8..15) — Destination skip register {i}
0x700 DMAC0_DCTRL_B — DMA control register B
0x704 DMAC0_DSCITVL_B — Descriptor interval register B
0x710 DMAC0_DST_EN_B ro — DMA status EN register B
0x714 DMAC0_DST_ER_B ro — DMA status ER register B
0x718 DMAC0_DST_END_B ro — DMA status END register B
0x720 DMAC0_DST_SUS_B ro — DMA status SUS register B
