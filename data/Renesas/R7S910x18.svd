# R7S910x18 register map
Vendor: Renesas Electronics Corporation; Series: RZT; File version: 1.0
RZ/T1 Group
CPU: other r1p4, little endian, MPU, FPU, vendor SysTick, 1 interrupt priority bits
Registers are 32-bit, read-write, no defined reset value unless marked. A register's access mark holds for its fields unless they carry their own. Offsets are from the block's base; lines under a group give offsets from that group; [hi:lo] are bit positions; {n}, {i} and the like mark numbered series; 'fields as' and 'values as' point back to an identical list; <NAME> marks a mode.

## Memory map
0xA0000000 PORT size 0x200 — I/O port
0xA0000200 MPC size 0x200 — Multi-function pin controller
0xA0002000 BSC size 0x3000 — Bus state controller
0xA0005000 SPIBSC size 0x1000 — SPI multi I/O bus controller
0xA0010000 VIC size 0x2000 — Vectored interrupt controller
0xA0040000 USBh size 0x20000 — USB2.0 Host module
0xA0060000 USBf size 0x400 — USB2.0 Function module
0xA0062000 DMA0 size 0x800 — Direct memory access controller 0
0xA0063000 DMA1 size 0x800 — Direct memory access controller 1
0xA0065000 SCIFA0 size 0x20 — FIFO embedded serial communications interface 0
0xA0065400 SCIFA1 size 0x20 — FIFO embedded serial communications interface 1
0xA0065800 SCIFA2 size 0x20 — FIFO embedded serial communications interface 2
0xA0065C00 SCIFA3 size 0x20 — FIFO embedded serial communications interface 3
0xA0066000 SCIFA4 size 0x20 — FIFO embedded serial communications interface 4
0xA0068000 RSPI0 size 0x20 — Serial peripheral interface 0
0xA0068400 RSPI1 size 0x20 — Serial peripheral interface 1
0xA0068800 RSPI2 size 0x20 — Serial peripheral interface 2
0xA0068C00 RSPI3 size 0x20 — Serial peripheral interface 3
0xA006A000 MTU size 0x1000 — Multi-function timer pulse unit
0xA006C000 GPT size 0x400 — General PWM timer
0xA0072000 DSMIF size 0x100 — Delta sigma interface
0xA0078000 RSCAN size 0x3400 — CAN module
0xA007C000 CRC size 0x40 — CRC Calculator
0xA007D000 ECMM size 0x40 — Error control module master
0xA007D040 ECMC size 0x40 — Error control module checker
0xA007D080 ECM size 0x80 — Error control module common
0xA0080000 CMT size 0x60 — Compare match timer
0xA0080100 TPU size 0x104 — 16-bit timer pulse unit
0xA0080300 CMTW size 0x200 — Compare match timer W
0xA0080500 PPG0 blocks up to offset 0x10 — Programmable pulse generator 0
0xA0080510 PPG1 blocks up to offset 0x11 — Programmable pulse generator 1
0xA0080600 WDT0 size 0x10 — Watchdog timer 0
0xA0080620 WDT1 size 0x10 — Watchdog timer 1
0xA0080700 IWDT size 0x10 — Independent watchdog timer
0xA0080800 POE3 size 0x40 — Port output enable
0xA0080900 RIIC0 size 0x20 — I2C Bus Interface
0xA0080940 RIIC1 size 0x20 — I2C Bus Interface
0xA0080A00 TSN size 0x4 — Temperature sensor
0xA0080B00 ELC size 0x80 — Event link controller
0xA0081000 SSI size 0x40 — Serial sound interface
0xA0081200 DOC size 0x8 — Data operation circuit
0xA008C000 S12ADC0 size 0x100 — 12-Bit A/D Converter 0
0xA008C400 S12ADC1 size 0x100 — 12-Bit A/D Converter 1
0xA0090000 CLMA0 size 0x20 — Clock monitor circuit 0
0xA0090020 CLMA1 size 0x20 — Clock monitor circuit 1
0xA0090040 CLMA2 size 0x20 — Clock monitor circuit 2
0xA0094000 ICU size 0x400 — Interrupt controller
0xA00B0000 SYSTEM size 0xC00 — System controller
0xA00BF000 ETHERSW size 0x11000 — Ethernet switch
0xA00D0000 ECATC size 0x10000 — EtherCAT slave controller
0xA00E0000 ETHERC size 0x13000 — Ethernet controller
0xA00F3000 ECCRAM size 0x400 — ECC controller for RAM

## BSC — Bus state controller
Base 0xA0002000; register names take the prefix BSC_
0x00 CMNCR — Common control register
{0x4+4i} CS{i}BCR (i=0..5) — CS{i} space bus control register
0x28 CS0WCR_0 — CS0 space wait control register
0x28 CS0WCR_1 (alternate view of CS0WCR_0) — CS0 space wait control register
0x28 CS0WCR_2 (alternate view of CS0WCR_0) — CS0 space wait control register
0x2C CS1WCR — CS1 space wait control register
{0x28+4i} CS{i}WCR_0 (i=2..4) — CS{i} space wait control register
{0x28+4i} CS{i}WCR_1 (alternate view of CS{i}WCR_0) (i=2..4) — CS{i} space wait control register
0x3C CS5WCR — CS5 space wait control register
0x4C SDCR — SDRAM control register
0x50 RTCSR — Refresh timer control/status register
0x54 RTCNT — Refresh timer counter
0x58 RTCOR — Refresh time constant register
{0x60+4i} TOSCOR{i} (i=0..5) — Timeout cycle constant register {i}
0x80 TOSTR — Timeout status register
0x84 TOENR — Timeout enable register
0xC0C CKIOSET — CKIO Control register
0xCFC CKIOKEY 8-bit — KEY register of CKIOSET
