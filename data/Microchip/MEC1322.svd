# MEC1322 register map
Vendor: Microchip Technology Inc.; Series: ARMCM4F; File version: 1.0
The EC (MEC1322) is built around an ARM Cortex M4F Processor provided by Arm. Ltd. (the "ARM M4F IP"). The ARM Cortex M4F is a full-featured 32-bit embedded processor, implementing the ARMv7-M THUMB instruction set and FPU instruction set in hardware. . The ARM M4F IP is configured as a Von Neumann, Byte-Addressable, Little-Endian architecture. It provides a single unified 32-bit byte-level address, for a total direct addressing space of 4GByte. It has multiple bus interfaces, but these express priorities of access to the chip-level resources (Instruction. Fetch vs. Data RAM vs. others), and they do not represent separate addressing spaces.
CPU: CM4 r1p0, little endian, MPU, FPU, 3 interrupt priority bits
Registers are 32-bit, read-write, reset 0x0 unless marked. A register's access mark holds for its fields unless they carry their own. Offsets are from the block's base; lines under a group give offsets from that group; [hi:lo] are bit positions; {n}, {i} and the like mark numbered series; 'fields as' and 'values as' point back to an identical list; <NAME> marks a mode.

## Memory map
0x40000400 WDT size 0x10 — The function of the Watchdog Timer is to provide a mechanism to detect if the internal embedded controller has failed. When enabled, the Watchdog Timer (WDT) circuit will generate a WDT Event if the user program fails to reload the WDT within a specified length of time known as the WDT Interval.
0x40000C00 TIMER size 0xC0 — This timer block offers a simple mechanism for firmware to maintain a time base. This timer may be instantiated as 16 bits or 32 bits.
0x40001800 SMB0 size 0x60 — The SMBus interface can handle standard SMBus 2.0 protocols as well as I2C interface.
0x40002400 DMA size 0x200 — The Internal DMA Controller transfers data to/from the source from/to the destination. The firmware is responsible for setting up each channel. Afterwards either the firmware or the hardware may perform the flow control. The hardware flow control exists entirely inside the source device. Each transfer may be 1, 2, or 4 bytes in size, so long as the device supports a transfer of that size. Every device must be on the internal 32-bit address space.
0x40005800 PWM size 0x40 — This block generates a PWM output that can be used to control 4-wire fans, blinking LEDs, and other similar devices. Each PWM can generate an arbitrary duty cycle output at frequencies from less than 0.1 Hz to 24 MHz. The PWM controller can also used to generate the. PROCHOT output and Speaker output.
0x40006000 TACH size 0x20 — This block monitors TACH output signals (or locked rotor signals) from various types of fans, and determines their speed.
0x40006400 PECI size 0x48 — The MEC1322 includes a PECI Interface to allow the EC to retrieve temperature readings from PECI-compliant devices.
0x40007C00 ADC size 0x80 — This block is designed to convert external analog voltage readings into digital values.
0x40008C00 TFDP size 0x8 — The TFDP serially transmits Embedded Controller (EC)-originated diagnostic vectors to an external debug trace system.
0x40009000 PS2 size 0x100 — There are four PS/2 Ports in the MEC1320 which are directly controlled by the EC. The hardware implementation eliminates the need to bit bang I/O ports to generate. PS/2 traffic, however bit banging is available via the associated GPIO pins.
0x40009400 SPI size 0xA0 — The General Purpose Serial Peripheral Interface (GP-SPI) may be used to communicate with various peripheral devices, e.g., EEPROMS, DACs, ADCs, that use a standard Serial Peripheral Interface.
0x40009800 HTM size 0x10 — The Hibernation Timer can generate a wake event to the Embedded Controller (EC) when it is in a hibernation mode. This block supports wake events up to 2 hours in duration. The timer is a 16-bit binary count-down timer that can be programmed in 30.5us and 0.125 second increments for period ranges of 30.5us to 2s or 0.125s to 136.5 minutes, respectively.
0x40009C00 KMS size 0x20 — The Keyboard Scan Interface block provides a register interface to the EC to directly scan an external keyboard matrix of size up to 18x8.
0x4000A000 FAN size 0x20 — The RPM-PWM Interface is an RPM based Fan Control Algorithm that monitors the fan's speed and automatically adjusts the drive to maintain the desired fan speed. This. RPM based Fan Control Algorithm controls a PWM output based on a tachometer input.
0x4000A400 VBAT size 0x10 — The VBAT Register Bank block is a block implemented for aggregating miscellaneous battery-backed registers required the host and by the Embedded Controller (EC) Subsystem that are not unique to a block implemented in the EC subsystem. . The VBAT Powered RAM provides a 64 Byte Random Accessed Memory that is operational while the main power rail is operational, and will retain its values powered by battery power while the main rail is unpowered.
0x4000AC00 SMB1 size 0x60
0x4000B000 SMB2 size 0x60
0x4000B400 SMB3 size 0x60
0x4000B800 LED size 0x14 — The blinking/breathing hardware is implemented using a PWM. The PWM can be driven either by the 48 MHz clock or by a 32.768 KHz clock input. When driven by the 48 MHz clock, the PWM can be used as a standard 8-bit PWM in order to control a fan. When used to drive blinking or breathing LEDs, the 32.768 KHz clock source is used.
0x4000BC00 BC_LINK size 0x10 — This block provides BC-Link? connectivity to a slave device. The BC-Link protocol includes a start bit to signal the beginning of a message and a turnaround (TAR) period for bus transfer between the Master and Companion devices.
0x4000C000 INTS size 0x210 — The interrupt generation logic is made of 16 groups of signals, each of which consist of a Status register, a Enable register and a Result register. The Status and Enable are latched registers. The Result register is a bit by bit AND function of the Source and Enable registers. All the bits of the Result register are OR'ed together and AND'ed with the corresponding bit in the Block. Select register to form the interrupt signal that is routed to the ARM interrupt controller.
0x4000FC00 EC_REG_BANK size 0x80 — This block is designed to be accessed internally by the EC via the register interface.
0x40080000 JTAG size 0x10 — The Controller, which is an IEEE compliant JTAG Port, has implemented all the mandatory JTAG instructions. This interface may be used to access the embedded controller's test access port (TAP).
0x40080100 PCR size 0x80 — The Power, Clocks, and Resets (PCR) chapter identifies all the power supplies, clock sources, and reset inputs to the chip and defines all the derived power, clock, and reset signals.
0x40081000 GPIO size 0x800 — The MEC1322/24 GPIO Interface provides general purpose input monitoring and output control, as well as managing many aspects of pin functionality; including, multi-function. Pin Multiplexing Control, GPIO Direction control, PU/PD (PU_PD) resistors, asynchronous wakeup and synchronous Interrupt Detection (int_det), GPIO Direction, and Polarity control, as well as control of pin drive strength and slew rate.
0x400F0000 EMI size 0x180 — The Embedded Memory Interface (EMI) provides a standard run-time mechanism for the system host to communicate with the Embedded Controller (EC) and other logical components.
0x400F0400 KBC size 0x800 — The MEC1322 keyboard controller uses the EC to produce a superset of the features provided by the industry-standard 8042 keyboard controller. The 8042 Emulated Keyboard. Controller is a Host/EC Message Interface with hardware assists to emulate 8042 behavior and provide Legacy GATEA20 support.
0x400F0C00 ACPI size 0x120 — The ACPI Embedded Controller Interface (ACPI-ECI) provides a four byte full duplex data interface which is a superset of the standard ACPI Embedded Controller Interface (ACPI-ECI) one byte data interface. The ACPI Embedded Controller Interface (ACPI-ECI) defaults to the standard one byte interface.
0x400F1400 PM1 size 0x120 — The MEC1322 implements the ACPI fixed registers but includes only those bits that apply to the power button sleep button and RTC alarm events. The ACPI WAK_STS, SLP_TYP, and SLP_EN bits are also supported.
0x400F1800 PORT92 size 0x400 — The registers listed in the Configuration Register Summary table are for a single instance of the Legacy Port92/GATEA20 logic.
0x400F1C00 UART size 0x400 — The 16550 UART (Universal Asynchronous Receiver/Transmitter) is a full-function Two Pin Serial Port that supports the standard RS-232 Interface.
0x400F2400 MBX size 0x180 — The Mailbox provides a standard run-time mechanism for the host to communicate with the Embedded Controller (EC)
0x400F2C00 RTC size 0x40 — This is the set of registers that are automatically counted by hardware every 1 second while the block is enabled to run and to update. These registers are: Seconds, Minutes, Hours, Day of Week, Day of Month, Month, and Year.
0x400F3000 LPC size 0x400 — The registers defined for the LPC Interface block are accessible by the various hosts as indicated in Section 5.9, "LPC Configuration Registers", Section 5.10, "EC-Only Registers"and Section 5.11, "Runtime Registers".
0x400FFF00 GCR size 0x30 — The Logical Device Configuration registers support motherboard designs in which the resources required by their components are known and assigned by the BIOS at POST.

## Interrupts
0 I2C0 (SMB0) — I2C0 / SMB0 Interrupt ................. Also see GIRQ 12.0
1 I2C1 (SMB0) — I2C1 / SMB1 Interrupt ................. Also see GIRQ 12.1
2 I2C2 (SMB0) — I2C2 / SMB2 Interrupt ................. Also see GIRQ 12.2
3 I2C3 (SMB0) — I2C3 / SMB3 Interrupt ................. Also see GIRQ 12.3
4 DMA0 (DMA) — DMA_CH0 Interrupt ..................... Also see GIRQ 13.16
5 DMA1 (DMA) — DMA_CH1 Interrupt ..................... Also see GIRQ 13.17
6 DMA2 (DMA) — DMA_CH2 Interrupt ..................... Also see GIRQ 13.18
7 DMA3 (DMA) — DMA_CH3 Interrupt ..................... Also see GIRQ 13.19
8 DMA4 (DMA) — DMA_CH4 Interrupt ..................... Also see GIRQ 13.20
9 DMA5 (DMA) — DMA_CH5 Interrupt ..................... Also see GIRQ 13.21
10 DMA6 (DMA) — DMA_CH6 Interrupt ..................... Also see GIRQ 13.22
11 DMA7 (DMA) — DMA_CH7 Interrupt ..................... Also see GIRQ 13.23
12 LPC — LPC Interrupt ......................... Also see GIRQ 14.2
13 UART_0 (UART) — UART_0 Interrupt ...................... Also see GIRQ 15.0
14 EMI_0 (EMI) — EMI_0 (IMAP) Interrupt ................ Also see GIRQ 15.2
15 ACPIEC0_IBF (ACPI) — ACPIEC[0] IBF Interrupt ............... Also see GIRQ 15.6
16 ACPIEC0_OBF (ACPI) — ACPIEC[0] OBF Interrupt ............... Also see GIRQ 15.7
17 ACPIEC1_IBF (ACPI) — ACPIEC[1] IBF Interrupt ............... Also see GIRQ 15.8
18 ACPIEC1_OBF (ACPI) — ACPIEC[1] OBF Interrupt ............... Also see GIRQ 15.9
19 ACPIPM1_CTL (PM1) — ACPIPM1_CTL Interrupt ................. Also see GIRQ 15.10
20 ACPIPM1_EN (PM1) — ACPIPM1_EN Interrupt .................. Also see GIRQ 15.11
21 ACPIPM1_STS (PM1) — ACPIPM1_STS Interrupt ................. Also see GIRQ 15.12
22 KBC8042_OBF (KBC) — 8042EM OBF Interrupt .................. Also see GIRQ 15.13
23 KBC8042_IBF (KBC) — 8042EM IBF Interrupt .................. Also see GIRQ 15.14
24 MAILBOX (MBX) — MAILBOX Interrupt ..................... Also see GIRQ 15.15
25 PECIHOST (PECI) — PECIHOST Interrupt .................... Also see GIRQ 16.3
26 TACH_0 (TACH) — TACH_0 Interrupt ...................... Also see GIRQ 17.0
27 TACH_1 (TACH) — TACH_1 Interrupt ...................... Also see GIRQ 17.1
28 ADC_SNGL (ADC) — ADC_SNGL Interrupt .................... Also see GIRQ 17.10
29 ADC_RPT (ADC) — ADC_RPT Interrupt ..................... Also see GIRQ 17.11
30 ADC2PWM_N1 (ADC) — MCHP Reserved ADC2PWM_INT_N1 .......... Also see GIRQ 17.12
31 ADC2PWM_N2 (ADC) — MCHP Reserved ADC2PWM_INT_N2 .......... Also see GIRQ 17.13
32 PS2_0 (PS2) — PS2_0 Interrupt ....................... Also see GIRQ 17.14
33 PS2_1 (PS2) — PS2_1 Interrupt ....................... Also see GIRQ 17.15
34 PS2_2 (PS2) — PS2_2 Interrupt ....................... Also see GIRQ 17.16
35 PS2_3 (PS2) — PS2_3 Interrupt ....................... Also see GIRQ 17.17
36 SPI0_TX (SPI) — SPI0 TX Interrupt ..................... Also see GIRQ 18.0
37 SPI0_RX (SPI) — SPI0 RX Interrupt ..................... Also see GIRQ 18.1
38 HTIMER (HTM) — HTIMER Interrupt ...................... Also see GIRQ 17.20
39 KSC_INT (KMS) — KSC Interrupt ......................... Also see GIRQ 17.21
40 MAILBOX_DATA (MBX) — MAILBOX DATA Interrupt ................ Also see GIRQ 15.16
41 RPM_Stall (FAN) — RPM_INT Stall Interrupt ............... Also see GIRQ 17.23
42 RPM_Spin (FAN) — RPM_INT Spin Interrupt ................ Also see GIRQ 17.24
43 PFR_STS (VBAT) — PFR_STS Interrupt ..................... Also see GIRQ 17.25
44 PWM_WDT0 (PWM) — PWM_WDT0 Interrupt .................... Also see GIRQ 17.26
45 PWM_WDT1 (PWM) — PWM_WDT1 Interrupt .................... Also see GIRQ 17.27
46 PWM_WDT2 (PWM) — PWM_WDT2 Interrupt .................... Also see GIRQ 17.28
47 BCM_Err (BC_LINK) — BCM_INT Err Interrupt ................. Also see GIRQ 17.29
48 BCM_Busy (BC_LINK) — BCM_INT Busy Interrupt ................ Also see GIRQ 17.30
49 TIMER0 (TIMER) — TIMER_16_0 Interrupt .................. Also see GIRQ 23.0
50 TIMER1 (TIMER) — TIMER_16_1 Interrupt .................. Also see GIRQ 23.1
51 TIMER2 (TIMER) — TIMER_16_2 Interrupt .................. Also see GIRQ 23.2
52 TIMER3 (TIMER) — TIMER_16_3 Interrupt .................. Also see GIRQ 23.3
53 TIMER4 (TIMER) — TIMER_32_0 Interrupt .................. Also see GIRQ 23.4
54 TIMER5 (TIMER) — TIMER_32_1 Interrupt .................. Also see GIRQ 23.5
55 SPI1_TX (SPI) — SPI1 TX Interrupt ..................... Also see GIRQ 18.2
56 SPI1_RX (SPI) — SPI1 RX Interrupt ..................... Also see GIRQ 18.3
{n+49} GIRQ{n:02} (INTS) (n=8..23) — GIRQ{n:02} ................................ Interrupt Aggregator
81 DMA8 (DMA) — DMA_CH8 Interrupt ..................... Also see GIRQ 13.24
82 DMA9 (DMA) — DMA_CH9 Interrupt ..................... Also see GIRQ 13.25
83 DMA10 (DMA) — DMA_CH10 Interrupt .................... Also see GIRQ 13.26
84 DMA11 (DMA) — DMA_CH11 Interrupt .................... Also see GIRQ 13.27
85 PWM_WDT3 (PWM) — PWM_WDT3 Interrupt .................... Also see GIRQ 18.4
91 RTC — RTC Interrupt ......................... Also see GIRQ 17.18
92 RTC_ALARM (RTC) — RTC ALARM Interrupt ................... Also see GIRQ 17.19

## Licence text in the file
ARM Limited (ARM) is supplying this software for use with Cortex-M processor based microcontroller, but can be equally used for other suitable processor architectures. This file can be freely distributed. Modifications to this file shall be clearly marked. . THIS SOFTWARE IS PROVIDED "AS IS". NO WARRANTIES, WHETHER EXPRESS, IMPLIED. OR STATUTORY, INCLUDING, BUT NOT LIMITED TO, IMPLIED WARRANTIES OF. MERCHANTABILITY AND FITNESS FOR A PARTICULAR PURPOSE APPLY TO THIS SOFTWARE. ARM SHALL NOT, IN ANY CIRCUMSTANCES, BE LIABLE FOR SPECIAL, INCIDENTAL, OR. CONSEQUENTIAL DAMAGES, FOR ANY REASON WHATSOEVER.

## Notices in the file
Copyright (C) 2012-2014 ARM Limited. All rights reserved.
Redistribution and use in source and binary forms, with or without
modification, are permitted provided that the following conditions are met:
- Redistributions of source code must retain the above copyright
notice, this list of conditions and the following disclaimer.
- Redistributions in binary form must reproduce the above copyright
notice, this list of conditions and the following disclaimer in the
documentation and/or other materials provided with the distribution.
- Neither the name of ARM nor the names of its contributors may be used
to endorse or promote products derived from this software without
specific prior written permission.
THIS SOFTWARE IS PROVIDED BY THE COPYRIGHT HOLDERS AND CONTRIBUTORS "AS IS"
AND ANY EXPRESS OR IMPLIED WARRANTIES, INCLUDING, BUT NOT LIMITED TO, THE
ARE DISCLAIMED. IN NO EVENT SHALL COPYRIGHT HOLDERS AND CONTRIBUTORS BE
LIABLE FOR ANY DIRECT, INDIRECT, INCIDENTAL, SPECIAL, EXEMPLARY, OR
CONSEQUENTIAL DAMAGES (INCLUDING, BUT NOT LIMITED TO, PROCUREMENT OF
SUBSTITUTE GOODS OR SERVICES; LOSS OF USE, DATA, OR PROFITS; OR BUSINESS
INTERRUPTION) HOWEVER CAUSED AND ON ANY THEORY OF LIABILITY, WHETHER IN
CONTRACT, STRICT LIABILITY, OR TORT (INCLUDING NEGLIGENCE OR OTHERWISE)
ARISING IN ANY WAY OUT OF THE USE OF THIS SOFTWARE, EVEN IF ADVISED OF THE
POSSIBILITY OF SUCH DAMAGE.
