# RIN32M4_CL2 register map
Vendor: Renesas Electronics Corporation; Series: RIN32M4; File version: 0.1
CPU: CM4F r0p1, little endian, MPU, FPU, 4 interrupt priority bits
Registers are 32-bit, read-write, reset 0x0 unless marked. A register's access mark holds for its fields unless they carry their own. Offsets are from the block's base; [hi:lo] are bit positions; {n}, {i} and the like mark numbered series.

## ETHSW — Ethernet Switch
Base 0x40070000
0x08 PORT_ENA — Port Enable Bits
0x0C UCAST_DEFAULT_MASK reset 0x7 — Default unicast flooding resolution
0x14 BCAST_DEFAULT_MASK — Default broadcast resolution
0x18 MCAST_DEFAULT_MASK — Default multicast resolution
0x1C INPUT_LEARN_BLOCK — Define port in blocking state and enable or disable learning
0x20 MGMT_CONFIG — Bridge Management Port Config
0x24 MODE_CONFIG — Define global config settings
0x34 VLAN_TAG_ID reset 0x8100 — VLAN type field value
0x80 OQMGR_STATUS reset 0x20004A — OQMGR status info
0x84 QMGR_MINCELLS reset 0x9 — OQMGR Low memory threshold
0x88 QMGR_ST_MINCELLS — OQMGR Statistic lowest free cells
0x8C QMGR_CGS_STAT ro — OQMGR Congestion Status
0x90 QMGR_IFACE_STAT ro reset 0x7 — OQMGR Internal I/F handshaking
0x94 QMGR_WEIGHTS — OQMGR weights
{0x100+4i} VLAN_PRIORITY{i} (i=0..2) — VLAN priority resolution map
{0x140+4i} IP_PRIORITY{i} (i=0..2) — IPv4 priority resolution
{0x180+4i} PRIORITY_CFG{i} (i=0..2) — priority resolution config
0x1C0 HUB_CONTROL reset 0xA0
0x1C4 HUB_STATS ro — HUB status
{0x1C8+8i} HUB_FLT_MAC{i}lo (i=0..5) — first 4 octets of MAC address n
{0x1CC+8i} HUB_FLT_MAC{i}hi (i=0..5) — last 2 octets of MAC address n
0x1F8 HUB_FLT_MAC6lo reset 0x6C2101 — first 4 octets of MAC address 6
0x1FC HUB_FLT_MAC6hi reset 0x1FF0100 — last 2 octets of MAC address 6
0x300 TOTAL_BYT_FRM ro — Sum of bytes of frames in TOTAL_FRM
0x304 TOTAL_BYT_DISC ro — Sum of bytes of frames in TOTAL_DISC
0x308 TOTAL_FRM ro — Total number of incoming frames
0x30C TOTAL_DISC ro — Total number of incoming frames discarded in SW
{0x310+8i} ODISC{i} (i=0..2) ro — Port n outgoing frames discarded
{0x314+8i} IDISC_BLOCKED{i} (i=0..2) ro — Port n incoming frames discarded
0x500 LRN_REC_A ro — Learning Records A
0x504 LRN_REC_B ro — Learning Records B
0x508 LRN_STATUS ro — Learning data available status
{0x8008+0x2000*i} COMMAND_CONFIG{i} (i=0..1) reset 0x10 — Command Register
{0x8014+0x2000*i} FRM_LENGTH{i} (i=0..1) reset 0x5F2 — Max frame length
{0x801C+0x2000*i} RX_SECTION_EMPTY{i} (i=0..1) ro — receive FIFO section empty threshold
{0x8020+0x2000*i} RX_SECTION_FULL{i} (i=0..1) — receive FIFO section full threshold
{0x8024+0x2000*i} TX_SECTION_EMPTY{i} (i=0..1) reset 0x48 — transmit FIFO section empty threshold
{0x8028+0x2000*i} TX_SECTION_FULL{i} (i=0..1) reset 0x14 — transmit FIFO section full threshold
{0x802C+0x2000*i} RX_ALMOST_EMPTY{i} (i=0..1) ro reset 0x8 — receive FIFO almost empty threshold
{0x8030+0x2000*i} RX_ALMOST_FULL{i} (i=0..1) ro reset 0x5 — receive FIFO almost full threshold
{0x8034+0x2000*i} TX_ALMOST_EMPTY{i} (i=0..1) ro reset 0x4 — transmit FIFO almost empty threshold
{0x8038+0x2000*i} TX_ALMOST_FULL{i} (i=0..1) ro reset 0x10 — transmit FIFO almost full threshold
{0x8058+0x2000*i} MAC_STATUS{i} (i=0..1) ro — informal status info for both MACs
{0x805C+0x2000*i} TX_IPG_LENGTH{i} (i=0..1) reset 0xC — Programmable Inter-Packet Gap
0xC004 TSM_CONFIG — TSM Module config
0xC008 TSM_IRQ_STAT_ACK — TSM Interrupt Status/Ack
{0xC020+8i} PORT{i}_CTRL (i=0..1) — TSM Port n timestamp control/status
{0xC024+8i} PORT{i}_TIME (i=0..1) ro — TSM Port n memorized timestamp
0xC120 ATIME_CTRL — TSM Time control
0xC124 ATIME — TSM Time value
0xC128 ATIME_OFFSET — TSM offset corrections
0xC12C ATIME_EVT_PERIOD reset 0x3B9ACA00 — TSM periodic events
0xC130 ATIME_CORR — TSM correction value
0xC134 ATIME_INC — TSM correction increment value
0xC138 ATIME_SEC — TSM second time value
0xC13C ATIME_OFFS_CORR — TSM offset correction counter
0xE000 DLR_CONTROL reset 0x3200
0xE004 DLR_STATUS ro reset 0x30000
0xE008 DLR_ETH_TYP reset 0x80E1 — Ethernet Type to compare for DLR frame
0xE00C DLR_IRQ_CTRL — Interrupt Control
0xE010 DLR_IRQ_STAT_ACK reset 0x180 — Interrupt Status Acknowledgement
0xE014 LOC_MAClo — Local MAC address
0xE018 LOC_MAChi — Local MAC address
0xE020 SUPR_MAClo ro — Active ring supervisor's MAC address
0xE024 SUPR_MAChi ro — Active ring supervisor's MAC address
0xE028 STATE_VLAN ro — DLR Ring state
0xE02C BEC_TMOUT ro — Beacon timeout timer value
0xE030 BEC_INTRVL ro — Beacon interval
0xE034 SUPR_IPADR ro — Ring supervisor's IP address
0xE038 ETH_STYP_VER ro — DLR Ring Ether sub Type and Protocol Version
0xE03C INV_TMOUT ro — Last out of range Beacon timeout timer value
0xE040 SEQ_ID ro — Sequence ID of the last Beacon frame
{0xE060+0x10*i} RX_STAT{i} (i=0..1) ro — Number of Beacon frames received on port n
{0xE064+0x10*i} RX_ERR_STAT{i} (i=0..1) ro — Number of Beacon frames received with crc error on port n
{0xE068+0x10*i} TX_STAT{i} (i=0..1) ro — Number of Beacon frames forwarded through the HUB from port n to port m
