# RIN32M3_CL register map
Vendor: Renesas Electronics Corporation; Series: RIN32M3; File version: 0.1
CPU: CM3 r2p1, little endian, MPU, no FPU, 4 interrupt priority bits
Registers are 32-bit, read-write, reset 0x0 unless marked. A register's access mark holds for its fields unless they carry their own. Offsets are from the block's base; [hi:lo] are bit positions; {n}, {i} and the like mark numbered series.

## CSI0 — CSI
Base 0x40000100
Same registers: CSI1 0x40000200
0x00 CSIHnCTL0 — Control register 0
0x04 CSIHnSTR0 ro reset 0x10 — Status register 0
0x08 CSIHnSTCR0 wo — Status clear register 0
0x10 CSIHnCTL1 — Control register 1
0x14 CSIHnCTL2 reset 0xE000 — Control register 2
0x40 CSIHnMCTL0 reset 0x1F — Memory control register 0
0x80 CSIHnMCTL1 — Memory control register 1
0x84 CSIHnMCTL2 — Memory control register 2
0x88 CSIHnTX0W reset not defined — Transmit data register 0 for word access
0x8C CSIHnTX0H reset not defined — Transmit data register 0 for half word access
0x90 CSIHnRX0W ro reset not defined — Receive data register 0 for word access
0x94 CSIHnRX0H ro reset not defined — Receive data register 0 for half word access
0x98 CSIHnMRWP0 — Memory read/write pointerregister 0
0xC4 CSIHnCFG0 — Configuration register 0
0xC8 CSIHnCFG1 — Configuration register 1

## UART0 — UART
Base 0x40000300
Same registers: UART1 0x40000400
0x00 URTJnCTL0 — Control Register 0
0x04 URTJnTRG — Triger Register
0x08 URTJnSTR0 ro — Status Register 0
0x0C URTJnSTR1 ro — Status Register 1
0x10 URTJnSTC — Status Clear Register
0x20 URTJnCTL1 reset 0x5002 — Control Register 1
0x24 URTJnCTL2 reset 0xEFFF — Control Register 2
0x80 URTJnFCTL0 reset 0xF00 — FIFO Control Register 0
0x84 URTJnFSTR0 ro reset 0x10 — FIFO Status Register 0
0x88 URTJnFSTR1 ro reset 0x5 — FIFO Status Register 1
0x8C URTJnFSTC — FIFO Status Clear Register
0x90 URTJnFRX ro reset 0xFF — FIFO Recieve Data Register
0x94 URTJnFTX 8-bit reset 0xFF — FIFO Transmit Data Register
0xA0 URTJnFCTL1 reset 0x3F — FIFO Control Register 1

## IIC0 — IIC
Base 0x40000500
Same registers: IIC1 0x40000600
0x00 IICBnDAT 8-bit — Data register
0x04 IICBnSVA 8-bit — Slave address register
0x08 IICBnCTL0 8-bit — Control Register 0
0x0C IICBnTRG 8-bit — Trigger register
0x10 IICBnSTR0 16-bit ro — Status Register 0
0x14 IICBnSTR1 8-bit ro — Status Register 1
0x18 IICBnSTRC 8-bit — Status clear register
0x20 IICBnCTL1 8-bit — Control Register 1
0x24 IICBnWL 16-bit reset 0x3FF — Low level width setting register
0x28 IICBnWH 16-bit reset 0x3FF — High level width setting register

## WDT — WatchDoc Timer
Base 0x40000700
0x00 WDTAnWDTE 8-bit reset 0x2C — Watchdog Timer Enable register
0x0C WDTAnMD 8-bit reset 0xF — Watchdog Timer Mode register

## SYS — System
Base 0x40010000
0x00 MDMNT ro reset not defined — Mode monitor register
0x04 IDCODE ro reset 0x52494E31
0x08 RINVER reset 0x1 — Version register
0x100 WREN reset 0x1 — Write enable register
0x108 WAITZSEL reset 0xF — WAITZ selection register
{0x110+4i} SMADSEL{i} reset 0x100000FC (i=0..3) — External memory I/F select {i}
0x120 BCLKSEL reset 0x4 — BUSCLK devide
0x124 SMCMD — SMC mode
0x180 WDTCLKCFG — WDT input clock selection register
0x1A0 CLKGTD0 reset 0xFFFF — Clock control 0
0x1A4 CLKGTD1 reset 0xFFFF — Clock control 1
0x1C0 SYSRESET — System reset register
0x210 CPURESET (reset mask 0xFFFFFFF0)
0x228 DRCTLP1L reset 0x9959 — Buffer function select P1L
0x22C DRCTLP1H reset 0x9999 — Buffer function select P1H
0x238 DRCTLP3L reset 0x9999 — Buffer function select P3L
0x23C DRCTLP3H reset 0x9999 — Buffer function select P3H
0x240 DRCTLP4L reset 0x9999 — Buffer function select P4L
0x244 DRCTLP4H reset 0x9999 — Buffer function select P4H
0x248 DRCTLP5L reset 0x599 — Buffer function select P5L
0x24C DRCTLP5H reset 0x9000 — Buffer function select P5H
0x260 DRCTLRP0L reset 0x9999 — Buffer function select RP0L
0x264 DRCTLRP0H reset 0x9999 — Buffer function select RP0H
0x268 DRCTLRP1L reset 0x9999 — Buffer function select RP1L
0x26C DRCTLRP1H reset 0x9999 — Buffer function select RP1H
0x270 DRCTLRP2L reset 0x5559 — Buffer function select RP2L
0x274 DRCTLRP2H reset 0x5555 — Buffer function select RP2H
0x278 DRCTLRP3L reset 0x9999 — Buffer function select RP3L
0x27C DRCTLRP3H reset 0x9999 — Buffer function select RP3H
0x300 SYSPCMD — System protect command
0x500 SELCNT — Timer input select
{0x530+4i} TMTFR{i} (i=0..3) — Timer trigger factor {i}
0x600 MACSEL reset 0x1
0x604 MDCCFG — MDC clock select
0x610 ETHDRCTRL reset 0x5 — Ethernet I/F buffer select
0x614 ETHPHYLNK reset 0xC — Ethernet PHY link level select
0x620 CATOFFADD — EtherCAT PHY offset address
0x624 CATEMMD — EtherCAT mode control
0x628 CATRESET — EtherCAT reset
0x680 ETHSWMTC reset 0xE001 — EtherSW management TAG
0x684 ETHSWMD — EtherSW mode control
{0x700+4i} NFC{i} (i=0..3) — Noise filter control {i}
{0x710+4i} INTM{i} reset 0x2 (i=0..2) — External interrupt mode {i}
0x720 DMAIFC0 — DMA transfer interface signal 0
0x724 DMAIFC1 — DMA transfer interface signal 1
0x728 RTDMAIFC — DMA transfer interface signal RT
{0x730+4i} DTFR{i} (i=0..3) — DMA trigger factor {i}
0x740 RTDTFR — DMA trigger factor RT
0x804 SRAMBRSEL — CC-Link IE Bridge select resister
0x80C CCSMON — CC-Link slave monitor
0x810 CCSRUN — CC-Link slave RUN LED control
0x814 CCRES — CC-Link reset register
0x818 CCSMD — CC-Link mode register
{0x900+4i} SCRATCH{i} (i=0..9)
0x928 SCRATCHA
0x92C SCRATCHB
0x930 SCRATCHC
0x934 SCRATCHD
0x938 CIECLKGTD — CC-Link IE clock gated resister
0x93C CIEWAITDLY — CC-Link IE bus wait delay resister
0xA00 RPTRGMD — Trigger sync port control
{0xA30+4i} RP{i}TFR (i=0..3) — Trigger sync port factor {i}

## Notices in the file
Copyright (C) 2012 ARM Limited. All rights reserved.
