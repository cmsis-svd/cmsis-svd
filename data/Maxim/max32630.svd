# max32630 register map
Vendor: Maxim Integrated; Series: max3263x; File version: 1.2
ARM 32-bit Cortex-M4 Microcontroller based device, Operation up to 96MHz, 2MB Flash Memory, 512KB RAM
CPU: CM4 r0p1, little endian, no MPU, FPU, 3 interrupt priority bits
Registers are 32-bit, read-write, reset 0x0 unless marked. A register's access mark holds for its fields unless they carry their own. Offsets are from the block's base; lines under a group give offsets from that group; [hi:lo] are bit positions; {n}, {i} and the like mark numbered series; 'fields as' and 'values as' point back to an identical list; <NAME> marks a mode.

## Memory map
0x40000000 SYSMAN size 0x400 — System Manager Settings
0x40000400 CLKMAN size 0x400 — System Clock Manager
0x40000800 PWRMAN size 0x200 — System Power Manager
0x40000A00 RTCTMR size 0x30 — Real Time Clock
0x40000A30 PWRSEQ size 0x40 — Power Sequencer
0x40000A70 RTCCFG size 0x90 — Real Time Clock
0x40000C00 IOMAN size 0x400 — System I/O Manager
0x40002000 FLC size 0x1000 — Flash Controller
0x40003000 ICC size 0x1000 — Instruction Cache
0x40004000 SPIX size 0x1000 — SPI XIP Interface
0x40005000 PMU0 size 0x20 — Peripheral Management Unit
0x40005020 PMU1 size 0x20
0x40005040 PMU2 size 0x20
0x40005060 PMU3 size 0x20
0x40005080 PMU4 size 0x20
0x400050A0 PMU5 size 0x20
0x40006000 CRC size 0x1000 — CRC-16/CRC-32 Engine
0x40007000 TPU size 0x400 — Trust Protection Unit (TPU)
0x40007400 AES size 0x400 — AES Cryptographic Engine
0x40007800 MAA size 0x400 — MAA Cryptographic Engine
0x40007C00 TPU_TSR size 0x40 — Trust Protection Unit (TPU)
0x40007C60 WDT2 size 0xA0 — Low-Level Watchdog Timer
0x40008000 WDT0 size 0x1000 — Watchdog Timers
0x40009000 WDT1 size 0x1000
0x4000A000 GPIO size 0x1000 — General Purpose I/O Ports (GPIO)
0x4000B000 TMR0 size 0x1000 — 16/32 bit Timer/Counters
0x4000C000 TMR1 size 0x1000
0x4000D000 TMR2 size 0x1000
0x4000E000 TMR3 size 0x1000
0x4000F000 TMR4 size 0x1000
0x40010000 TMR5 size 0x1000
0x40011000 PTG size 0x10 — Pulse Train Generation
0x40011020 PT0 size 0x10 — Pulse Train Generation
{0x40011020+0x20*n} PT{n} size 0x10 (n=1..15)
0x40012000 UART0 size 0x1000 — UART / Serial Port Interface
0x40013000 UART1 size 0x1000
0x40014000 UART2 size 0x1000
0x40015000 UART3 size 0x1000
0x40016000 I2CM0 size 0x1000 — I2C Master Interface
0x40017000 I2CM1 size 0x1000
0x40018000 I2CM2 size 0x1000
0x40019000 I2CS size 0x1000 — I2C Slave Interface (Mailbox type)
0x4001A000 SPIM0 size 0x1000 — SPI Master Interface
0x4001B000 SPIM1 size 0x1000
0x4001C000 SPIM2 size 0x1000
0x4001E000 OWM size 0x1000 — 1-Wire Master Interface
0x4001F000 ADC size 0x1000 — ADC / AFE
0x40020000 SPIS size 0x1000 — SPI Slave Interface
0x40100000 USB size 0x1000 — USB Device Controller

## Licence text in the file
Copyright (C) 2018 Maxim Integrated Products, Inc., All Rights Reserved. . Permission is hereby granted, free of charge, to any person obtaining a copy of this software and associated documentation files (the "Software"), to deal in the Software without restriction, including without limitation the rights to use, copy, modify, merge, publish, distribute, sublicense, and/or sell copies of the Software, and to permit persons to whom the. Software is furnished to do so, subject to the following conditions: The above copyright notice and this permission notice shall be included in all copies or substantial portions of the Software. * THE SOFTWARE IS PROVIDED "AS IS", WITHOUT WARRANTY OF ANY KIND, EXPRESS. OR IMPLIED, INCLUDING BUT NOT LIMITED TO THE WARRANTIES OF. MERCHANTABILITY, FITNESS FOR A PARTICULAR PURPOSE AND NONINFRINGEMENT. IN NO EVENT SHALL MAXIM INTEGRATED BE LIABLE FOR ANY CLAIM, DAMAGES. OR OTHER LIABILITY, WHETHER IN AN ACTION OF CONTRACT, TORT OR OTHERWISE, ARISING FROM, OUT OF OR IN CONNECTION WITH THE SOFTWARE OR THE USE OR. OTHER DEALINGS IN THE SOFTWARE. . Except as contained in this notice, the name of Maxim Integrated. Products, Inc. shall not be used except as stated in the Maxim Integrated. Products, Inc. Branding Policy. . The mere transfer of this software does not imply any licenses of trade secrets, proprietary technology, copyrights, patents, trademarks, maskwork rights, or any other form of intellectual property whatsoever. Maxim Integrated Products, Inc. retains all ownership rights.
