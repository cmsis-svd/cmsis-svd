# R7S910x01 register map
Vendor: Renesas Electronics Corporation; Series: RZT; File version: 1.0
CPU: other r1p4, little endian, MPU, FPU, vendor SysTick, 1 interrupt priority bits
Registers are 32-bit, read-write, no defined reset value unless marked. A register's access mark holds for its fields unless they carry their own. Offsets are from the block's base; [hi:lo] are bit positions.

## USBh — USB2.0 Host module
Base 0xA0040000; register names take the prefix USBh_
0x00 HcRevision ro
0x04 HcControl
0x08 HcCommandStatus
0x0C HcIntStatus — HcInterruptStatus register
0x10 HcIntEnable — HcInterruptEnable register
0x14 HcIntDisable — HcInterruptDisable register
0x18 HcHCCA
0x1C HcPeriodCurED ro — HcPeriodCurrentED register
0x20 HcContHeadED — HcControlHeadED register
0x24 HcContCurrentED — HcControlCurrentED register
0x28 HcBulkHeadED
0x2C HcBulkCurrentED
0x30 HcDoneHead ro
0x34 HcFmInterval
0x38 HcFmRemaining ro
0x3C HcFmNumber ro
0x40 HcPeriodicStart
0x44 HcLSThreshold
0x48 HcRhDescriptorA
0x4C HcRhDescriptorB
0x50 HcRhStatus_A — HcRhStatus register
0x50 HcRhStatus_B (alternate view of HcRhStatus_A) — HcRhStatus register
0x54 HcRhPortStatus1_A — HcRhPortStatus1 register
0x54 HcRhPortStatus1_B (alternate view of HcRhPortStatus1_A) — HcRhPortStatus1 register
0x1000 CAPL_VERSION ro — HCIVERSION / CAPLENGTH register
0x1004 HCSPARAMS ro
0x1008 HCCPARAMS ro
0x100C HCSP_PORTROUTE ro
0x1020 USBCMD
0x1024 USBSTS
0x1028 USBINTR
0x102C FRINDEX
0x1030 CTRLDSSEGMENT ro
0x1034 PERIODICLIST — PERIODICLISTBASE register
0x1038 ASYNCLISTADDR
0x1060 CONFIGFLAG
0x1064 PORTSC1
0x10000 VID_DID_O ro — PCI configuration register for OHCI
0x10000 VID_DID_A ro (alternate view of VID_DID_O) — PCI configuration register for AHB-PCI bridge
0x10004 CMND_STS_O — PCI configuration register for OHCI
0x10004 CMND_STS_A (alternate view of CMND_STS_O) — PCI configuration register for AHB-PCI bridge
0x10008 REVID_CC_O ro — PCI configuration register for OHCI
0x10008 REVID_CC_A ro (alternate view of REVID_CC_O) — PCI configuration register for AHB-PCI bridge
0x1000C CLS_LT_HT_BIST_O — PCI configuration register for OHCI
0x1000C CLS_LT_HT_BIST_A (alternate view of CLS_LT_HT_BIST_O) — PCI configuration register for AHB-PCI bridge
0x10010 BASEAD_O — PCI configuration register for OHCI
0x10010 BASEAD_A (alternate view of BASEAD_O) — PCI configuration register for AHB-PCI bridge
0x10014 WIN1_BASEAD — PCI configuration register for AHB-PCI bridge
0x1002C SSVID_SSID_O ro — PCI configuration register for OHCI
0x1002C SSVID_SSID_A ro (alternate view of SSVID_SSID_O) — PCI configuration register for AHB-PCI bridge
0x10030 EROM_BASEAD ro — PCI configuration register for OHCI
0x10034 CAPPTR ro — PCI configuration register for OHCI
0x1003C INTR_LINE_PIN_O — PCI configuration register for OHCI
0x1003C INTR_LINE_PIN_A (alternate view of INTR_LINE_PIN_O) — PCI configuration register for AHB-PCI bridge
0x10040 CAPID_NIP_PMCAP ro — PCI configuration register for OHCI
0x10044 PMC_STS_PMCSR — PCI configuration register for OHCI
0x100E0 EXT1 — PCI configuration register for OHCI
0x100E4 EXT2 — PCI configuration register for OHCI
0x10100 VID_DID_E ro — PCI configuration register for EHCI
0x10104 CMND_STS_E — PCI configuration register for EHCI
0x10108 REVID_CC_E ro — PCI configuration register for EHCI
0x1010C CLS_LT_HT_BIST_E — PCI configuration register for EHCI
0x10110 BASEAD_E — PCI configuration register for EHCI
0x1012C SSVID_SSID_E ro — PCI configuration register for EHCI
0x10130 EROM_BASEAD_E ro — PCI configuration register for EHCI
0x10134 CAPPTR_E ro — PCI configuration register for EHCI
0x1013C INTR_LINE_PIN_E — PCI configuration register for EHCI
0x10140 CAPID_NIP_PMCAP_E ro — PCI configuration register for EHCI
0x10144 PMC_STS_PMCSR_E — PCI configuration register for EHCI
0x10160 SBRN_FLADJ_PW — PCI configuration register for EHCI
0x101E0 EXT1_E — PCI configuration register for EHCI
0x101E4 EXT2_E — PCI configuration register for EHCI
0x10800 PCIAHB_WIN1_CTR
0x10810 AHBPCI_WIN1_CTR
0x10814 AHBPCI_WIN2_CTR
0x10820 PCI_INT_ENABLE
0x10824 PCI_INT_STATUS
0x10830 AHB_BUS_CTR
0x10834 USBCTR
0x10840 PCI_ARBITER_CTR
0x10848 PCI_UNIT_REV ro
