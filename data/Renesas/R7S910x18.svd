# R7S910x18 register map
Vendor: Renesas Electronics Corporation; Series: RZT; File version: 1.0
CPU: other r1p4, little endian, MPU, FPU, vendor SysTick, 1 interrupt priority bits
Registers are 32-bit, read-write, no defined reset value unless marked. A register's access mark holds for its fields unless they carry their own. Offsets are from the block's base; [hi:lo] are bit positions; {n}, {i} and the like mark numbered series.

## ECATC — EtherCAT slave controller
Base 0xA00D0000; register names take the prefix ECATC_
0x00 TYPE 8-bit ro
0x01 REVISION 8-bit ro
0x02 BUILD 16-bit ro
0x04 FMMU_NUM 8-bit ro — FMMUs supported
0x05 SYNC_MANAGER 8-bit ro — SyncManagers supported
0x06 RAM_SIZE 8-bit ro
0x07 PORT_DESC 8-bit ro — Port Descriptor
0x08 FEATURE 16-bit ro — ESC Features supported
0x10 STATION_ADR 16-bit ro — Configured Station Address
0x12 STATION_ALIAS 16-bit — Configured Station Alias
0x20 WR_REG_ENABLE 8-bit ro — Write Register Enable
0x21 WR_REG_PROTECT 8-bit ro — Write Register Protection
0x30 ESC_WR_ENABLE 8-bit ro — ESC Write Enable
0x31 ESC_WR_PROTECT 8-bit ro — ESC Write Protection
0x40 ESC_RESET_ECAT_W 8-bit — ESC Reset ECAT
0x40 ESC_RESET_ECAT_R 8-bit ro (alternate view of ESC_RESET_ECAT_W) — ESC Reset ECAT
0x41 ESC_RESET_PDI_W 8-bit — ESC Reset PDI
0x41 ESC_RESET_PDI_R 8-bit ro (alternate view of ESC_RESET_PDI_W) — ESC Reset PDI
0x100 ESC_DL_CONTROL ro
0x108 PHYSICAL_RW_OFFSET 16-bit ro — Physical Read/Write Offset
0x110 ESC_DL_STATUS 16-bit
0x120 AL_CONTROL 16-bit
0x130 AL_STATUS 16-bit
0x134 AL_STATUS_CODE 16-bit
0x138 RUN_LED_OVERRIDE 8-bit
0x139 ERR_LED_OVERRIDE 8-bit
0x140 PDI_CONTROL 8-bit ro
0x141 ESC_CONFIG 8-bit ro — ESC Configuration
0x150 PDI_CONFIG 8-bit ro — PDI Configuration
0x151 SYNC_LATCH_CONFIG 8-bit ro — SYNC/LATCH PDI Configuration
0x152 EXT_PDI_CONFIG 16-bit ro — Extended PDI Configuration
0x200 ECAT_EVENT_MASK 16-bit ro
0x204 AL_EVENT_MASK
0x210 ECAT_EVENT_REQ 16-bit ro — ECAT Event Request
0x220 AL_EVENT_REQ ro — AL Event Request
0x300 RX_ERR_COUNT0 16-bit ro — Rx Error Counter 0
0x302 RX_ERR_COUNT1 16-bit ro — Rx Error Counter 1
0x308 FWD_RX_ERR_COUNT0 8-bit ro — Forwarded Rx Error counter 0
0x309 FWD_RX_ERR_COUNT1 8-bit ro — Forwarded Rx Error counter 1
0x30C ECAT_PROC_ERR_COUNT 8-bit ro — ECAT Processing Unit Error Counter
0x30D PDI_ERR_COUNT 8-bit ro — PDI Error Counter
0x310 LOST_LINK_COUNT0 8-bit ro — Lost Link Counter 0
0x311 LOST_LINK_COUNT1 8-bit ro — Lost Link Counter 1
0x400 WD_DIVIDE 16-bit ro — Watchdog Divider
0x410 WDT_PDI 16-bit ro — Watchdog Time PDI
0x420 WDT_DATA 16-bit ro — Watchdog Time Process Data
0x440 WDS_DATA 16-bit ro — Watchdog Status Process Data
0x442 WDC_DATA 8-bit ro — Watchdog Counter Process Data
0x443 WDC_PDI 8-bit ro — Watchdog Counter PDI
0x500 EEP_CONF 8-bit ro — EEPROM Configuration
0x501 EEP_STATE 8-bit — EEPROM PDI Access State
0x502 EEP_CONT_STAT 16-bit — EEPROM Control/Status
0x504 EEP_ADR — EEPROM Address
0x508 EEP_DATA — EEPROM Data
0x510 MII_CONT_STAT 16-bit — MII Management Control/Status
0x512 PHY_ADR 8-bit — PHY Address
0x513 PHY_REG_ADR 8-bit — PHY Register Address
0x514 PHY_DATA 16-bit
0x516 MII_ECAT_ACS_STAT 8-bit ro — MII Management ECAT Access State
0x517 MII_PDI_ACS_STAT 8-bit — MII Management PDI Access State
0x518 PHY_STATUS0 8-bit — PHY Port Status 0
0x519 PHY_STATUS1 8-bit — PHY Port Status 1
{0x600+0x10*i} FMMU{i}_L_START_ADR ro (i=0..7) — FMMU Logical Start Address {i}
{0x604+0x10*i} FMMU{i}_LEN 16-bit ro (i=0..7) — FMMU Length {i}
{0x606+0x10*i} FMMU{i}_L_START_BIT 8-bit ro (i=0..7) — FMMU Logical Start bit {i}
{0x607+0x10*i} FMMU{i}_L_STOP_BIT 8-bit ro (i=0..7) — FMMU Logical Stop bit {i}
{0x608+0x10*i} FMMU{i}_P_START_ADR 16-bit ro (i=0..7) — FMMU Physical Start Address {i}
{0x60A+0x10*i} FMMU{i}_P_START_BIT 8-bit ro (i=0..7) — FMMU Physical Start bit {i}
{0x60B+0x10*i} FMMU{i}_TYPE 8-bit ro (i=0..7) — FMMU Type {i}
{0x60C+0x10*i} FMMU{i}_ACT 8-bit ro (i=0..7) — FMMU Activate {i}
{0x800+8i} SM{i}_P_START_ADR 16-bit ro (i=0..7) — SyncManager Physical Start Address {i}
{0x802+8i} SM{i}_LEN 16-bit ro (i=0..7) — SyncManager Length {i}
{0x804+8i} SM{i}_CONTROL 8-bit ro (i=0..7) — SyncManager Control {i}
{0x805+8i} SM{i}_STATUS 8-bit ro (i=0..7) — SyncManager Status {i}
{0x806+8i} SM{i}_ACT 8-bit ro (i=0..7) — SyncManager Activate {i}
{0x807+8i} SM{i}_PDI_CONT 8-bit (i=0..7) — SyncManager PDI Control {i}
0x900 DC_RCV_TIME_PORT0 ro — Receive Times Port0
0x904 DC_RCV_TIME_PORT1 ro — Receive Times Port1
0x910 DC_SYS_TIME 64-bit ro — System Time
0x918 DC_RCV_TIME_UNIT 64-bit ro — Receive Time ECAT Processing Unit
0x920 DC_SYS_TIME_OFFSET 64-bit ro — System Time Offset
0x928 DC_SYS_TIME_DELAY ro — System Time Delay
0x92C DC_SYS_TIME_DIFF ro — System Time Difference
0x930 DC_SPEED_COUNT_START 16-bit ro — Speed Counter Start
0x932 DC_SPEED_COUNT_DIFF 16-bit ro — Speed Counter Diff
0x934 DC_SYS_TIME_DIFF_FIL_DEPTH 8-bit ro — System Time Difference Filter Depth
0x935 DC_SPEED_COUNT_FIL_DEPTH 8-bit ro — Speed Counter Filter Depth
0x980 DC_CYC_CONT 8-bit ro — Cyclic Unit Control
0x981 DC_ACT 8-bit — Activation
0x982 DC_PULSE_LEN 16-bit ro — Pulse Length of SyncSignals
0x984 DC_ACT_STAT 8-bit ro — Activation Status
0x98E DC_SYNC0_STAT 8-bit ro — SYNC0 Status
0x98F DC_SYNC1_STAT 8-bit ro — SYNC1 Status
0x990 DC_CYC_START_TIME 64-bit — Start Time Cyclic Operation / Next SYNC0 Pulse
0x998 DC_NEXT_SYNC1_PULSE 64-bit ro — Next SYNC1 Pulse
0x9A0 DC_SYNC0_CYC_TIME — SYNC0 Cycle Time
0x9A4 DC_SYNC1_CYC_TIME — SYNC1 Cycle Time
0x9A8 DC_LATCH0_CONT 8-bit — Latch0 Control
0x9A9 DC_LATCH1_CONT 8-bit — Latch1 Control
0x9AE DC_LATCH0_STAT 8-bit ro — Latch0 Status
0x9AF DC_LATCH1_STAT 8-bit ro — Latch1 Status
0x9B0 DC_LATCH0_TIME_POS 64-bit ro — Latch0 Time Positive Edge
0x9B8 DC_LATCH0_TIME_NEG 64-bit ro — Latch0 Time Negative Edge
0x9C0 DC_LATCH1_TIME_POS 64-bit ro — Latch1 Time Positive Edge
0x9C8 DC_LATCH1_TIME_NEG 64-bit ro — Latch1 Time Negative Edge
0x9F0 DC_ECAT_CNG_EV_TIME ro — Buffer Change Event Time
0x9F8 DC_PDI_START_EV_TIME ro — PDI Buffer Start Event Time
0x9FC DC_PDI_CNG_EV_TIME ro — PDI Buffer Change Event Time
0xE00 PRODUCT_ID 64-bit ro
0xE08 VENDOR_ID 64-bit ro — Vender ID
