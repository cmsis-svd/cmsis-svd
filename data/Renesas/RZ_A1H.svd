# RZA1H register map
File version: 1.00
Registers are 32-bit, read-write, no defined reset value unless marked. A register's access mark holds for its fields unless they carry their own. Offsets are from the block's base; [hi:lo] are bit positions; {n}, {i} and the like mark numbered series.

## SDG0
Base 0xFCFF4800
0x00 SGCR1_0 8-bit
0x01 SGCSR_0 8-bit
0x02 SGCR2_0 8-bit
0x03 SGLR_0 8-bit
0x04 SGTFR_0 8-bit
0x05 SGSFR_0 8-bit

## SDG1
Base 0xFCFF4A00
0x00 SGCR1_1 8-bit
0x01 SGCSR_1 8-bit
0x02 SGCR2_1 8-bit
0x03 SGLR_1 8-bit
0x04 SGTFR_1 8-bit
0x05 SGSFR_1 8-bit

## SDG2
Base 0xFCFF4C00
0x00 SGCR1_2 8-bit
0x01 SGCSR_2 8-bit
0x02 SGCR2_2 8-bit
0x03 SGLR_2 8-bit
0x04 SGTFR_2 8-bit
0x05 SGSFR_2 8-bit

## SDG3
Base 0xFCFF4E00
0x00 SGCR1_3 8-bit
0x01 SGCSR_3 8-bit
0x02 SGCR2_3 8-bit
0x03 SGLR_3 8-bit
0x04 SGTFR_3 8-bit
0x05 SGSFR_3 8-bit

## SPDIF
Base 0xE8012000
0x00 TLCA
0x04 TRCA
0x08 TLCS
0x0C TRCS
0x10 TUI
0x14 RLCA
0x18 RRCA
0x1C RLCS
0x20 RRCS
0x24 RUI
0x28 CTRL
0x2C STAT
0x30 TDAD
0x34 RDAD

## SPIBSC0
Base 0x3FEFA000
0x00 CMNCR_0
0x04 SSLDR_0
0x08 SPBCR_0
0x0C DRCR_0
0x10 DRCMR_0
0x14 DREAR_0
0x18 DROPR_0
0x1C DRENR_0
0x20 SMCR_0
0x24 SMCMR_0
0x28 SMADR_0
0x2C SMOPR_0
0x30 SMENR_0
0x38 SMRDR0_0
0x3C SMRDR1_0
0x40 SMWDR0_0
0x44 SMWDR1_0
0x48 CMNSR_0
0x58 DRDMCR_0
0x5C DRDRENR_0
0x60 SMDMCR_0
0x64 SMDRENR_0

## SPIBSC1
Base 0x3FEFB000
0x00 CMNCR_1
0x04 SSLDR_1
0x08 SPBCR_1
0x0C DRCR_1
0x10 DRCMR_1
0x14 DREAR_1
0x18 DROPR_1
0x1C DRENR_1
0x20 SMCR_1
0x24 SMCMR_1
0x28 SMADR_1
0x2C SMOPR_1
0x30 SMENR_1
0x38 SMRDR0_1
0x3C SMRDR1_1
0x40 SMWDR0_1
0x44 SMWDR1_1
0x48 CMNSR_1
0x58 DRDMCR_1
0x5C DRDRENR_1
0x60 SMDMCR_1
0x64 SMDRENR_1

## SSIF0
Base 0xE820B000
0x00 SSICR_0
0x04 SSISR_0
0x10 SSIFCR_0
0x14 SSIFSR_0
0x18 SSIFTDR_0
0x1C SSIFRDR_0
0x20 SSITDMR_0
0x24 SSIFCCR_0
0x28 SSIFCMR_0
0x2C SSIFCSR_0

## SSIF1
Base 0xE820B800
0x00 SSICR_1
0x04 SSISR_1
0x10 SSIFCR_1
0x14 SSIFSR_1
0x18 SSIFTDR_1
0x1C SSIFRDR_1
0x20 SSITDMR_1
0x24 SSIFCCR_1
0x28 SSIFCMR_1
0x2C SSIFCSR_1

## SSIF2
Base 0xE820C000
0x00 SSICR_2
0x04 SSISR_2
0x10 SSIFCR_2
0x14 SSIFSR_2
0x18 SSIFTDR_2
0x1C SSIFRDR_2
0x20 SSITDMR_2
0x24 SSIFCCR_2
0x28 SSIFCMR_2
0x2C SSIFCSR_2

## SSIF3
Base 0xE820C800
0x00 SSICR_3
0x04 SSISR_3
0x10 SSIFCR_3
0x14 SSIFSR_3
0x18 SSIFTDR_3
0x1C SSIFRDR_3
0x20 SSITDMR_3
0x24 SSIFCCR_3
0x28 SSIFCMR_3
0x2C SSIFCSR_3

## SSIF4
Base 0xE820D000
0x00 SSICR_4
0x04 SSISR_4
0x10 SSIFCR_4
0x14 SSIFSR_4
0x18 SSIFTDR_4
0x1C SSIFRDR_4
0x20 SSITDMR_4
0x24 SSIFCCR_4
0x28 SSIFCMR_4
0x2C SSIFCSR_4

## SSIF5
Base 0xE820D800
0x00 SSICR_5
0x04 SSISR_5
0x10 SSIFCR_5
0x14 SSIFSR_5
0x18 SSIFTDR_5
0x1C SSIFRDR_5
0x20 SSITDMR_5
0x24 SSIFCCR_5
0x28 SSIFCMR_5
0x2C SSIFCSR_5

## UAHV
Base 0xE8030000
0x00 URTH0CTL0 8-bit
0x04 URTH0OPT1 8-bit
0x08 URTH0OPT2 16-bit
0x0C URTH0TRG 8-bit
0x10 URTH0STR0 8-bit
0x14 URTH0STR1 8-bit
0x18 URTH0STC 8-bit
0x1C URTH0RX 8-bit
0x20 URTH0RXHL 16-bit
0x24 URTH0ERX 8-bit
0x28 URTH0ERXW
0x2C URTH0TX 8-bit
0x30 URTH0TXHL 16-bit
0x34 URTH0ETX 8-bit
0x38 URTH0ETXW
0x40 URTH0CTL1 16-bit
0x44 URTH0CTL2 16-bit
0x48 URTH0OPT0 16-bit

## USB200
Base 0xE8010000
0x00 SYSCFG0_0 16-bit
0x02 BUSWAIT_0 16-bit
0x04 SYSSTS0_0 16-bit
0x08 DVSTCTR0_0 16-bit
0x0C TESTMODE_0 16-bit
0x10 D0FBCFG_0 16-bit
0x12 D1FBCFG_0 16-bit
0x14 CFIFO_0
0x18 D0FIFO_0
0x1C D1FIFO_0
0x20 CFIFOSEL_0 16-bit
0x22 CFIFOCTR_0 16-bit
0x28 D0FIFOSEL_0 16-bit
0x2A D0FIFOCTR_0 16-bit
0x2C D1FIFOSEL_0 16-bit
0x2E D1FIFOCTR_0 16-bit
0x30 INTENB0_0 16-bit
0x32 INTENB1_0 16-bit
0x36 BRDYENB_0 16-bit
0x38 NRDYENB_0 16-bit
0x3A BEMPENB_0 16-bit
0x3C SOFCFG_0 16-bit
0x40 INTSTS0_0 16-bit
0x42 INTSTS1_0 16-bit
0x46 BRDYSTS_0 16-bit
0x48 NRDYSTS_0 16-bit
0x4A BEMPSTS_0 16-bit
0x4C FRMNUM_0 16-bit
0x4E UFRMNUM_0 16-bit
0x50 USBADDR_0 16-bit
0x54 USBREQ_0 16-bit
0x56 USBVAL_0 16-bit
0x58 USBINDX_0 16-bit
0x5A USBLENG_0 16-bit
0x5C DCPCFG_0 16-bit
0x5E DCPMAXP_0 16-bit
0x60 DCPCTR_0 16-bit
0x64 PIPESEL_0 16-bit
0x68 PIPECFG_0 16-bit
0x6A PIPEBUF_0 16-bit
0x6C PIPEMAXP_0 16-bit
0x6E PIPEPERI_0 16-bit
{0x6E+2i} PIPE{i}CTR_0 16-bit (i=1..9)
0x82 PIPEACTR_0 16-bit
0x84 PIPEBCTR_0 16-bit
0x86 PIPECCTR_0 16-bit
0x88 PIPEDCTR_0 16-bit
0x8A PIPEECTR_0 16-bit
0x8C PIPEFCTR_0 16-bit
{0x8C+4i} PIPE{i}TRE_0 16-bit (i=1..5)
{0x8E+4i} PIPE{i}TRN_0 16-bit (i=1..5)
0xA4 PIPEBTRE_0 16-bit
0xA6 PIPEBTRN_0 16-bit
0xA8 PIPECTRE_0 16-bit
0xAA PIPECTRN_0 16-bit
0xAC PIPEDTRE_0 16-bit
0xAE PIPEDTRN_0 16-bit
0xB0 PIPEETRE_0 16-bit
0xB2 PIPEETRN_0 16-bit
0xB4 PIPEFTRE_0 16-bit
0xB6 PIPEFTRN_0 16-bit
0xB8 PIPE9TRE_0 16-bit
0xBA PIPE9TRN_0 16-bit
0xBC PIPEATRE_0 16-bit
0xBE PIPEATRN_0 16-bit
{0xD0+2i} DEVADD{i}_0 16-bit (i=0..9)
0xE4 DEVADDA_0 16-bit
0x102 SUSPMODE_0 16-bit
{0x160+4i} D0FIFOB{i}_0 (i=0..7)
{0x180+4i} D1FIFOB{i}_0 (i=0..7)

## USB201
Base 0xE8207000
0x00 SYSCFG0_1 16-bit
0x02 BUSWAIT_1 16-bit
0x04 SYSSTS0_1 16-bit
0x08 DVSTCTR0_1 16-bit
0x0C TESTMODE_1 16-bit
0x10 D0FBCFG_1 16-bit
0x12 D1FBCFG_1 16-bit
0x14 CFIFO_1
0x18 D0FIFO_1
0x1C D1FIFO_1
0x20 CFIFOSEL_1 16-bit
0x22 CFIFOCTR_1 16-bit
0x28 D0FIFOSEL_1 16-bit
0x2A D0FIFOCTR_1 16-bit
0x2C D1FIFOSEL_1 16-bit
0x2E D1FIFOCTR_1 16-bit
0x30 INTENB0_1 16-bit
0x32 INTENB1_1 16-bit
0x36 BRDYENB_1 16-bit
0x38 NRDYENB_1 16-bit
0x3A BEMPENB_1 16-bit
0x3C SOFCFG_1 16-bit
0x40 INTSTS0_1 16-bit
0x42 INTSTS1_1 16-bit
0x46 BRDYSTS_1 16-bit
0x48 NRDYSTS_1 16-bit
0x4A BEMPSTS_1 16-bit
0x4C FRMNUM_1 16-bit
0x4E UFRMNUM_1 16-bit
0x50 USBADDR_1 16-bit
0x54 USBREQ_1 16-bit
0x56 USBVAL_1 16-bit
0x58 USBINDX_1 16-bit
0x5A USBLENG_1 16-bit
0x5C DCPCFG_1 16-bit
0x5E DCPMAXP_1 16-bit
0x60 DCPCTR_1 16-bit
0x64 PIPESEL_1 16-bit
0x68 PIPECFG_1 16-bit
0x6A PIPEBUF_1 16-bit
0x6C PIPEMAXP_1 16-bit
0x6E PIPEPERI_1 16-bit
{0x6E+2i} PIPE{i}CTR_1 16-bit (i=1..9)
0x82 PIPEACTR_1 16-bit
0x84 PIPEBCTR_1 16-bit
0x86 PIPECCTR_1 16-bit
0x88 PIPEDCTR_1 16-bit
0x8A PIPEECTR_1 16-bit
0x8C PIPEFCTR_1 16-bit
{0x8C+4i} PIPE{i}TRE_1 16-bit (i=1..5)
{0x8E+4i} PIPE{i}TRN_1 16-bit (i=1..5)
0xA4 PIPEBTRE_1 16-bit
0xA6 PIPEBTRN_1 16-bit
0xA8 PIPECTRE_1 16-bit
0xAA PIPECTRN_1 16-bit
0xAC PIPEDTRE_1 16-bit
0xAE PIPEDTRN_1 16-bit
0xB0 PIPEETRE_1 16-bit
0xB2 PIPEETRN_1 16-bit
0xB4 PIPEFTRE_1 16-bit
0xB6 PIPEFTRN_1 16-bit
0xB8 PIPE9TRE_1 16-bit
0xBA PIPE9TRN_1 16-bit
0xBC PIPEATRE_1 16-bit
0xBE PIPEATRN_1 16-bit
{0xD0+2i} DEVADD{i}_1 16-bit (i=0..9)
0xE4 DEVADDA_1 16-bit
0x102 SUSPMODE_1 16-bit
{0x160+4i} D0FIFOB{i}_1 (i=0..7)
{0x180+4i} D1FIFOB{i}_1 (i=0..7)

## WDT
Base 0xFCFE0000
0x00 WTCSR 16-bit
0x02 WTCNT 16-bit
0x04 WRCSR 16-bit
