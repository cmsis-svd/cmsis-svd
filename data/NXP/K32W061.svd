# K32W061 register map
Vendor: nxp.com; File version: 1.0
K32W041HN,K32W061HN
CPU: CM4 r0p1, little endian, MPU, no FPU, VTOR, 3 interrupt priority bits
Registers are 32-bit, read-write, reset 0x0 unless marked. A register's access mark holds for its fields unless they carry their own. Offsets are from the block's base; lines under a group give offsets from that group; [hi:lo] are bit positions; {n}, {i} and the like mark numbered series; 'fields as' and 'values as' point back to an identical list; <NAME> marks a mode.

## Memory map
0x40000000 SYSCON size 0xFF4 — This is the description of component syscon. It is the System Control APB bus interface. More details will follow.
0x40002000 OTPC size 0x18 — This is the description of component otpc It is an eFUSE OTP (One Time Programmable memory) controller with APB bus interface. More details will follow.
0x40003000 I2C0 size 0x1000 — This is the description of component i2c It is an Inter IC with APB bus interface. More details will follow.
0x40003000 FLEXCOMM2 size 0x1000 — LPC5411x Flexcomm serial communication
0x40004000 I2C1 size 0x1000 — This is the description of component i2c It is an Inter IC with APB bus interface. More details will follow.
0x40004000 FLEXCOMM3 size 0x1000 — LPC5411x Flexcomm serial communication
0x40005000 I2C2 size 0x1000 — This is the description of component i2c It is an Inter IC with APB bus interface. More details will follow.
0x40005000 FLEXCOMM6 size 0x1000 — LPC5411x Flexcomm serial communication
0x40006000 ISO7816 size 0x6C — This is the description of component iso7816 It is an ISO7816 controller with APB bus interface. More details will follow.
0x40007000 CIC_IRB size 0x1000 — This is the description of component cic_irb. It is an Infra Red Blaster Controller with a VPB bus interface. More details will follow.
0x40009000 FLASH size 0x1000 — This is the description of component input mux. . More details will follow.
0x4000A000 WWDT size 0x1C — This is the description of component wwdt It is an Windowed Watchdog Timer with APB bus interface. More details will follow.
0x4000B000 RTC size 0x10 — This is the description of component rtc It is Real Time Clock with APB bus interface. More details will follow.
0x4000C000 PWM size 0x1000 — This is the description of component pwm. It is a Pulse Width Modulation Controller with an APB bus interface. More details will follow.
0x4000D000 RNG size 0x1000 — This is the description of component rng. It is an Universal Synchrnous/Asynchrnous Receiver/Transmitter with APB bus interface. More details will follow.
0x4000E000 INPUTMUX size 0x188 — This is the description of component input mux. . More details will follow.
0x4000F000 IOCON size 0x58 — This is the description of component input mux. . More details will follow.
0x40010000 PINT size 0x34 — This is the description of component pint It is a Pin Interrupt & Pattern matching module with APB bus interface. More details will follow.
0x40011000 GINT0 size 0x44 — This is the description of component gint It is an Global Interrupt with APB bus interface. More details will follow.
0x40012000 PMC size 0xD0 — This is the description of component pmc. It is the Power Management Unit Controller. More details will follow.
0x40014000 BLE_DP_TOP size 0xB4 — This is the description of component ble_dp_top. It is Bluetooth Low Energy Data Path module APB bus interface. More details will follow.
0x40020000 ASYNC_SYSCON size 0xD0 — This is the description of component async_syscon
0x40021000 CTIMER0 size 0x78 — This is the description of component ct32b It is standard 32-bit Counter/Timer with APB bus interface. More details will follow.
0x40022000 CTIMER1 size 0x78 — This is the description of component ct32b It is standard 32-bit Counter/Timer with APB bus interface. More details will follow.
0x40080000 GPIO size 0x2484 — This is the description of component gpio It is General Purpose I/O with APB bus interface. More details will follow.
0x40084000 SPIFI size 0x20 — This is the description of component spifi It is General Purpose I/O with APB bus interface. More details will follow.
0x40085000 DMA0 size 0x530 — dma
0x40086000 AES0 size 0xA0 — This is the description of component aes256 It is AES 128-192-256 with GCM mode. More details will follow.
0x40089000 ADC0 size 0x78 — This is the description of component adc It is General Purpose ADC. More details will follow.
0x4008A000 DMIC0 size 0x1000 — This is the description of component dmic It is General Purpose I/O with APB bus interface. More details will follow.
0x4008B000 FLEXCOMM0 size 0x1000 — LPC5411x Flexcomm serial communication
0x4008B000 USART0 size 0x1000 — This is the description of component usart. It is an Universal Synchrnous/Asynchrnous Receiver/Transmitter with APB bus interface. More details will follow.
0x4008C000 FLEXCOMM1 size 0x1000 — LPC5411x Flexcomm serial communication
0x4008C000 USART1 size 0x1000 — This is the description of component usart. It is an Universal Synchrnous/Asynchrnous Receiver/Transmitter with APB bus interface. More details will follow.
0x4008D000 FLEXCOMM4 size 0x1000 — LPC5411x Flexcomm serial communication
0x4008D000 SPI0 size 0x1000 — This is the description of component spi. It is a Serial Peripheral Interface with APB bus interface. More details will follow.
0x4008E000 FLEXCOMM5 size 0x1000 — LPC5411x Flexcomm serial communication
0x4008E000 SPI1 size 0x1000 — This is the description of component spi. It is a Serial Peripheral Interface with APB bus interface. More details will follow.
0x4008F000 SHA0 size 0x1000 — This is the description of component hash It is AES 128-192-256 with GCM mode. More details will follow.

## Interrupts
0 WDT_BOD (WWDT)
1 DMA0
2 GINT0
3 CIC_IRB
4 PIN_INT0 (PINT)
5 PIN_INT1 (PINT)
6 PIN_INT2 (PINT)
7 PIN_INT3 (PINT)
9 CTIMER0
10 CTIMER1
11 FLEXCOMM0 (FLEXCOMM0, USART0)
12 FLEXCOMM1 (FLEXCOMM1, USART1)
13 FLEXCOMM2 (I2C0, FLEXCOMM2)
14 FLEXCOMM3 (I2C1, FLEXCOMM3)
15 FLEXCOMM4 (FLEXCOMM4, SPI0)
16 FLEXCOMM5 (FLEXCOMM5, SPI1)
{n+17} PWM{n} (PWM) (n=0..10)
28 FLEXCOMM6 (I2C2, FLEXCOMM6)
29 RTC
32 ADC0_SEQA (ADC0)
33 ADC0_SEQB (ADC0)
34 ADC0_THCMP (ADC0)
35 DMIC0
36 HWVAD0 (DMIC0)
46 ISO7816
55 SHA (SHA0)

## Licence text in the file
Copyright 2016-2020 NXP All rights reserved. SPDX-License-Identifier: BSD-3-Clause
