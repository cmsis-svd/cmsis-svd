# NUC1263AE register map
File version: 1.0
NUC1263AE SVD file
Registers are 32-bit, read-write, reset 0x0 unless marked. A register's access mark holds for its fields unless they carry their own. Offsets are from the block's base; lines under a group give offsets from that group; [hi:lo] are bit positions; {n}, {i} and the like mark numbered series; 'fields as' and 'values as' point back to an identical list; <NAME> marks a mode.

## Memory map
0x40004000 WDT size 0xC — WDT Register Map
0x40004100 WWDT size 0x10 — WWDT Register Map
0x40010000 TMR01 blocks up to offset 0x3C — TIMER Register Map
0x40020000 I2C0 blocks up to offset 0x6C — I2C Register Map
0x40024000 I2C2 blocks up to offset 0x6C — I2C Register Map
0x40030000 SPI0 blocks up to offset 0x6C — SPI Register Map
0x40040000 BPWM0 blocks up to offset 0x334 — BPWM Register Map
0x40044000 BPWM2 blocks up to offset 0x334 — BPWM Register Map
0x40050000 UART0 blocks up to offset 0x4C — UART Register Map
0x40054000 LLSI0 size 0x24 — LLSI Register Map
0x40054200 LLSI2 size 0x24 — LLSI Register Map
0x40054400 LLSI4 size 0x24 — LLSI Register Map
0x40060000 USBD blocks up to offset 0x5C0 — USBD Register Map
0x40070000 I3CS0 blocks up to offset 0xDC — I3CS Register Map
0x40080000 UART2 blocks up to offset 0x4C — UART Register Map
0x400B0000 SPI1 blocks up to offset 0x6C — SPI Register Map
0x400D0000 ACMP01 size 0x18 — ACMP Register Map
0x400E0000 ADC blocks up to offset 0x104 — ADC Register Map
0x400F0000 DAC0 size 0x18 — DAC Register Map
0x400F0040 DAC1 size 0x18 — DAC Register Map
0x400F0080 DAC2 size 0x18 — DAC Register Map
0x400F00C0 DAC3 size 0x18 — DAC Register Map
0x40110000 TMR23 blocks up to offset 0x3C — TIMER Register Map
0x40120000 I2C1 blocks up to offset 0x6C — I2C Register Map
0x40130000 SPI2 blocks up to offset 0x6C — SPI Register Map
0x40140000 BPWM1 blocks up to offset 0x334 — BPWM Register Map
0x40144000 BPWM3 blocks up to offset 0x334 — BPWM Register Map
0x40150000 UART1 blocks up to offset 0x4C — UART Register Map
0x40154000 LLSI1 size 0x24 — LLSI Register Map
0x40154200 LLSI3 size 0x24 — LLSI Register Map
0x40154400 LLSI5 size 0x24 — LLSI Register Map
0x40170000 I3CS1 blocks up to offset 0xDC — I3CS Register Map
0x401D0000 ACMP23 size 0x18 — ACMP Register Map
0x50000000 SYS blocks up to offset 0x164 — SYS Register Map
0x50000200 CLK blocks up to offset 0x80 — CLK Register Map
0x50000300 NMI size 0x8 — NMI Register Map
0x50004000 GPIO blocks up to offset 0x380 — GPIO Register Map
0x50008000 PDMA blocks up to offset 0x48C — PDMA Register Map
0x5000C000 FMC blocks up to offset 0xC8 — FMC Register Map
0x50018000 CRC size 0x10 — CRC Register Map
0xE000E000 SCS blocks up to offset 0xD24 — SYST_SCS Register Map
0xE000E100 NVIC blocks up to offset 0x208 — NVIC Register Map

## NVIC — NVIC Register Map
Base 0xE000E100
0x00 NVIC_ISER0 — IRQ0 ~ IRQ31 Set-enable Control Register
  [31:0] SETENA — Interrupt Set Enable Bit. The NVIC_ISER0-NVIC_ISER1 registers enable interrupts, and show which interrupts are enabled. Write Operation:
    0=No effect. Interrupt Disabled; 1=Interrupt Enabled
0x04 NVIC_ISER1 — IRQ32 ~ IRQ49 Set-enable Control Register
  fields as NVIC_ISER0
0x80 NVIC_ICER0 — IRQ0 ~ IRQ31 Clear-enable Control Register
  [31:0] CALENA — Interrupt Clear Enable Bit. The NVIC_ICER0-NVIC_ICER1 registers disable interrupts, and show which interrupts are enabled. Write Operation:
    0=No effect. Interrupt Disabled; 1=Interrupt Disabled. Interrupt Enabled
0x84 NVIC_ICER1 — IRQ32 ~ IRQ49 Clear-enable Control Register
  [31:0] CALENA — Interrupt Clear Enable Bit. The NVIC_ICER0-NVIC_ICER2 registers disable interrupts, and show which interrupts are enabled. Write Operation:
    values as NVIC_ICER0.CALENA
0x100 NVIC_ISPR0 — IRQ0 ~ IRQ31 Set-pending Control Register
  [31:0] SETPEND — Interrupt Set-pending. The NVIC_ISPR0-NVIC_ISPR1 registers force interrupts into the pending state, and show which interrupts are pending. Write Operation:
    0=No effect. Interrupt is not pending; 1=Changes interrupt state to pending. Interrupt is pending
0x104 NVIC_ISPR1 — IRQ32 ~ IRQ49 Set-pending Control Register
  fields as NVIC_ISPR0
0x180 NVIC_ICPR0 — IRQ0 ~ IRQ31 Clear-pending Control Register
  [31:0] CALPEND — Interrupt Clear-pending. The NVIC_ICPR0-NVIC_ICPR1 registers remove the pending state from interrupts, and show which interrupts are pending. Write Operation:
    0=No effect. Interrupt is not pending; 1=Removes pending state an interrupt. Interrupt is pending
0x184 NVIC_ICPR1 — IRQ32 ~ IRQ49 Clear-pending Control Register
  fields as NVIC_ICPR0
0x200 NVIC_IABR0 — IRQ0 ~ IRQ31 Active Bit Register
  [31:0] ACTIVE — Interrupt Active Flags. The NVIC_IABR0-NVIC_IABR1 registers indicate which interrupts are active.
    0=interrupt not active; 1=interrupt active
0x204 NVIC_IABR1 — IRQ32 ~ IRQ49 Active Bit Register
  fields as NVIC_IABR0
