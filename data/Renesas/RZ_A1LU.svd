# RZ_A1LU register map
Vendor: Renesas Electronics Corporation.; Series: RZ; File version: 3
CPU: other r3p0, little endian, MPU, no FPU, 3 interrupt priority bits
Registers are 32-bit, read-write, no defined reset value unless marked. A register's access mark holds for its fields unless they carry their own. Offsets are from the block's base; [hi:lo] are bit positions; {n}, {i} and the like mark numbered series.

## SSIF0
Base 0xE820B000
0x00 SSICR_0
0x04 SSISR_0
0x10 SSIFCR_0
0x14 SSIFSR_0
0x18 SSIFTDR_0
0x1C SSIFRDR_0
0x20 SSITDMR_0
0x24 SSIFCCR_0
0x28 SSIFCMR_0
0x2C SSIFCSR_0

## SSIF1
Base 0xE820B800
0x00 SSICR_1
0x04 SSISR_1
0x10 SSIFCR_1
0x14 SSIFSR_1
0x18 SSIFTDR_1
0x1C SSIFRDR_1
0x20 SSITDMR_1
0x24 SSIFCCR_1
0x28 SSIFCMR_1
0x2C SSIFCSR_1

## SSIF2
Base 0xE820C000
0x00 SSICR_2
0x04 SSISR_2
0x10 SSIFCR_2
0x14 SSIFSR_2
0x18 SSIFTDR_2
0x1C SSIFRDR_2
0x20 SSITDMR_2
0x24 SSIFCCR_2
0x28 SSIFCMR_2
0x2C SSIFCSR_2

## SSIF3
Base 0xE820C800
0x00 SSICR_3
0x04 SSISR_3
0x10 SSIFCR_3
0x14 SSIFSR_3
0x18 SSIFTDR_3
0x1C SSIFRDR_3
0x20 SSITDMR_3
0x24 SSIFCCR_3
0x28 SSIFCMR_3
0x2C SSIFCSR_3

## CEU
Base 0xE8210000
0x00 CAPSR
0x04 CAPCR
0x08 CAMCR
0x0C CMCYR
0x10 CAMOR_A
0x14 CAPWR_A
0x18 CAIFR
0x28 CRCNTR
0x2C CRCMPR
0x30 CFLCR_A
0x34 CFSZR_A
0x38 CDWDR_A
0x3C CDAYR_A
0x40 CDACR_A
0x44 CDBYR_A
0x48 CDBCR_A
0x4C CBDSR_A
0x5C CFWCR
0x60 CLFCR_A
0x64 CDOCR_A
0x70 CEIER
0x74 CETCR
0x7C CSTSR
0x84 CDSSR
0x90 CDAYR2_A
0x94 CDACR2_A
0x98 CDBYR2_A
0x9C CDBCR2_A
0x1010 CAMOR_B
0x1014 CAPWR_B
0x1030 CFLCR_B
0x1034 CFSZR_B
0x1038 CDWDR_B
0x103C CDAYR_B
0x1040 CDACR_B
0x1044 CDBYR_B
0x1048 CDBCR_B
0x104C CBDSR_B
0x1060 CLFCR_B
0x1064 CDOCR_B
0x1090 CDAYR2_B
0x1094 CDACR2_B
0x1098 CDBYR2_B
0x109C CDBCR2_B
0x2010 CAMOR_M
0x2014 CAPWR_M
0x2030 CFLCR_M
0x2034 CFSZR_M
0x2038 CDWDR_M
0x203C CDAYR_M
0x2040 CDACR_M
0x2044 CDBYR_M
0x2048 CDBCR_M
0x204C CBDSR_M
0x2060 CLFCR_M
0x2064 CDOCR_M
0x2090 CDAYR2_M
0x2094 CDACR2_M
0x2098 CDBYR2_M
0x209C CDBCR2_M

## ETHAVB
Base 0xE8215000
0x00 CCC
0x04 DBAT
0x08 DLR
0x0C CSR
{0x10+4i} CDAR{i} (i=0..21)
0x88 ESR
0x90 RCR
{0x94+4i} RQC{i} (i=0..4)
0xB0 RPC
0xC0 UFCS
{0xC4+4i} UFCV{i} (i=0..4)
{0xE0+4i} UFCD{i} (i=0..4)
0xFC SFO
{0x100+4i} SFP{i} (i=0..31)
0x1C0 SFM0
0x1C4 SFM1
0x300 TGC
0x304 TCCR
0x308 TSR
{0x310+4i} TFA{i} (i=0..2)
0x320 CIVR0
0x324 CIVR1
0x328 CDVR0
0x32C CDVR1
0x330 CUL0
0x334 CUL1
0x338 CLL0
0x33C CLL1
0x350 DIC
0x354 DIS
0x358 EIC
0x35C EIS
{0x360+8i} RIC{i} (i=0..2)
{0x364+8i} RIS{i} (i=0..2)
0x378 TIC
0x37C TIS
0x380 ISS
0x390 GCCR
0x394 GMTT
0x398 GPTC
0x39C GTI
{0x3A0+4i} GTO{i} (i=0..2)
0x3AC GIC
0x3B0 GIS
0x3B4 GCPT
{0x3B8+4i} GCT{i} (i=0..2)
0x3D8 GCEC
0x500 ECMR
0x508 RFLR
0x510 ECSR
0x518 ECSIPR
0x520 PIR
0x554 APR
0x558 MPR
0x55C PFTCR
0x560 PFRCR
0x564 TPAUSER
0x5C0 MAHR
0x5C8 MALR
0x740 CEFCR
0x748 FRECR
0x750 TSFRCR
0x758 TLFRCR
0x760 RFCR
0x778 MAFCR

## WDT
Base 0xFCFE0000
0x00 WTCSR 16-bit
0x02 WTCNT 16-bit
0x04 WRCSR 16-bit

## CPG
Base 0xFCFE0010
0x00 FRQCR 16-bit
0x08 CPUSTS 8-bit
0x10 STBCR1 8-bit
0x14 STBCR2 8-bit
0x20 STBREQ1 8-bit
0x24 STBREQ2 8-bit
0x30 STBACK1 8-bit
0x34 STBACK2 8-bit
{0x3EC+4i} SYSCR{i} 8-bit (i=1..3)
{0x404+4i} STBCR{i} 8-bit (i=3..12)
0x450 SWRSTCR1 8-bit
0x454 SWRSTCR2 8-bit
0x117F0 RRAMKP 8-bit
0x117F2 DSCTR 8-bit
0x117F4 DSSSR 16-bit
0x117F6 DSESR 16-bit
0x117F8 DSFR 16-bit
0x11800 XTALCTR 8-bit

## INB
Base 0xFCFE1A00
0x00 RMPR
0x04 AXIBUSCTL0
0x0C AXIBUSCTL2
{0x4+4i} AXIBUSCTL{i} (i=5..7)
0x30 AXIRERRCTL0
0x38 AXIRERRCTL2
0x40 AXIRERRST0
0x48 AXIRERRST2
0x50 AXIRERRCLR0
0x58 AXIRERRCLR2

## GPIO
Base 0xFCFE3004
0x00 P1 16-bit
0x04 P2 16-bit
0x08 P3 16-bit
0x0C P4 16-bit
0x10 P5 16-bit
0x14 P6 16-bit
0x18 P7 16-bit
0x1C P8 16-bit
0x20 P9 16-bit
{0xFC+4i} PSR{i} (i=1..9)
{0x1FC+4i} PPR{i} 16-bit (i=0..9)
{0x2FC+4i} PM{i} 16-bit (i=1..9)
{0x3FC+4i} PMC{i} 16-bit (i=0..9)
{0x4FC+4i} PFC{i} 16-bit (i=0..9)
{0x5FC+4i} PFCE{i} 16-bit (i=0..9)
{0x6FC+4i} PNOT{i} 16-bit (i=1..9)
{0x7FC+4i} PMSR{i} (i=1..9)
{0x8FC+4i} PMCSR{i} (i=0..9)
{0x9FC+4i} PFCAE{i} 16-bit (i=0..9)
0xBFC SNCR
{0x3FFC+4i} PIBC{i} 16-bit (i=0..9)
{0x40FC+4i} PBDC{i} 16-bit (i=1..9)
{0x41FC+4i} PIPC{i} 16-bit (i=1..9)
0x4B1C JPPR0 16-bit
0x4B3C JPMC0 16-bit
0x4B8C JPMCSR0
0x4EFC JPIBC0 16-bit
