# R7F5A009 register map
Vendor: Renesas Electronics Corporation; Series: Tahoe; File version: 1
CPU: CM4 r0p4, little endian, MPU, FPU, 4 interrupt priority bits
Registers are 32-bit, read-write, no defined reset value unless marked. A register's access mark holds for its fields unless they carry their own. Offsets are from the block's base; [hi:lo] are bit positions; {n}, {i} and the like mark numbered series.

## CAC — Clock Frequency Accuracy Measurement Circuit
Base 0x4008B000; register names take the prefix CAC_
{0x0+i} CACR{i} 8-bit (i=0..2) — CAC Control Register {i}
0x03 CAICR 8-bit — CAC Interrupt Control Register
0x04 CASTR 8-bit ro — CAC Status Register
0x06 CAULVR 16-bit — CAC Upper-Limit Value Setting Register
0x08 CALLVR 16-bit — CAC Lower-Limit Value Setting Register
0x0A CACNTBR 16-bit ro — CAC Counter Buffer Register

## DOC — Data operation circuit
Base 0x4008B080; register names take the prefix DOC_
0x00 DOCR 8-bit — DOC Control Register
0x02 DODIR 16-bit — DOC Data Input Register
0x04 DODSR 16-bit — DOC Data Setting Register

## PORT — I/O port
Base 0x4008C000; register names take the prefix PORT_
{0x0+i} PORT{i}_PDR 8-bit (i=0..9) — Port {i} Direction Register
0x0A PORTA_PDR 8-bit — Port A Direction Register
0x0B PORTB_PDR 8-bit — Port B Direction Register
0x0C PORTC_PDR 8-bit — Port C Direction Register
0x0D PORTD_PDR 8-bit — Port D Direction Register
{0x20+i} PORT{i}_OPR 8-bit (i=0..9) — Port {i} Output Data Register
0x2A PORTA_OPR 8-bit — Port A Output Data Register
0x2B PORTB_OPR 8-bit — Port B Output Data Register
0x2C PORTC_OPR 8-bit — Port C Output Data Register
0x2D PORTD_OPR 8-bit — Port D Output Data Register
{0x40+i} PORT{i}_IPR 8-bit ro (i=0..9) — Port {i} Input Data Register
0x4A PORTA_IPR 8-bit ro — Port A Input Data Register
0x4B PORTB_IPR 8-bit ro — Port B Input Data Register
0x4C PORTC_IPR 8-bit ro — Port C Input Data Register
0x4D PORTD_IPR 8-bit ro — Port D Input Data Register
{0x60+i} PORT{i}_PMR 8-bit (i=0..9) — Port {i} Mode Register
0x6A PORTA_PMR 8-bit — Port A Mode Register
0x6B PORTB_PMR 8-bit — Port B Mode Register
0x6C PORTC_PMR 8-bit — Port C Mode Register
0x6D PORTD_PMR 8-bit — Port D Mode Register
{0x80+2i} PORT{i}_ODR0 8-bit (i=0..4) — Port {i} Open-Drain Control Register 0
{0x81+2i} PORT{i}_ODR1 8-bit (i=1..3) — Port {i} Open-Drain Control Register 1
{0x80+2i} PORT{i}_ODR0 8-bit (i=6..9) — Port {i} Open-Drain Control Register 0
{0x81+2i} PORT{i}_ODR1 8-bit (i=6..9) — Port {i} Open-Drain Control Register 1
0x94 PORTA_ODR0 8-bit — Port A Open-Drain Control Register 0
0x95 PORTA_ODR1 8-bit — Port A Open-Drain Control Register 1
0x96 PORTB_ODR0 8-bit — Port B Open-Drain Control Register 0
0x97 PORTB_ODR1 8-bit — Port B Open-Drain Control Register 1
0x98 PORTC_ODR0 8-bit — Port C Open-Drain Control Register 0
0x99 PORTC_ODR1 8-bit — Port C Open-Drain Control Register 1
0x9A PORTD_ODR0 8-bit — Port D Open-Drain Control Register 0
0x9B PORTD_ODR1 8-bit — Port D Open-Drain Control Register 1
{0xC0+i} PORT{i}_PCR 8-bit (i=0..9) — Port {i} Pull-Up Control Register
0xCA PORTA_PCR 8-bit — Port A Pull-Up Control Register
0xCB PORTB_PCR 8-bit — Port B Pull-Up Control Register
0xCC PORTC_PCR 8-bit — Port C Pull-Up Control Register
0xCD PORTD_PCR 8-bit — Port D Pull-Up Control Register

## MPC — Multi-function pin controller
Base 0x4008C100; register names take the prefix MPC_
0x1F PWPR 8-bit — Write-Protect Register
{0x40+i} P{i:02}PFS 8-bit (i=0..3) — P{i:02} Pin Function Control Register
{0x3E+i} P{i}PFS 8-bit (i=10..14) — P{i} Pin Function Control Register
{0x3C+i} P{i}PFS 8-bit (i=20..27) — P{i} Pin Function Control Register
{0x3A+i} P{i}PFS 8-bit (i=30..37) — P{i} Pin Function Control Register
{0x38+i} P{i}PFS 8-bit (i=40..43) — P{i} Pin Function Control Register
{0x36+i} P{i}PFS 8-bit (i=50..57) — P{i} Pin Function Control Register
{0x34+i} P{i}PFS 8-bit (i=60..67) — P{i} Pin Function Control Register
{0x32+i} P{i}PFS 8-bit (i=70..77) — P{i} Pin Function Control Register
{0x30+i} P{i}PFS 8-bit (i=80..86) — P{i} Pin Function Control Register
{0x2E+i} P{i}PFS 8-bit (i=90..97) — P{i} Pin Function Control Register
{0x90+i} PA{i}PFS 8-bit (i=0..7) — PA{i} Pin Function Control Register
{0x98+i} PB{i}PFS 8-bit (i=0..7) — PB{i} Pin Function Control Register
{0xA0+i} PC{i}PFS 8-bit (i=0..7) — PC{i} Pin Function Control Register
{0xA8+i} PD{i}PFS 8-bit (i=0..7) — PD{i} Pin Function Control Register
