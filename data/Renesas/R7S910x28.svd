# R7S910x28 register map
Vendor: Renesas Electronics Corporation; Series: RZT; File version: 1.0
CPU: other r1p4, little endian, MPU, FPU, vendor SysTick, 1 interrupt priority bits
Registers are 32-bit, read-write, no defined reset value unless marked. A register's access mark holds for its fields unless they carry their own. Offsets are from the block's base; [hi:lo] are bit positions; {n}, {i} and the like mark numbered series.

## ETHERSW — Ethernet switch
Base 0xA00BF000; register names take the prefix ETHERSW_
0x00 ETSPCMD — Ethernet system protect command register
0x04 MACSEL — MAC select register
{0x8+4i} MII_CTRL{i} (i=0..2) — MII control register {i}
0x14 ETHPHYLNK — Ethernet PHY LINK mode register
0x100 CATOFFADD — EtherCAT PHY offset address setting
0x104 CATEMMD — EtherCAT operation mode setting
0x10C CATTXCSFT — EtherCAT TXC shift setting
0x110 ETHSWMTC — Ethernet switch management TAG control register
0x114 ETHSWMD — Ethernet switch operation mode setting register
0x118 ETHSFTRST — Ethernet peripheral reset register
0x200 SWTMEN — Timer output enable register
0x204 SWTMSTSEC — Timer second start setting register
0x208 SWTMSTNS — Timer nanosecond start setting register
0x20C SWTMPSEC — Timer second cycle setting register
0x210 SWTMPNS — Timer nanosecond cycle setting register
0x214 SWTMWTH — Timer pulse width setting register
0x22C SWTMLATSEC ro — Timer second time holding register
0x230 SWTMLATNS ro — Timer nanosecond time holding register
0x1008 PORT_ENA — Port enable register
0x100C UCAST_DEFAULT_MASK — Unicast default mask register
0x1014 BCAST_DEFAULT_MASK — Broadcast default mask register
0x1018 MCAST_DEFAULT_MASK — Multicast default mask register
0x101C INPUT_LEARN_BLOCK — Input learning blocking register
0x1020 MGMT_CONFIG — Management configuration register
0x1024 MODE_CONFIG — Mode configuration register
0x1034 VLAN_TAG_ID
0x1080 OQMGR_STATUS — Output queue management status register
0x1084 QMGR_MINCELLS — Output queue minimum memory register
0x1088 QMGR_ST_MINCELLS — Output queue minimum memory statistics register
0x108C QMGR_CGS_STAT ro — Output queue congestion status register
0x1090 QMGR_IFACE_STAT ro — Queue internal interface status register
0x1094 QMGR_WEIGHTS — Queue wait register
{0x1100+4i} VLAN_PRIORITY{i} (i=0..2) — VLAN priority register {i}
{0x1140+4i} IP_PRIORITY{i} (i=0..2) — IP priority register {i}
{0x1180+4i} PRIORITY_CFG{i} (i=0..2) — Priority configuration register {i}
0x11C0 HUB_CONTROL
0x11C4 HUB_STATS — Hub status register
{0x11C8+8i} HUB_FLT_MAC{i}lo (i=0..6) — Hub input filter MAC address low register {i}
{0x11CC+8i} HUB_FLT_MAC{i}hi (i=0..6) — Hub input filter MAC address high register {i}
0x1300 TOTAL_BYT_FRM ro — Switch statistics counter
0x1304 TOTAL_BYT_DISC ro — Switch statistics counter
0x1308 TOTAL_FRM ro — Switch statistics counter
0x130C TOTAL_DISC ro — Switch statistics counter
{0x1310+8i} ODISC{i} ro (i=0..2) — Switch statistics counter
{0x1314+8i} IDISC_BLOCKED{i} ro (i=0..2) — Switch statistics counter
0x1500 LRN_REC_A ro — Learning record A register
0x1504 LRN_REC_B ro — Learning record B register
0x1508 LRN_STATUS ro — Learning data status register
0x9008 COMMAND_CONFIG0 — Command configuration register 0
0x9014 FRM_LENGTH0 — Maximum frame length register 0 (shared)
0x901C RX_SECTION_EMPTY0 ro — FIFO buffer threshold register 0 (shared)
0x9020 RX_SECTION_FULL0 — FIFO buffer threshold register 0 (shared)
0x9024 TX_SECTION_EMPTY0 — FIFO buffer threshold register 0 (shared)
0x9028 TX_SECTION_FULL0 — FIFO buffer threshold register 0 (shared)
0x902C RX_ALMOST_EMPTY0 ro — FIFO buffer threshold register 0 (shared)
0x9030 RX_ALMOST_FULL0 ro — FIFO buffer threshold register 0 (shared)
0x9034 TX_ALMOST_EMPTY0 ro — FIFO buffer threshold register 0 (shared)
0x9038 TX_ALMOST_FULL0 ro — FIFO buffer threshold register 0 (shared)
0x9058 MAC_STATUS0 ro — MAC status register 0 (shared)
0x905C TX_IPG_LENGTH0 — Transmit IPG length register 0 (shared)
0x9100 etherStatsOctets_0 — MAC receive statistics counter
0x9104 OctetsOK_0 — MAC receive statistics counter
0x9108 aAlignmentErrors_0 — MAC receive statistics counter
0x910C aPAUSEMACCtrlFrames_0 — MAC receive statistics counter
0x9110 FramesOK_0 — MAC receive statistics counter
0x9114 CRCErrors_0 — MAC receive statistics counter
0x9118 VLANOK_0 — MAC receive statistics counter
0x911C ifInErrors_0 — MAC receive statistics counter
0x9120 ifInUcastPkts_0 — MAC receive statistics counter
0x9124 ifInMulticastPkts_0 — MAC receive statistics counter
0x9128 ifInBroadcastPkts_0 — MAC receive statistics counter
0x912C etherStatsDropEvents_0 — MAC receive statistics counter
0x9130 etherStatsPkts_0 — MAC receive statistics counter
0x9134 etherStatsUndersizePkts_0 — MAC receive statistics counter
0x9138 etherStatsPkts64Octets_0 — MAC receive statistics counter
0x913C etherStatsPkts65to127Octets_0 — MAC receive statistics counter
0x9140 etherStatsPkts128to255Octets_0 — MAC receive statistics counter
0x9144 etherStatsPkts256to511Octets_0 — MAC receive statistics counter
0x9148 etherStatsPkts512to1023Octets_0 — MAC receive statistics counter
0x914C etherStatsPkts1024to1518Octets_0 — MAC receive statistics counter
0x9150 etherStatsPkts1519toMax_0 — MAC receive statistics counter
0x9154 etherStatsOversizePkts_0 — MAC receive statistics counter
0x9158 etherStatsJabbers_0 — MAC receive statistics counter
0x915C etherStatsFragments_0 — MAC receive statistics counter
0x9160 aMACControlFramesReceived_0 — MAC receive statistics counter
0x9164 aFrameTooLong_0 — MAC receive statistics counter
0x916C StackedVLANOK_0 — MAC receive statistics counter
0x9180 TXetherStatsOctets_0 — MAC transmit statistics counter
0x9184 TxOctetsOK_0 — MAC transmit statistics counter
0x918C TXaPAUSEMACCtrlFrames_0 — MAC transmit statistics counter
0x9190 TxFramesOK_0 — MAC transmit statistics counter
0x9194 TxCRCErrors_0 — MAC transmit statistics counter
0x9198 TxVLANOK_0 — MAC transmit statistics counter
0x919C ifOutErrors_0 — MAC transmit statistics counter
0x91A0 ifUcastPkts_0 — MAC transmit statistics counter
0x91A4 ifMulticastPkts_0 — MAC transmit statistics counter
0x91A8 ifBroadcastPkts_0 — MAC transmit statistics counter
0x91AC TXetherStatsDropEvents_0 — MAC transmit statistics counter
0x91B0 TXetherStatsPkts_0 — MAC transmit statistics counter
0x91B4 TXetherStatsUndersizePkts_0 — MAC transmit statistics counter
0x91B8 TXetherStatsPkts64Octets_0 — MAC transmit statistics counter
0x91BC TXetherStatsPkts65to127Octets_0 — MAC transmit statistics counter
0x91C0 TXetherStatsPkts128to255Octets_0 — MAC transmit statistics counter
0x91C4 TXetherStatsPkts256to511Octets_0 — MAC transmit statistics counter
0x91C8 TXetherStatsPkts512to1023Octets_0 — MAC transmit statistics counter
0x91CC TXetherStatsPkts1024to1518Octets_0 — MAC transmit statistics counter
0x91D0 TXetherStatsPkts1519toMax_0 — MAC transmit statistics counter
0x91D4 TXetherStatsOversizePkts_0 — MAC transmit statistics counter
0x91D8 TXetherStatsJabbers_0 — MAC transmit statistics counter
0x91DC TXetherStatsFragments_0 — MAC transmit statistics counter
0x91E0 aMACControlFrames_0 — MAC transmit statistics counter
0x91E4 TXaFrameTooLong_0 — MAC transmit statistics counter
0x91EC aMultipleCollisions_0 — MAC transmit statistics counter
0x91F0 aSingleCollisions_0 — MAC transmit statistics counter
0x91F4 aLateCollisions_0 — MAC transmit statistics counter
0x91F8 aExcessCollisions_0 — MAC transmit statistics counter
0xB008 COMMAND_CONFIG1 — Command configuration register 1
0xB014 FRM_LENGTH1 — Maximum frame length register 1 (shared)
0xB01C RX_SECTION_EMPTY1 ro — FIFO buffer threshold register 1 (shared)
0xB020 RX_SECTION_FULL1 — FIFO buffer threshold register 1 (shared)
0xB024 TX_SECTION_EMPTY1 — FIFO buffer threshold register 1 (shared)
0xB028 TX_SECTION_FULL1 — FIFO buffer threshold register 1 (shared)
0xB02C RX_ALMOST_EMPTY1 ro — FIFO buffer threshold register 1 (shared)
0xB030 RX_ALMOST_FULL1 ro — FIFO buffer threshold register 1 (shared)
0xB034 TX_ALMOST_EMPTY1 ro — FIFO buffer threshold register 1 (shared)
0xB038 TX_ALMOST_FULL1 ro — FIFO buffer threshold register 1 (shared)
0xB058 MAC_STATUS1 ro — MAC status register 1 (shared)
0xB05C TX_IPG_LENGTH1 — Transmit IPG length register 1 (shared)
0xB100 etherStatsOctets_1 — MAC receive statistics counter
0xB104 OctetsOK_1 — MAC receive statistics counter
0xB108 aAlignmentErrors_1 — MAC receive statistics counter
0xB10C aPAUSEMACCtrlFrames_1 — MAC receive statistics counter
0xB110 FramesOK_1 — MAC receive statistics counter
0xB114 CRCErrors_1 — MAC receive statistics counter
0xB118 VLANOK_1 — MAC receive statistics counter
0xB11C ifInErrors_1 — MAC receive statistics counter
0xB120 ifInUcastPkts_1 — MAC receive statistics counter
0xB124 ifInMulticastPkts_1 — MAC receive statistics counter
0xB128 ifInBroadcastPkts_1 — MAC receive statistics counter
0xB12C etherStatsDropEvents_1 — MAC receive statistics counter
0xB130 etherStatsPkts_1 — MAC receive statistics counter
0xB134 etherStatsUndersizePkts_1 — MAC receive statistics counter
0xB138 etherStatsPkts64Octets_1 — MAC receive statistics counter
0xB13C etherStatsPkts65to127Octets_1 — MAC receive statistics counter
0xB140 etherStatsPkts128to255Octets_1 — MAC receive statistics counter
0xB144 etherStatsPkts256to511Octets_1 — MAC receive statistics counter
0xB148 etherStatsPkts512to1023Octets_1 — MAC receive statistics counter
0xB14C etherStatsPkts1024to1518Octets_1 — MAC receive statistics counter
0xB150 etherStatsPkts1519toMax_1 — MAC receive statistics counter
0xB154 etherStatsOversizePkts_1 — MAC receive statistics counter
0xB158 etherStatsJabbers_1 — MAC receive statistics counter
0xB15C etherStatsFragments_1 — MAC receive statistics counter
0xB160 aMACControlFramesReceived_1 — MAC receive statistics counter
0xB164 aFrameTooLong_1 — MAC receive statistics counter
0xB16C StackedVLANOK_1 — MAC receive statistics counter
0xB180 TXetherStatsOctets_1 — MAC transmit statistics counter
0xB184 TxOctetsOK_1 — MAC transmit statistics counter
0xB18C TXaPAUSEMACCtrlFrames_1 — MAC transmit statistics counter
0xB190 TxFramesOK_1 — MAC transmit statistics counter
0xB194 TxCRCErrors_1 — MAC transmit statistics counter
0xB198 TxVLANOK_1 — MAC transmit statistics counter
0xB19C ifOutErrors_1 — MAC transmit statistics counter
0xB1A0 ifUcastPkts_1 — MAC transmit statistics counter
0xB1A4 ifMulticastPkts_1 — MAC transmit statistics counter
0xB1A8 ifBroadcastPkts_1 — MAC transmit statistics counter
0xB1AC TXetherStatsDropEvents_1 — MAC transmit statistics counter
0xB1B0 TXetherStatsPkts_1 — MAC transmit statistics counter
0xB1B4 TXetherStatsUndersizePkts_1 — MAC transmit statistics counter
0xB1B8 TXetherStatsPkts64Octets_1 — MAC transmit statistics counter
0xB1BC TXetherStatsPkts65to127Octets_1 — MAC transmit statistics counter
0xB1C0 TXetherStatsPkts128to255Octets_1 — MAC transmit statistics counter
0xB1C4 TXetherStatsPkts256to511Octets_1 — MAC transmit statistics counter
0xB1C8 TXetherStatsPkts512to1023Octets_1 — MAC transmit statistics counter
0xB1CC TXetherStatsPkts1024to1518Octets_1 — MAC transmit statistics counter
0xB1D0 TXetherStatsPkts1519toMax_1 — MAC transmit statistics counter
0xB1D4 TXetherStatsOversizePkts_1 — MAC transmit statistics counter
0xB1D8 TXetherStatsJabbers_1 — MAC transmit statistics counter
0xB1DC TXetherStatsFragments_1 — MAC transmit statistics counter
0xB1E0 aMACControlFrames_1 — MAC transmit statistics counter
0xB1E4 TXaFrameTooLong_1 — MAC transmit statistics counter
0xB1EC aMultipleCollisions_1 — MAC transmit statistics counter
0xB1F0 aSingleCollisions_1 — MAC transmit statistics counter
0xB1F4 aLateCollisions_1 — MAC transmit statistics counter
0xB1F8 aExcessCollisions_1 — MAC transmit statistics counter
0xD004 TSM_CONFIG — Timer module configuration register
0xD008 TSM_IRQ_STAT_ACK — Timer interrupt status/acknowledge register
0xD020 PORT0_CTRL — Port timestamp control/status register 0
0xD024 PORT0_TIME — Port timestamp register 0
0xD028 PORT1_CTRL — Port timestamp control/status register 1
0xD02C PORT1_TIME — Port timestamp register 1
0xD120 ATIME_CTRL — Timer control register
0xD124 ATIME — Timer nanosecond register
0xD128 ATIME_OFFSET — Timer offset correction register
0xD12C ATIME_EVT_PERIOD — Timer cycle event generation register
0xD130 ATIME_CORR — Timer drift correction register
0xD134 ATIME_INC — Timer increment register
0xD138 ATIME_SEC — Timer second register
0xD13C ATIME_CORR_OFFS — Timer offset correction count register
0xF000 DLR_CONTROL
0xF004 DLR_STATUS
0xF008 DLR_ETH_TYP — DLR EtherType register
0xF00C DLR_IRQ_CTRL — DLR interrupt control register
0xF010 DLR_IRQ_STAT_ACK — DLR interrupt status/acknowledge register
0xF014 LOC_MAClo — DLR local MAC address low register
0xF018 LOC_MAChi — DLR local MAC address high register
0xF020 SUPR_MAClo ro — DLR supervisor MAC address low register
0xF024 SUPR_MAChi ro — DLR supervisor MAC address high register
0xF028 STATE_VLAN ro — DLR ring status/VLAN register
0xF02C BEC_TMOUT ro — DLR beacon timeout timer register
0xF030 BEC_INTRVL ro — DLR beacon interval register
0xF034 SUPR_IPADR ro — DLR supervisor IP address register
0xF038 ETH_STYP_VER ro — DLR sub-type/protocol version register
0xF03C INV_TMOUT ro — DLR beacon illegal time-out timer register
0xF040 SEQ_ID ro — DLR sequence ID register
0xF060 RX_STAT0 ro — DLR MAC statistics counter
0xF064 RX_ERR_STAT0 ro — DLR MAC statistics counter
0xF068 TX_STAT0 ro — DLR MAC statistics counter
0xF070 RX_STAT1 ro — DLR MAC statistics counter
0xF074 RX_ERR_STAT1 ro — DLR MAC statistics counter
0xF078 TX_STAT1 ro — DLR MAC statistics counter
