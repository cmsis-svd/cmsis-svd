# R7S910x13 register map
Vendor: Renesas Electronics Corporation; Series: RZT; File version: 1.0
CPU: other r1p4, little endian, MPU, FPU, vendor SysTick, 1 interrupt priority bits
Registers are 32-bit, read-write, no defined reset value unless marked. A register's access mark holds for its fields unless they carry their own. Offsets are from the block's base; [hi:lo] are bit positions; {n}, {i} and the like mark numbered series.

## SPIBSC — SPI multi I/O bus controller
Base 0xA0005000; register names take the prefix SPIBSC_
0x00 CMNCR — Common control register
0x04 SSLDR — SSL delay register
0x08 SPBCR — Bit rate register
0x0C DRCR — Data read control register
0x10 DRCMR — Data read command setting register
0x14 DREAR — Data read extended address setting register
0x18 DROPR — Data read option setting register
0x1C DRENR — Data read enable setting register
0x20 SMCR — SPI mode control register
0x24 SMCMR — SPI mode command setting register
0x28 SMADR — SPI mode address setting register
0x2C SMOPR — SPI mode option setting register
0x30 SMENR — SPI mode enable setting register
0x38 SMRDR0 ro — SPI mode read data register 0
0x40 SMWDR0 — SPI mode write data register 0
0x48 CMNSR ro — Common status register
0x58 DRDMCR — Data read dummy cycle setting register
0x60 SMDMCR — SPI mode dummy cycle setting register

## VIC — Vectored interrupt controller
Base 0xA0010000; register names take the prefix VIC_
{0x0+4i} IRQS{i} ro (i=0..7) — IRQ status register {i}
{0x40+4i} RAIS{i} ro (i=0..7) — Interrupt input status register {i}
{0x80+4i} IEN{i} (i=0..7) — Interrupt enable register {i}
{0xA0+4i} IEC{i} wo (i=0..7) — Interrupt enable clear register {i}
{0x100+4i} PLS{i} (i=0..7) — Interrupt detection type select register {i}
{0x120+4i} PIC{i} wo (i=0..7) — Edge detection bit clear register {i}
0x1C0 PRLM0 — Interrupt priority level mask register 0
0x1C4 PRLC0 wo — Interrupt priority level mask clear register 0
0x1C8 UEN0 — User mode enable register 0
0x200 HVA0 wo — Interrupt address register 0
{0x210+4i} ISS{i} ro (i=0..7) — Interrupt service status register {i}
{0x230+4i} ISC{i} ro (i=0..7) — Interrupt service current register {i}
{0x400+4i} VAD{i} (i=1..255) — Interrupt address storage register {i}
{0x800+4i} PRL{i} (i=1..255) — Interrupt priority level storage register {i}
0x1000 IRQS8 ro — IRQ status register 8
0x1004 IRQS9 ro — IRQ status register 9
0x1040 RAIS8 ro — Interrupt input status register 8
0x1044 RAIS9 ro — Interrupt input status register 9
0x1080 IEN8 — Interrupt enable register 8
0x1084 IEN9 — Interrupt enable register 9
0x10A0 IEC8 wo — Interrupt enable clear register 8
0x10A4 IEC9 wo — Interrupt enable clear register 9
0x1100 PLS8 — Interrupt detection type select register 8
0x1104 PLS9 — Interrupt detection type select register 9
0x1120 PIC8 wo — Edge detection bit clear register 8
0x1124 PIC9 wo — Edge detection bit clear register 9
0x11C0 PRLM1 — Interrupt priority level mask register 1
0x11C4 PRLC1 wo — Interrupt priority level mask clear register 1
0x11C8 UEN1 — User mode enable register 1
0x1210 ISS8 ro — Interrupt service status register 8
0x1214 ISS9 ro — Interrupt service status register 9
0x1230 ISC8 ro — Interrupt service current register 8
0x1234 ISC9 ro — Interrupt service current register 9
{0x1000+4i} VAD{i} (i=256..300) — Interrupt address storage register {i}
{0x1400+4i} PRL{i} (i=256..300) — Interrupt priority level storage register {i}

## USBf — USB2.0 Function module
Base 0xA0060000; register names take the prefix USBf_
0x00 SYSCFG0 16-bit — System configuration control register 0
0x02 SYSCFG1 16-bit — System configuration control register 1
0x04 SYSSTS0 16-bit ro — System configuration status register
0x08 DVSTCTR0 16-bit — Device control register 0
0x0C TESTMODE 16-bit
0x10 D0FBCFG 16-bit — DMA0-FIFO bus configuration register
0x12 D1FBCFG 16-bit — DMA1-FIFO bus configuration register
0x14 CFIFO — CFIFO port register
0x18 D0FIFO — D0FIFO port register
0x1C D1FIFO — D1FIFO port register
0x20 CFIFOSEL 16-bit — CFIFO port select register
0x22 CFIFOCTR 16-bit — CFIFO port control register
0x28 D0FIFOSEL 16-bit — D0FIFO port select register
0x2A D0FIFOCTR 16-bit — D0FIFO port control register
0x2C D1FIFOSEL 16-bit — D1FIFO port select register
0x2E D1FIFOCTR 16-bit — D1FIFO port control register
0x30 INTENB0 16-bit — Interrupt enable register 0
0x36 BRDYENB 16-bit — BRDY interrupt enable register
0x38 NRDYENB 16-bit — NRDY interrupt enable register
0x3A BEMPENB 16-bit — BEMP interrupt enable register
0x3C SOFCFG 16-bit — SOF output configuration register
0x40 INTSTS0 16-bit — Interrupt status register 0
0x46 BRDYSTS 16-bit — BRDY interrupt status register
0x48 NRDYSTS 16-bit — NRDY interrupt status register
0x4A BEMPSTS 16-bit — BEMP interrupt status register
0x4C FRMNUM 16-bit — Frame number register
0x4E UFRMNUM 16-bit ro — Micro frame number register
0x50 USBADDR 16-bit ro — USB address register
0x54 USBREQ 16-bit — USB request type register
0x56 USBVAL 16-bit — USB request value register
0x58 USBINDX 16-bit — USB request index register
0x5A USBLENG 16-bit — USB request length register
0x5C DCPCFG 16-bit — DCP configuration register
0x5E DCPMAXP 16-bit — DCP max packet size register
0x60 DCPCTR 16-bit — DCP control register
0x64 PIPESEL 16-bit — Pipe window select register
0x68 PIPECFG 16-bit — Pipe configuration register
0x6A PIPEBUF 16-bit — Pipe buffer specification register
0x6C PIPEMAXP 16-bit — Pipe max packet size register
0x6E PIPEPERI 16-bit — Pipe cycle control register
{0x6E+2i} PIPE{i}CTR 16-bit (i=1..9) — PIPE{i} control register
{0x8C+4i} PIPE{i}TRE 16-bit (i=1..5) — PIPE{i} transaction counter enable register
{0x8E+4i} PIPE{i}TRN 16-bit (i=1..5) — PIPE{i} transaction counter register
0x100 LPCTRL 16-bit — Low-power control register
0x102 LPSTS 16-bit — Low-power status register
0x104 PHYFUNCTR 16-bit — PHY function control register
{0x160+4i} D0FIFOB{i} (i=0..7) — D0FIFO continuous transfer port register {i}
{0x180+4i} D1FIFOB{i} (i=0..7) — D1FIFO continuous transfer port register {i}
0x1A0 PHYSET1 16-bit — PHY configuration register 1
