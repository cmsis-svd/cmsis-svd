# R7S910x23 register map
Vendor: Renesas Electronics Corporation; Series: RZT; File version: 1.5
RZ/T1 Group
CPU: other r1p4, little endian, MPU, FPU, vendor SysTick, 1 interrupt priority bits
Registers are 32-bit, read-write, no defined reset value unless marked. A register's access mark holds for its fields unless they carry their own. Offsets are from the block's base; lines under a group give offsets from that group; [hi:lo] are bit positions; {n}, {i} and the like mark numbered series; 'fields as' and 'values as' point back to an identical list; <NAME> marks a mode.

## Memory map
0xA0000000 PORT size 0x200 — I/O port
0xA0000200 MPC size 0x200 — Multi-function pin controller
0xA0005000 SPIBSC size 0x1000 — SPI multi I/O bus controller
0xA0010000 VIC size 0x2000 — Vectored interrupt controller
0xA0062000 DMA0 size 0x800 — Direct memory access controller 0
0xA0063000 DMA1 size 0x800 — Direct memory access controller 1
0xA0065000 SCIFA0 size 0x20 — FIFO embedded serial communications interface 0
0xA0065400 SCIFA1 size 0x20 — FIFO embedded serial communications interface 1
0xA0065800 SCIFA2 size 0x20 — FIFO embedded serial communications interface 2
0xA0066000 SCIFA4 size 0x20 — FIFO embedded serial communications interface 4
0xA0068000 RSPI0 size 0x20 — Serial peripheral interface 0
0xA0068400 RSPI1 size 0x20 — Serial peripheral interface 1
0xA007C000 CRC size 0x40 — CRC Calculator
0xA007D000 ECMM size 0x40 — Error control module master
0xA007D040 ECMC size 0x40 — Error control module checker
0xA007D080 ECM size 0x80 — Error control module common
0xA0080000 CMT size 0x60 — Compare match timer
0xA0080100 TPU size 0x104 — 16-bit timer pulse unit
0xA0080300 CMTW size 0x200 — Compare match timer W
0xA0080600 WDT0 size 0x10 — Watchdog timer 0
0xA0080700 IWDT size 0x10 — Independent watchdog timer
0xA0080900 RIIC0 size 0x20 — I2C Bus Interface
0xA0080940 RIIC1 size 0x20 — I2C Bus Interface
0xA0080A00 TSN size 0x4 — Temperature sensor
0xA0080B00 ELC size 0x80 — Event link controller
0xA0081200 DOC size 0x8 — Data operation circuit
0xA008C000 S12ADC0 size 0x100 — 12-Bit A/D Converter 0
0xA008C400 S12ADC1 size 0x100 — 12-Bit A/D Converter 1
0xA0090000 CLMA0 size 0x20 — Clock monitor circuit 0
0xA0090020 CLMA1 size 0x20 — Clock monitor circuit 1
0xA0090040 CLMA2 size 0x20 — Clock monitor circuit 2
0xA0094000 ICU size 0x400 — Interrupt controller
0xA00B0000 SYSTEM size 0xC00 — System controller
0xA00F3000 ECCRAM size 0x400 — ECC controller for RAM

## PORT — I/O port
Base 0xA0000000; register names take the prefix PORT_
{0x0+2i} PORT{i}_PDR 16-bit (i=0..7) — Port direction register
0x12 PORT9_PDR 16-bit — Port direction register
0x14 PORTA_PDR 16-bit — Port direction register
0x18 PORTC_PDR 16-bit — Port direction register
0x1C PORTE_PDR 16-bit — Port direction register
0x20 PORTG_PDR 16-bit — Port direction register
{0x40+i} PORT{i}_PODR 8-bit (i=0..7) — Port output data register
0x49 PORT9_PODR 8-bit — Port output data register
0x4A PORTA_PODR 8-bit — Port output data register
0x4C PORTC_PODR 8-bit — Port output data register
0x4E PORTE_PODR 8-bit — Port output data register
0x50 PORTG_PODR 8-bit — Port output data register
{0x60+i} PORT{i}_PIDR 8-bit ro (i=0..7) — Port input data register
0x69 PORT9_PIDR 8-bit ro — Port input data register
0x6A PORTA_PIDR 8-bit ro — Port input data register
0x6C PORTC_PIDR 8-bit ro — Port input data register
0x6E PORTE_PIDR 8-bit ro — Port input data register
0x70 PORTG_PIDR 8-bit ro — Port input data register
{0x80+i} PORT{i}_PMR 8-bit (i=0..7) — Port mode register
0x89 PORT9_PMR 8-bit — Port mode register
0x8A PORTA_PMR 8-bit — Port mode register
0x8C PORTC_PMR 8-bit — Port mode register
0x8E PORTE_PMR 8-bit — Port mode register
0x90 PORTG_PMR 8-bit — Port mode register
{0x100+2i} PORT{i}_PCR 16-bit (i=0..7) — Pull-up/pull-down control register
0x112 PORT9_PCR 16-bit — Pull-up/pull-down control register
0x114 PORTA_PCR 16-bit — Pull-up/pull-down control register
0x11C PORTE_PCR 16-bit — Pull-up/pull-down control register
0x120 PORTG_PCR 16-bit — Pull-up/pull-down control register
