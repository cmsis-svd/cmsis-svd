# R7S910x18 register map
Vendor: Renesas Electronics Corporation; Series: RZT; File version: 1.0
CPU: other r1p4, little endian, MPU, FPU, vendor SysTick, 1 interrupt priority bits
Registers are 32-bit, read-write, no defined reset value unless marked. A register's access mark holds for its fields unless they carry their own. Offsets are from the block's base; [hi:lo] are bit positions; {n}, {i} and the like mark numbered series.

## CLMA0 — Clock monitor circuit 0
Base 0xA0090000; register names take the prefix CLMA0_
0x00 CLMA0CTL0 8-bit — CLMA0 control register 0
0x08 CLMA0CMPL 16-bit — CLMA0 compare register L
0x0C CLMA0CMPH 16-bit — CLMA0 compare register H
0x10 CLMA0PCMD 8-bit wo — CLMA0 command register
0x14 CLMA0PS 8-bit ro — CLMA0 protection status register

## CLMA1 — Clock monitor circuit 1
Base 0xA0090020; register names take the prefix CLMA1_
Registers as CLMA0 (with CLMA0 read as CLMA1).

## CLMA2 — Clock monitor circuit 2
Base 0xA0090040; register names take the prefix CLMA2_
Registers as CLMA0 (with CLMA0 read as CLMA2).

## ICU — Interrupt controller
Base 0xA0094000; register names take the prefix ICU_
{0x0+4i} DMA0SEL{i} (i=0..15) — DMAC unit 0 source select register {i}
{0x40+4i} DMA1SEL{i} (i=0..15) — DMAC unit 1 source select register {i}
0x80 DMASTG — DMAC software start register
{0x200+4i} IRQCR{i} (i=0..15) — IRQ control register {i}
0x240 IRQFLTE — IRQ pin digital noise filter enable register
0x244 IRQFLTC — IRQ pin digital noise filter setting register
0x248 NMISR — Non-maskable interrupt status register
0x24C NMICLR — Non-maskable interrupt status clear register
0x250 NMICR — NMI pin interrupt control register
0x254 NMIFLTE — NMI pin digital noise filter enable register
0x258 NMIFLTC — NMI pin digital noise filter setting register
{0x25C+4i} EPHYCR{i} (i=0..2) — EtherPHY control register {i}
0x268 EPHYFLTE — EtherPHY interrupt request pin digital noise filter enable register
0x26C EPHYFLTC — EtherPHY interrupt request pin digital noise filter setting register
0x270 DREQFLTE — External DMA request pin digital noise filter enable register
0x274 DREQFLTC — External DMA request pin digital noise filter setting register
0x290 CPUINT — Inter-CPU interrupt request register

## SYSTEM — System controller
Base 0xA00B0000; register names take the prefix SYSTEM_
0x20 SCKCR — System clock control register
0x24 SCKCR2 — System clock control register 2
0x28 DSCR — DS I/F clock control register
0x34 PLL1CR — PLL1 control register
0x38 PLL1CR2 — PLL1 control register 2
0x40 LOCOCR — Low-speed on-chip oscillator control register
0x4C OSTDCR — Oscillation stop detect control register
0x200 RSTSR0 — Reset status register 0
0x210 SWRR1 — Software reset register
0x220 SWRR2 — Software reset register 2
0x248 MRCTLC — Module reset control register C
0x300 MSTPCRA — Module stop control register A
0x304 MSTPCRB — Module stop control register B
0x308 MSTPCRC — Module stop control register C
0x30C MSTPCRD — Module stop control register D
0x310 MSTPCRE — Module stop control register E
0x314 MSTPCRF — Module stop control register F
0x800 SYTATCMWAIT — ATCM wait control register
0x920 SYTSEMFEN — Semaphore enable register
{0x930+4i} SYTSEMF{i} (i=0..7) — Semaphore register {i}
0xA00 DBGIFCNT — Debug interface control register
0xA60 MDMONR ro — Mode monitor register
0xA80 ECMMCNT — ECM mask control register
0xB00 PRCR — Protect register

## ETHERC — Ethernet controller
Base 0xA00E0000; register names take the prefix ETHERC_
0x00 C0TYPE (alternate view of 0) — Hardware function type register
0x08 C0STAT (alternate view of 0) — Hardware function state register
0xF000 SYSC — Hardware function command register
{0xEFF4+4i} R{i} (i=4..7) — Hardware function argument register {i}
0xF014 CMD (alternate view of 0) — Hardware function command register
0xF020 R0 ro — Hardware function return value register 0
0xF024 R1 ro — Hardware function return value register 1
0x1000C GMAC_TXID ro — TX ID register
0x10010 GMAC_TXRESULT ro — TX RESULT register
0x10020 GMAC_MODE — MODE register
0x10024 GMAC_RXMODE — RX MODE register
0x10028 GMAC_TXMODE — TX MODE register
0x10030 GMAC_RESET wo — RESET register
{0x1007C+4i} GMAC_PAUSE{i} (i=1..5) — PAUSE packet data register {i}
0x10098 GMAC_FLWCTL — RX FLOWCONTROL register
0x1009C GMAC_PAUSPKT — PAUSE register
0x100A0 GMAC_MIIM — MIM register
{0x10100+8i} GMAC_ADR{i}A (i=0..15) — MAC address register {i}A
{0x10104+8i} GMAC_ADR{i}B (i=0..15) — MAC address register {i}B
0x10200 GMAC_RXFIFO ro — RX FIFO status register
0x10204 GMAC_TXFIFO ro — TX FIFO status register
0x10208 GMAC_ACC — TCPIPACC register
0x10220 GMAC_RXMAC_ENA — RX MAC ENABLE register
0x10224 GMAC_LPI_MODE — LPI mode control register
0x10228 GMAC_LPI_TIMING — LIP CLIENT timing control register
0x11100 BUFID — Receive FIFO information register
0x1201C ETHSW10HDEN (alternate view of 0) — Ether Switch 10-Mbps/half-duplex mode setting register
0x12100 SPCMD — System protect command register
0x12110 EMACRST — Ethernet MAC reset register

## ECCRAM — ECC controller for RAM
Base 0xA00F3000; register names take the prefix ECCRAM_
0x00 RAMPCMD — Protection command register
0x100 RAMEDC — ECC decoder configuration register
0x104 RAMEEC — ECC encoder configuration register
0x108 RAMDBEST ro — 2-bit ECC error status register
0x10C RAMDBEAD ro — 2-bit ECC error address register
0x110 RAMDBECNT ro — 2-bit ECC error counter register
